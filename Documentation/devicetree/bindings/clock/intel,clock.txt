## Documentation/devicetree/bindings/clock/intel,clock.txt
```
IMC CLOCK

Clock framework could be enabled on IMC Linux native
The dtsi file is generated

** for fixed clock (32K, 26M..) following compatible is used:
compatible = "fixed-clock"

** for intel pll following compatible is used
compatible = "intel,xgold-pll"

** for intel phase shifter following compatible is used
compatible = "intel,xgold-phs"

** for intel clock divivers following compatibles is used
compatible = "intel,xgold-fixed-divider"
compatible = "intel,xgold-divider"

** for intel clock divivers following compatible is used
compatible = "intel,xgold-mux"

** for intel clock  following compatibles is used
compatible = "intel,xgold-clock"
compatible = "intel,xgold-block-clock"
```

## Documentation/devicetree/bindings/intel/coho_board_type.txt
```
* List of compatibles used by SSG for coho board types

compatible = "SOFIA3GR_MRD6"
compatible = "SOFIA3GR_OARS7"
compatible = "SOFIA3GR_MRD6_720"
```

## Documentation/devicetree/bindings/intel/intel-compatibles.txt
```
IMC

* List of compatibles used by IMC and defined as intel compatibles
To be described in separate files

compatible = "intel,abb"
compatible = "intel,adc"
compatible = "intel,adc_sensors"
compatible = "intel,ag620_swfgh"
compatible = "intel,agold620,on-button"
compatible = "intel,ag6x0_bat_hal"
compatible = "rockchip,rk818";
compatible = "intel,bq2429x_charger"
compatible = "intel,bq2429x_idi"
compatible = "intel,brownout"
compatible = "intel,display"
compatible = "intel,dma-pl08x,dma-req"
compatible = "intel,dma-pl08x,slave-chan"
compatible = "intel,fan54x_charger"
compatible = "intel,fan54015_charger"
compatible = "intel,fan54020_charger"
compatible = "intel,fan54x_idi"
compatible = "intel,fuel_gauge"
compatible = "intel,graphics"
compatible = "intel,agold,headset"
compatible = "intel,headset"
compatible = "intel,idi,peripheral"
compatible = "intel,idiabb"
compatible = "intel,idiafe"
compatible = "intel,idibtauif"
compatible = "intel,idibtif"
compatible = "intel,idierror"
compatible = "intel,idifmr"
compatible = "intel,idignss"
compatible = "intel,idii2c"
compatible = "intel,idimeas"
compatible = "intel,idiwlan"
compatible = "intel,ion"
compatible = "intel,lcd"
compatible = "intel,ldo"
compatible = "intel,agold620-led"
compatible = "intel,lnp,bt-fmr"
compatible = "intel,bt-fmr"
compatible = "intel,fm-radio"
compatible = "intel,lvds"
compatible = "intel,meas_thermal"
compatible = "intel,ov8825"
compatible = "intel,ov9740"
compatible = "intel,pmic"
compatible = "intel,pmic-led"
compatible = "intel,pmic_bat"
compatible = "intel,pmic_afe"
compatible = "intel,pmic,on-button"
compatible = "intel,meas_pmic"
compatible = "intel,pmic_usb_det"
compatible = "intel,bq24261"
compatible = "intel,pmicper"
compatible = "intel,pmu"
compatible = "intel,rtc"
compatible = "intel,screen"
compatible = "intel,scuabb"
compatible = "intel,spcu-thermal"
compatible = "intel,vibra"
compatible = "intel,vmodem"
compatible = "intel,xgold"
compatible = "intel,xgold,bitfield"
compatible = "intel,xgold-mipi_dsi"
compatible = "intel,xgold,noc,filter,routeid"
compatible = "intel,xgold,noc,filter,security"
compatible = "intel,xgold,register"
compatible = "intel,xgold-cpufreq"
compatible = "intel,xgold-regulators"
compatible = "intel,xgold-req"
compatible = "intel,xgold-snd-asoc"
compatible = "intel,xgold-snd-dsp"
compatible = "intel,xgold-snd-pcm"
compatible = "intel,xgold-snd-speech"
compatible = "intel,xgold-snd-voice"
compatible = "intel,xgold_abb"
compatible = "intel,xgold_vmm_pmic"
compatible = "intel,sofia,idle-state"
compatible = "intel,regulator-device-pm"
compatible = "rockchip,ion"
compatible = "rockchip,ion-heap"

* List of compatibles used by IMC and defined as non-intel compatibles
To be described or renamed or cleaned

compatible = "himax,hm2051-v4l2-i2c-subdev"
compatible = "himax,8528d"

compatible = "omnivision,ov5670-v4l2-i2c-subdev"
compatible = "omnivision,ov8825-v4l2-i2c-subdev"
compatible = "omnivision,ov9740-v4l2-i2c-subdev"
compatible = "omnivision,ov9760-v4l2-i2c-subdev"
compatible = "omnivision,ov13850-v4l2-i2c-subdev"
compatible = "goodix,Goodix-TS"
compatible = "focaltech,ft5x06"
compatible = "focaltech,ft3x27"
compatible = "st,l3gd20_gyr"
compatible = "st,lsm303dlhc_acc"
compatible = "st,lsm303dlhc_mag"
compatible = "st,lsm303c_acc"
compatible = "st,lsm303c_mag"
compatible = "avago,apds990x"
compatible = "inv,mpu6050"
compatible = "nanosilicon,nanosilicon-lvds"
compatible = "liteon,ltr559";
```

## Documentation/devicetree/bindings/intel/irq.txt
```
* IMC IRQ

** IMC Linux is relying on IRQ domains for interrupt cascading
Depending on the plaform the following domain could be used

*** With VMM
compatible = "intel,sofia-hirq"
compatible = "intel,sofia-main-hirq"

*** With ABB (AGOLD)
compatible = "intel,xgold_abb_irq_wake"
compatible = "intel,xgold_pmu"

*** With External Interrupt
compatible = "intel,xgold_eint"


** For wake-up capability from interrupt, following compatible is used:
compatible = "intel,xgold_irq_wake"
```

## Documentation/devicetree/bindings/intel/prh.txt
```
* IMC PRH

IMC Linux is relying on a vpower interface to enable clocks and regulators.
For each IMC SoC a pm.dtsi contains pm classes and pm users description:

** pm_class:
Following compatible must be used: "intel,xgold_pm_class";
Required properties:
	intel,name: class name
	intel,state-names: pm state names
	intel,states: pm state id
Optional properties:
	intel,sync: sync words (platform dependent)

Example:
generic_pm_class:generic_pm_class {
	compatible = "intel,xgold_pm_class";
	intel,name = "generic_class";
	intel,states-names =
		"disable",
		"enable";
	intel,states = <
		PRH_PER_TYPE_GENERIC PRH_PER_GENERIC_DISABLE
		PRH_PER_TYPE_GENERIC PRH_PER_GENERIC_ENABLE >;
};

** pm_user
Following compatible must be used: "intel,xgold_pm_user";

Required properties:
	intel,name: user name
	intel,user-i: user id
	intel,per-id = peripheral id
	intel,class = class binding

Example:
ext_gyroscope_pm_user:ext_gyroscope_pm_user {
	compatible = "intel,xgold_pm_user";
	intel,name = "gyroscope";
	intel,user-id = <PRH_USER_GYROSCOPE>;
	intel,per-id = <PRH_PER_EXT_GYROSCOPE>;
	intel,class = <&generic_pm_class>;
};

** core_pm (optional)
Following compatible must be used: "intel,vpower";

Required properties:
	intel,prh_mode: async or sync

Example:
core_pm:core_pm {
	compatible = "intel,vpower";
	intel,prh_mode = "async";

	#address-cells = < 0 >;
	interrupts = < 0 >;
	interrupt-parent = <&core_pm>;
	#interrupt-cells = < 1 >;
	interrupt-map = < 0 &hirq HIRQ_PMIC_PRH_SIGNALING IRQ_TYPE_DEFAULT>;
	interrupt-names = "notification";
};
```

## Documentation/devicetree/bindings/intel/soc.txt
```
* IMC SOC

Each IMC SoC is described in a soc.dtsi file.
Following compatibles are used to describe the SoC HW.
To be documented.

compatible = "intel,soc"
compatible = "intel,sofia"
compatible = "intel,sofia-vpic"
compatible = "intel,sofia_3g_soc-svb"
compatible = "intel,sofia_lte_soc-svb"
compatible = "intel,sofia_3gr_soc-svb"
compatible = "intel,capcom"
compatible = "intel,capcom1"
compatible = "intel,cgu"
compatible = "intel,cif_isp20"
compatible = "intel,dcc"
compatible = "intel,gpio"
compatible = "intel,i2c"
compatible = "intel,keypad"
compatible = "intel,mali"
compatible = "intel,oct"
compatible = "intel,oct2"
compatible = "intel,phy-usb3"
compatible = "intel,pl08x"
compatible = "intel,scu"
compatible = "intel,sdhci"
compatible = "intel,stm"
compatible = "intel,usb"
compatible = "intel,usb2phy"
compatible = "intel,usif-serial"
compatible = "intel,vpu_decoder"
compatible = "intel,vpu_encoder"
compatible = "rockchip,vpu_service"
compatible = "rockchip,hevc_service"
compatible = "intel,xgold-reset"
compatible = "intel,ahbper"
compatible = "intel,idiper"
compatible = "intel,l1noc"
compatible = "intel,l2noc"
compatible = "intel,modemnoc"
compatible = "intel,uspcnoc"
compatible = "intel,noc"
compatible = "intel,tadi"
compatible = "intel,xgold-ia"
compatible = "intel,pmic_i2c"

compatible = "VTL-TS"
compatible = "rockchip,rk3288-pwm"
```

## Documentation/devicetree/bindings/video/rockchip.txt
```
compatible = "rockchip,fb"
compatible = "rockchip,screen"
compatible = "rockchip,vop"
compatible = "rockchip,rga"
compatible = "rockchip,vop_mmu"
compatible = "rockchip,vpu_combo"
compatible = "rockchip,vpu_mmu"
compatible = "rockchip,hevc_mmu"
```
