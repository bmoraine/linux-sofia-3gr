## drivers/fm/fmdev/Kconfig
```kconfig
#
# Copyright (C) 2013 Intel Mobile Communications GmbH
#
# This program is free software; you can redistribute it and/or modify it
# under the terms and conditions of the GNU General Public License,
# version 2, as published by the Free Software Foundation.
#
# This program is distributed in the hope it will be useful, but WITHOUT
# ANY WARRANTY; without even the implied warranty of MERCHANTABILITY or
# FITNESS FOR A PARTICULAR PURPOSE. See the GNU General Public License for
# more details.
#
# You should have received a copy of the GNU General Public License along with
# this program; if not, write to the Free Software Foundation, Inc.,
# 51 Franklin St - Fifth Floor, Boston, MA 02110-1301 USA.
#

#
# fmdev character device support
#

config FMDEV
  tristate "FM Character Device Support"
  depends on FM
  default y if FM
  help
    If you say yes to this option, support for the Frequency Manager (FM)
    Character Device will be included.
    If you say no to this option, support for the Frequency Manager (FM)
    Character Device will not be included.

config FMDEV_VERBOSE
  bool "FM Character Device Verbose Debugging"
  depends on FMDEV
  default n if FMDEV
  help
    If you say yes to this option, verbose debug tracing will be enabled
    within the FM Character Device driver (fmdev).
    If you say no to this option, verbose debug tracing will be disabled within
    the FM Character Device driver (fmdev).
```

## drivers/fm/iui_fm/Kconfig
```kconfig
#
# Copyright (C) 2013 Intel Mobile Communications GmbH
#
# This program is free software; you can redistribute it and/or modify it
# under the terms and conditions of the GNU General Public License,
# version 2, as published by the Free Software Foundation.
#
# This program is distributed in the hope it will be useful, but WITHOUT
# ANY WARRANTY; without even the implied warranty of MERCHANTABILITY or
# FITNESS FOR A PARTICULAR PURPOSE. See the GNU General Public License for
# more details.
#
# You should have received a copy of the GNU General Public License along with
# this program; if not, write to the Free Software Foundation, Inc.,
# 51 Franklin St - Fifth Floor, Boston, MA 02110-1301 USA.
#

#
# IUI FM Interface support
#

config IUI_FM
  tristate "IUI FM Support"
  depends on FMDEV
  default y if FMDEV
  help
    If you say yes to this option, support for the IUI Frequency Manager
    (FM) Interface will be included.
    If you say no to this option, support for the IUI Frequency Manager
    (FM) Interface will not be included.

config IUI_FM_EMMC
  bool "EMMC Macro Support"
  depends on IUI_FM
  default n if IUI_FM
  help
    If you say yes to this option, support for the EMMC Frequency Macro
    will be included in the IUI Frequency Manager interface.
    If you say no to this option, support for the EMMC Frequency Macro
    will not be included in the IUI Frequency Manager interface.

config IUI_FM_CLASS_D
  bool "Class D Macro Support"
  depends on IUI_FM
  default n if IUI_FM
  help
    If you say yes to this option, support for the Class D Frequency Macro
    will be included in the IUI Frequency Manager interface.
    If you say no to this option, support for the Class D Frequency Macro
    will not be included in the IUI Frequency Manager interface.

config IUI_FM_PMU_CP
  bool "Power Management Unit Charge Pump (PMU_CP) Macro Support"
  depends on IUI_FM
  default n if IUI_FM
  help
    If you say yes to this option, support for the Power Management Unit
    Charge Pump (PMU_CP) Frequency Macro will be included in the IUI
    Frequency Manager interface.
    If you say no to this option, support for the Power Management Unit
    Charge Pump (PMU_CP) Frequency Macro will not be included in the IUI
    Frequency Manager interface.

config IUI_FM_MS_CP
  bool "Mixed Signal Charge Pump (MS_CP) Macro Support"
  depends on IUI_FM
  default y if IUI_FM
  help
    If you say yes to this option, support for the Mixed Signal Charge Pump
    (MS_CP) Frequency Macro will be included in the IUI Frequency Manager
    interface.
    If you say no to this option, support for the Mixed Signal Charge Pump
    (MS_CP) Frequency Macro will not be included in the IUI Frequency Manager
    interface.

config IUI_FM_DCDC
  bool "DC to DC Converter (DCDC) Macro Support"
  depends on IUI_FM
  default n if IUI_FM
  help
    If you say yes to this option, support for the DC to DC converter
    (DCDC) Frequency Macro will be included in the IUI Frequency Manager
    interface.
    If you say no to this option, support for the DC to DC converter
    (DCDC) Frequency Macro will not be included in the IUI Frequency Manager
    interface.

config IUI_FM_IDI
  bool "Inter-Die Interface (IDI) Macro Support"
  depends on IUI_FM
  default y if IUI_FM
  help
    If you say yes to this option, support for the Inter-Die Interface
    (IDI) Frequency Macro will be included in the IUI Frequency Manager
    interface.
    If you say no to this option, support for the Inter-Die Interface
    (IDI) Frequency Macro will not be included in the IUI Frequency Manager
    interface.

config IUI_FM_WLAN
  bool "Wireless LAN (WLAN) Macro Support"
  depends on IUI_FM
  default y if IUI_FM
  help
    If you say yes to this option, support for the Wireless LAN (WLAN)
    Frequency Macro will be included in the IUI Frequency Manager
    interface.
    If you say no to this option, support for the Wireless LAN (WLAN)
    Frequency Macro will not be included in the IUI Frequency Manager
    interface.

config IUI_FM_FMR
  bool "FM Radio (FMR) Macro Support"
  depends on IUI_FM
  default y if IUI_FM
  help
    If you say yes to this option, support for the FM Radio (FMR) Frequency
    Macro will be included in the IUI Frequency Manager interface.
    If you say no to this option, support for the FM Radio (FMR) Frequency
    Macro will not be included in the IUI Frequency Manager interface.

config IUI_FM_BT
  bool "Bluetooth (BT) Macro Support"
  depends on IUI_FM
  default n if IUI_FM
  help
    If you say yes to this option, support for the Bluetooth (BT) Frequency
    Macro will be included in the IUI Frequency Manager interface.
    If you say no to this option, support for the Bluetooth (BT) Frequency
    Macro will no be included in the IUI Frequency Manager interface

config IUI_FM_GNSS
  bool "Global Navigation Satellite System (GNSS) Macro Support"
  depends on IUI_FM
  default n if IUI_FM
  help
    If you say yes to this option, support for the Global Navigation
    Satellite System (GNSS) Frequency Macro will be included in the IUI
    Frequency Manager interface.
    If you say no to this option, support for the Global Navigation
    Satellite System (GNSS) Frequency Macro will not be included in the IUI
    Frequency Manager interface.
```

## drivers/gpu/arm/umplock/Kconfig
```kconfig
config MALI_UMPLOCK
	tristate "Mali-UMPLOCK support"
	depends on ARM || X86_INTEL_XGOLD
	---help---
	  This enables support for the ARM umplock function.
```

## drivers/idi/Kconfig
```kconfig
#
# Copyright (C) 2012-2013 Intel Mobile Communications GmbH
#
# This software is licensed under the terms of the GNU General Public
# License version 2, as published by the Free Software Foundation, and
# may be copied, distributed, and modified under those terms.
#
# This program is distributed in the hope that it will be useful,
# but WITHOUT ANY WARRANTY; without even the implied warranty of
# MERCHANTABILITY or FITNESS FOR A PARTICULAR PURPOSE.  See the
# GNU General Public License for more details.
#

#
# IDI subsystem configuration
#
menuconfig IDI
	tristate "IDI support"
	depends on HAS_IOMEM
	select RT_MUTEXES
	---help---
	 IDI (Inter-die Interface) is a MIPI HSI module with 16 channels
	 that has several functions layered on top of it.
	 Special flow control mechanisms are implemented on some channels
	 requiring DMA interation.
	 Some specific features are added as well for streaming channels
	 to ensure throughput with predictable latencies.

if IDI

config IDI_DEBUG
	bool "IDI event debugging"
	help
	 This option is compiling the IDI subsystem with DEBUG activated.
	 A lot of prints will come from the drivers,
	 tracking the routines sequences calls, etc...
	 If not sure of what you are doing, say n.

config IDI_OF
	bool "IDI OF support"
	select OF_ADDRESS if OF
	help
	 Say yes if you need helpers
	 for IDI devices registration from device tree.
	 This provides automatic IDI peripheral driver registration
	 among others things.

source drivers/idi/controllers/Kconfig
source drivers/idi/clients/Kconfig
source drivers/idi/peripherals/Kconfig
source drivers/idi/test/Kconfig

endif # IDI
```

## drivers/idi/clients/Kconfig
```kconfig
#
# Copyright (C) 2012-2013 Intel Mobile Communications GmbH
#
# This software is licensed under the terms of the GNU General Public
# License version 2, as published by the Free Software Foundation, and
# may be copied, distributed, and modified under those terms.
#
# This program is distributed in the hope that it will be useful,
# but WITHOUT ANY WARRANTY; without even the implied warranty of
# MERCHANTABILITY or FITNESS FOR A PARTICULAR PURPOSE.  See the
# GNU General Public License for more details.
#

#
# IDI client support
#

config IDI_AG6X0
       tristate "IDI AGold 6x0 support"
       help
	This option enables the support for the AGold 6x0 devices.
	This can be AG610 with 2G/3G RF, BT, PMU and FMR devices,
	or AG620 with 2G/3G RF, BT, PMU, WIFI, GNSS and FMR devices.
	This will register a IDI client device within the IDI subsystem.
```

## drivers/idi/controllers/Kconfig
```kconfig
#
# Copyright (C) 2012-2013 Intel Mobile Communications GmbH
#
# This software is licensed under the terms of the GNU General Public
# License version 2, as published by the Free Software Foundation, and
# may be copied, distributed, and modified under those terms.
#
# This program is distributed in the hope that it will be useful,
# but WITHOUT ANY WARRANTY; without even the implied warranty of
# MERCHANTABILITY or FITNESS FOR A PARTICULAR PURPOSE.  See the
# GNU General Public License for more details.
#

#
# IDI Controller support
#

config IDI_IMC
       tristate "IDI IMC controller"
       help
        If you say yes to this option, support will be include for the IMC IDI
        controller.

if IDI_IMC
choice
	prompt "IDI bus parent"

config IDI_IMC_PCI
	bool "PCI bus"
	depends on PCI
    help
	Select this option to be registered as a PCI driver

config IDI_IMC_PLATFORM
	bool "Platform bus"
    help
	Select this option to be registered as a platform driver

endchoice
endif
```

## drivers/idi/peripherals/Kconfig
```kconfig
#
# IDI Peripheral support
#
if IDI_AG6X0
config IDI_IMC_BTIF
	tristate "IDI IMC BlueTooth InterFace peripheral driver support"
	select SERIAL_CORE
	help
	 Say yes if you want the support of the bluetooth macro through a BTIF.
	 This driver is valid for BT IP macro found in
	 AG610 or AG620 devices.

endif
```

## drivers/idi/test/Kconfig
```kconfig
#
# Copyright (C) 2012-2013 Intel Mobile Communications GmbH
#
# This software is licensed under the terms of the GNU General Public
# License version 2, as published by the Free Software Foundation, and
# may be copied, distributed, and modified under those terms.
#
# This program is distributed in the hope that it will be useful,
# but WITHOUT ANY WARRANTY; without even the implied warranty of
# MERCHANTABILITY or FITNESS FOR A PARTICULAR PURPOSE.  See the
# GNU General Public License for more details.
#

#
# IDI Test suite support
#
if IDI

config IDI_TEST_SUITE
        bool "IDI Test suite"
        depends on !IDI_IMC_FMR
        help
         Say yes if you want to build the IDI Test Suite

endif
```

## drivers/iio/proximity/Kconfig
```kconfig
#
# Proximity sensors
#

menu "Proximity sensors"

config SX9500
	tristate "SX9500 Semtech proximity sensor"
	select IIO_BUFFER
	select IIO_TRIGGERED_BUFFER
	select REGMAP_I2C
	depends on I2C
	help
	  Say Y here to build a driver for Semtech's SX9500 capacitive
	  proximity/button sensor.

	  To compile this driver as a module, choose M here: the
	  module will be called sx9500.

endmenu
```

## drivers/input/touchscreen/ft3x27/Kconfig
```kconfig
config TOUCHSCREEN_FT3X27
		tristate "FocalTech ft3x27 touchscreen"
		depends on I2C
		default n
		help
		  Say Y here if you have the FocalTech ft3x27 touchscreen.
		  This driver uses standard I2C protocol. Initilization is
		  done with device tree.
		  If unsure, say N.
```

## drivers/input/touchscreen/gt910/Kconfig
```kconfig
config TOUCHSCREEN_GT910
	tristate "goodix gt910 touchscreen"
	depends on I2C
	default n
	help
	  Say Y here if you have a goodix gt910 touchscreen.

config TOUCHSCREEN_GT915
	tristate "goodix gt915 touchscreen"
	depends on I2C
	default n
	help
	  Say Y here if you have a goodix gt915 touchscreen.
```

## drivers/input/touchscreen/vtl_ts/Kconfig
```kconfig
config TOUCHSCREEN_VTL_CT36X
	tristate "VTL CT36x touchscreen"
	depends on I2C
	default n
	help
	  Say Y here if you have a VTL CT36x touchscreen.
```
