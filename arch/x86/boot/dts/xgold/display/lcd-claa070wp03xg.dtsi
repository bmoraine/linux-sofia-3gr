/*
 * sofia. lcd-claa070wp03xg
 * definition at "include/dt-bindings/sofiafb/sofia_fb.h"
 */

claa070wp03xg {
	compatible = "intel,display";
	display-timings {
		native-mode = <&claa070wp03xg_timing>;
		claa070wp03xg_timing: claa070wp03xg_timing {
			screen-type = <SCREEN_LVDS>;
			lvds-format = <LVDS_8BIT_2>;
			out-face    = <OUT_D888_P666>;
			color-mode = <COLOR_RGB>;
			clock-frequency = <67000000>;
			hactive = <800>;
			vactive = <1280>;
			hback-porch = <24>;
			hfront-porch = <24>;
			vback-porch = <4>;
			vfront-porch = <2>;
			hsync-len = <16>;
			vsync-len = <2>;
			hsync-active = <0>;
			vsync-active = <0>;
			de-active = <0>;
			pixelclk-active = <0>;
			swap-rb = <0>;
			swap-rg = <0>;
			swap-gb = <0>;
		};
	};
};