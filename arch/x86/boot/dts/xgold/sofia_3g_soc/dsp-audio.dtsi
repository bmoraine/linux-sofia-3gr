pcm_music:pcm_music {
	compatible = "intel,xgold-snd-pcm";
	intel,dsp = < &dsp_audio >;
	intel,pcm,dma_en;
	intel,pcm,bt_init_en;
	intel,pcm,rec_dma_en;
};

pcm_voice:pcm_voice {
	compatible = "intel,xgold-snd-voice";
	intel,dsp = < &dsp_audio >;
};

speech_probe:speech_probe {
	compatible = "intel,xgold-snd-speech";
	intel,dsp = < &dsp_audio >;
};

dsp_audio:dsp_audio {
	compatible = "intel,xgold-snd-dsp";

	intel,dsp,id = "XG642";
	reg = <0xE3600000 0x4000>, <0xE3604000 0x200000>;
	reg-names = "shm-regs", "shm-mem";
	clocks = <&clk_dsp_aud>, <&int_dsp_aud_r>, <&ABB_MUX_MS>, <&clk_ahb_per3>, <&ABB_clk_chp>, <&clk_x2_aud>, <&clk_dsp_aud_26m>;
	clock-names = "clk_dsp";

	pm,class-name = "dsp_audio_class";
	pm,user-name = "dsp_audio";
	pm,state-D0 = "enable";
	pm,state-D3 = "disable";
	pm,state-D0i3 = "suspend";

	dsp-supply = <&vdd_aud>;
	interrupts = < AUDIODSP_INT1 IRQ_TYPE_DEFAULT >, < AUDIODSP_INT2 IRQ_TYPE_DEFAULT >, < AUDIODSP_INT3 IRQ_TYPE_DEFAULT >;
	interrupt-names = "dsp_playback", "dsp_record", "dsp_hw_probe";
	dmas = < &dma8ch 4
		 &dma8ch 5
		 &dma8ch 6 >;
	dma-names = "play1", "play2", "record";

	intel,uccf = <0x20C 0x210 0x214>;
	intel,mcu2dsp = <0x208>;
	intel,dsp-imsc = < 0xC 1 2 0 >;
	intel,dsp-icr = < 0x18 1 2 0 >;
	intel,dsp-mis = < 0x14 1 2 0 >;
	intel,dsp-cf = < 3 4 0x1F>; /* play1, record, tone */
	intel,dsp-sm-buf-speech-buffer_1 = < 1076 >;
	intel,dsp-sm-buf-speech-buffer_2 = < 2052 >;
	intel,dsp-sm-buf-speech-buffer_3 = < 2372 >;
	intel,dsp-sm-buf-speech-buffer_4 = < 2692 >;
	intel,dsp-sm-buf-speech-buffer_5 = < 3012 >;
	intel,dsp-sm-buf-speech-buffer_6 = < 3496 >;
	intel,dsp-sm-buf_sm_hw_probe_a_offset = < 1076 >;
	intel,dsp-sm-buf_sm_hw_probe_b_offset = < 1556 >;
	resets = <&dbb_rst2 13>;
	reset-names = "dsp";
	intel,dsp-pcm-offset = < 2051 3816 >;
	intel,dsp-clc = < 4 >;
	intel,dsp-sm-aud-buf-dl-offset = < 594 >;
	intel,dsp-sm-aud-buf-dl2-offset = < 1556 >;
	intel,dsp-buf-size-ul-offset = < 1074 >;
	intel,dsp-sm-aud-buf-ul-offset = < 114 >;
	intel,dsp-rstmods = < 0x204 >;
	/* Fix me use DAPM for firmware path setup */
	intel,dsp-cmd-pcm_gain = /bits/ 16 <0x21 0x32 0x0 0x0 0x0 0x0 0x0 0x0 0x0 0x0 0x0 0x0 0x0 0x0 0x0 0x0 0x0 0x0 0x0 0x0 0x0 0x0 0x0 0x0 0x0 0x0 0x0>;
	intel,dsp-cmd-gain_const = /bits/ 16 < 0x24 0x2 0x32 >;
	intel,dsp-cmd-swm_afeout =/bits/ 16 <0x1B 0x1A 0x1 0x0 0x0 0x0 0x0 0x0 0x1 0x0 0x0 0x0 0x0 0x0 0x0>;
	intel,dsp-cmd-swm_pcmout = /bits/ 16 <0x20 0x1A 0x1 0x1 0x0 0x0 0x0 0x0 0x0 0x0 0x0 0x0 0x0 0x0 0x0>;
	intel,dsp-cmd-mix_matrix = /bits/ 16 <0x4D 0xA 0x0 0x7fff 0x0 0x0 0x7fff>;
	intel,dsp-cmd-pcm_iir_left = /bits/ 16 <0x27 0x2E 0xA 0x0 0x0 0x0 0x0 0x0 0x0 0x0 0x0 0x0 0x0 0x0 0x0 0x0 0x0 0x0 0x0 0x0 0x0 0x0 0x0 0x0 0x0>;
	intel,dsp-cmd-pcm_iir_right = /bits/ 16 <0x27 0x2E 0xB 0x0 0x0 0x0 0x0 0x0 0x0 0x0 0x0 0x0 0x0 0x0 0x0 0x0 0x0 0x0 0x0 0x0 0x0 0x0 0x0 0x0 0x0>;
	intel,dsp-cmd-afe_tx_iir = /bits/ 16 <0x27 0x2E 0x0 0x0 0x0 0x0 0x0 0x0 0x0 0x0 0x0 0x0 0x0 0x0 0x0 0x0 0x0 0x0 0x0 0x0 0x0 0x0 0x0 0x0 0x0>;

       /* Usecases built into XGold audio driver*/
       /* Alsa control with the same name will be automatically created for each entry in the below list */
       intel,XGold-usecase = "PCM Audio Playback","PCM Audio Record";

       /* Use case Parameter. DSP command list for above use case. Property name should end with integer number */
       /* integer number should be equal to the index of the use case in the above use case list */
       /* Each line is a DSP command payload with format <command_id payload_length_bytes payload_word_1 payload_word_2 ....>, */

       /* Parameters for "PCM Audio Playback" */
       intel,XGold-usecase-parameter-1 = /bits/ 16 <0x0002 0x0004 0x0001 0x0003 >, /* Start DSP Scheduler(VB_HW_AFE) */
		/* Configure Gain Module (VB_SET_GAIN) */
		/bits/ 16 <0x0021 0x0032 0xFF40 0xFFB0 0xFFB0 0xFF40 0xFF40 0xFF40 0xFF40 0xFF40 0x0000  0xFF40 0x0000 0x0000 0x0000 0xFF40 0xFF40 0xFF40 0x0000 0x0000 0xFF40 0xFF40 0x0000 0xFF40 0xFF40 0xFF40 0x0000>,
               /* Configure Ramping time for the Gain module (VB_SET_GAIN_TIMECONST) */
               /bits/ 16 <0x0024 0x0002 0x0019>,
               /* Configure Switch Mixing for AFE OUT (VB_SET_SWM_AFE_OUT) */
               /bits/ 16 <0x001B 0x001A 0x0001 0x0000 0x0000 0x0000 0x0000 0x0000 0x0001 0x0000 0x0000 0x0000 0x0000 0x0000 0x0000>;

	/* Parameters for "PCM Audio Record" */
	intel,XGold-usecase-parameter-2 = /bits/ 16 <0x0002 0x0004 0x0001 0x0003 >, /* Start DSP Scheduler(VB_HW_AFE) */
	/* Configure Switch Mixing for PCM OUT (VB_SET_SWM_PCM_OUT) */
	/bits/ 16 <0x0020 0x001A 0x0001 0x0001 0x0000 0x0000 0x0000 0x0000 0x0000 0x0000 0x0000 0x0000 0x0000 0x0000 0x0000>,
	/* Configure Ramping time for the Gain module (VB_SET_GAIN_TIMECONST) */
	/bits/ 16 <0x0024 0x0002 0x0019>,
	/* Configure Gain Module (VB_SET_GAIN) Scal_PCM_Out*/
	/bits/ 16 <0x0021 0x0032 0x0000 0xFFB0 0xFFB0 0xFF40 0xFF40 0xFF40 0xFF40 0xFF40 0x0000  0xFF40 0x0000 0x0000 0x0000 0xFF40 0xFF40 0xFF40 0x0000 0x0000 0xFF40 0xFF40 0x0000 0xFF40 0xFF40 0x0000 0x0000>;

	intel,dsp-fw = /bits/ 16 <
		/* X-GOLD632_AUDIO WA03 PATCH V3.1.2.0 generated on Fri Jul 17 13:49:54 2015 (local time) */
		/* Configuration management:  */
		0x0000 0x0006 0x0002 0x4180 0x253a 0x0000 0x000e 0x0002
		0x4180 0x253a 0x0000 0x0016 0x0002 0x4180 0x23d3 0x0000
		0x0020 0x01fd 0x5e08 0x0001 0x5e09 0x008d 0x5e0a 0x0000
		0x4f90 0x5e0d 0x8c00 0x5e18 0x0301 0xd4bc 0xa502 0x0000
		0x5e18 0x0200 0xd4bc 0xa503 0x5e18 0x0001 0xd4bc 0xbea5
		0xd4bc 0xad02 0x5e1a 0x0dc0 0xd4bc 0x265c 0x5e1a 0x0654
		0xd4bc 0x265e 0x5e1a 0x068d 0xd4bc 0x2668 0x5e1a 0x0674
		0xd4bc 0x2660 0x5e1a 0x00b4 0xd4bc 0x2671 0x5e1a 0x00c1
		0xd4bc 0x2672 0x5e1a 0x03b5 0xd4bc 0x2679 0x5e1a 0x03b9
		0xd4bc 0x265b 0x5e1a 0x0565 0xd4bc 0x2694 0x5e1a 0x05b4
		0xd4bc 0x2692 0x5e1a 0x0bba 0xd4bc 0x2693 0x5e1a 0x0a93
		0xd4bc 0x2681 0x5e1a 0x08d1 0xd4bc 0x2683 0x5e1a 0x0b99
		0xd4bc 0x2684 0x5e1a 0x0a5b 0xd4bc 0x267e 0x41c0 0x26d4
		0x5e19 0x0000 0xd5bc 0x0007 0x5e19 0x0000 0xd5bc 0x0008
		0x5e19 0x0000 0xd5bc 0x0009 0x5e19 0x0001 0xd5bc 0x0006
		0x5e1a 0xffff 0xd4bc 0xbe02 0xd4bc 0xbe06 0xd4bc 0xbe0a
		0xd4bc 0xbe0e 0x5e1a 0xc107 0xd4bc 0xbe01 0x5e1a 0x0000
		0xd4bc 0xbe05 0x5e1a 0x0000 0xd4bc 0xbe09 0x81ea 0x0040
		0x81e8 0x000e 0x2101 0xd4bc 0xbe92 0x0000 0x0000 0x0000
		0x0000 0x0000 0x0000 0x0000 0x43c0 0x2101 0xd4bc 0xbea1
		0x0000 0x0000 0x0000 0x4380 0x4180 0x00a3 0xcd08 0x4181
		0x00cb 0xcd01 0x4181 0x01e5 0xcd00 0x4181 0x024c 0xcd05
		0x4181 0x027e 0x4580 0xcd22 0x4181 0x0123 0xcd0a 0x4181
		0x0159 0xcd15 0x4181 0x02c5 0x4580 0x5e78 0x1f08 0xcc02
		0x6763 0x86c0 0x00d5 0x0000 0x599a 0x0000 0x0000 0x5020
		0x5070 0x53d0 0xe187 0x0002 0xe387 0x0001 0x4180 0x0122
		0xf087 0x4181 0x0122 0xe387 0x0002 0x048f 0x1f48 0x382e
		0x1f48 0x382f 0x1f48 0x3839 0x1f48 0x382d 0x5e06 0x0049
		0x1f48 0xdc84 0x41c0 0x5031 0x6760 0x5e00 0xcd26 0x0c0f
		0x1b48 0x5e00 0xe6a1 0x0c07 0x1b48 0x5e00 0xcd36 0x0c0f
		0x1b48 0x5e00 0xe6a9 0x0c07 0x1b48 0x5e06 0x1f45 0x5e01
		0x1f50 0x682f 0x2f08 0x5e04 0xcd9d 0x41c0 0x5fa8 0xed39
		0x0001 0x50b2 0x048d 0x0000 0xe187 0x0001 0x50d0 0xd4b8
		0x7f99 0x67e0 0xd4bc 0x7f99 0x5075 0x048f 0x41c0 0x5061
		0x048d 0x2303 0x41c0 0x2327 0x4580 0x5e78 0x1f68 0x5edb
		0x5e03 0x09e5 0x1f48 0x5e9a 0x67e0 0x58fa 0x080e 0x5b0b
		0x86a3 0x587a 0x58da 0x1c23 0xd2d0 0x82a1 0xcc03 0x4581
		0x5e05 0x08b8 0x5b0b 0x86a5 0x58ba 0xcd00 0x4182 0x3064
		0x58da 0x5e18 0xffff 0x1b4b 0x6760 0x0c0c 0x1b4b 0x1b45
		0xd98c 0x5091 0x585b 0x0000 0x1b42 0xd5b8 0x09e4 0x5031
		0x77e0 0xd5bc 0x09e4 0xd4b8 0x09e4 0x4182 0x30bf 0xe386
		0x0006 0x4180 0x30bf 0x5e78 0x1c20 0x87e1 0xa500 0x5e18
		0x0016 0x1b49 0x5e18 0x002f 0x1b49 0x5e18 0x1600 0x1b49
		0x5e18 0x0031 0x1b49 0x5e18 0x1300 0x1b49 0x5e18 0x0025
		0x1b49 0x5e18 0x2500 0x1b49 0x5e18 0x006f 0x1b49 0x5e18
		0x1100 0x1b49 0x5e18 0x0068 0x1b49 0x5e18 0x1000 0x1b49
		0x5e18 0x0071 0x1b49 0x5e18 0x1500 0x1b49 0x5e18 0x0046
		0x1b49 0x5e18 0x1400 0x1b49 0x5e18 0x0026 0x1b49 0x5e18
		0x1100 0x1b49 0x5e18 0x006b 0x1b49 0x5e18 0x1000 0x1b49
		0x5e18 0x0027 0x1b49 0x5e18 0x1000 0x1b49 0x5e18 0x0030
		0x1b49 0x5e18 0x1200 0x1b49 0x5e18 0x0037 0x1b49 0x5e18
		0x1200 0x1b49 0x5e18 0x005e 0x1b49 0x5e18 0x1100 0x1b49
		0x5e18 0x005f 0x1b49 0x5e18 0x1000 0x1b49 0x5e18 0x0023
		0x1b49 0x5e18 0x1100 0x1b49 0x5e18 0x004e 0x1b49 0x5e18
		0x2500 0x1b49 0x5e18 0x0048 0x1b49 0x5e18 0x1300 0x1b49
		0x5e18 0x0050 0x1b49 0x5e18 0x1200 0x1b49 0x5e18 0x007a
		0x1b49 0x5e18 0x1000 0x1b49 0x5e18 0x0077 0x1b49 0x5e18
		0x1000 0x1b49 0x5e18 0x0079 0x1b49 0x5e18 0x1000 0x1b49
		0x5e18 0x0034 0x1b49 0x5e18 0x1000 0x1b49 0x4580 0x5e78
		0x1f08 0xcc02 0x6763 0x86c0 0x01ef 0x0000 0x599a 0x0000
		0x0000 0x5030 0x5080 0x4180 0x023e 0xe187 0x0020 0xe387
		0x0010 0x4180 0x024b 0xf487 0x4181 0x024b 0xe387 0x0020
		0x048f 0x1f48 0x383b 0x1f48 0x383c 0x1f48 0x3846 0x1f48
		0x383a 0x5840 0x41c0 0x5235 0x5e06 0x004f 0x1f4a 0xdc84
		0x1f4a 0xdc82 0x6760 0x5e00 0xcd46 0x0c0f 0x1b48 0x5e00
		0xe6b1 0x0c07 0x1b48 0x5e00 0xcd56 0x0c0f 0x1b48 0x0000
		0x021d 0x01fd 0x5e00 0xe6b9 0x0c07 0x1b48 0x5e06 0x1f96
		0x5e01 0x1fa1 0x683c 0x2f08 0x5e04 0xcd9d 0x41c0 0x5fa8
		0xed46 0x0001 0x5162 0x048d 0x0000 0xe187 0x0010 0xed3a
		0x0002 0x4182 0x024b 0x6760 0xd4bc 0x8295 0x67d0 0xd4bc
		0x8294 0x4180 0x024b 0xd4b8 0x81bc 0x67e0 0xd4bc 0x81bc
		0x5075 0x048f 0x41c0 0x5265 0x048d 0x2304 0x41c0 0x2327
		0x4580 0x5e78 0x1f08 0x8dfa 0x0004 0x67e1 0x1f28 0x9fc2
		0x80b9 0xc207 0x86c0 0x025b 0x0000 0x599a 0x0000 0x0000
		0x5070 0x50c0 0x5110 0x5160 0x5060 0x50b0 0x5100 0x5150
		0x5e01 0xd952 0x5140 0x5e01 0xd95c 0x5110 0x5e01 0xd966
		0x50e0 0x5e01 0xd970 0x50b0 0x5e01 0x81bd 0x5080 0x5e01
		0x81c7 0x5050 0x5e01 0x81d1 0x5020 0x5e01 0x81db 0x370a
		0x41c0 0x294e 0x4580 0x1f00 0x4582 0x5e78 0x3300 0x3711
		0x41c0 0x2953 0x4582 0x1f08 0x1f48 0xcc00 0x5042 0xe384
		0x0002 0x4180 0x02c4 0xcc01 0x5161 0xf184 0x5141 0x6760
		0x5e01 0xcc46 0x0c0f 0x1b49 0x6760 0x5e01 0xf6cb 0x0c0f
		0x1b49 0x5e01 0xe631 0x0c07 0x1b49 0x5e01 0xf6db 0x0c07
		0x1b49 0xe184 0x0002 0x5e02 0x006f 0x5e01 0x006d 0x5e04
		0x827b 0x1f08 0x6700 0x58fa 0x0089 0x008c 0x1b51 0x1b54
		0x8ec0 0x0004 0x6790 0x86c0 0x90f8 0x587a 0x0000 0x1f43
		0x1b41 0x1b44 0x0805 0x5b0b 0x4586 0x1f28 0x1b6a 0x67e0
		0x57c2 0x4580 0x5e78 0x3300 0x3704 0x41c0 0x2953 0x4582
		0x5860 0x0088 0x3300 0x3701 0x41c0 0x2953 0x4582 0x5803
		0x0000 0x1f08 0x585a 0x8dfa 0x0004 0x67e1 0x1f28 0x9fc2
		0x80b9 0x1f28 0x4181 0x0397 0x82c0 0x0007 0x6720 0x86c0
		0x02e8 0x0000 0x599a 0x0000 0x0000 0x4180 0x02fc 0x4180
		0x0306 0x4180 0x030c 0x4180 0x0348 0x4180 0x02f8 0x4180
		0x0302 0x4180 0x0313 0x4180 0x0357 0x5e01 0x7080 0x4180
		0x0393 0xe1c9 0x2000 0x5e01 0x7071 0x4180 0x0393 0x5e01
		0x709e 0x4180 0x0393 0xe1cb 0x0080 0x5e01 0x708f 0x4180
		0x0393 0xf485 0x4181 0x03ad 0x5e01 0x70ad 0x4180 0x0393
		0xf485 0x4181 0x03ad 0xe185 0x0010 0x41c0 0x3456 0x5e01
		0x70bc 0x370f 0x41c0 0x294e 0x5e00 0x70ad 0x5e06 0x701c
		0x41c0 0x5e7a 0x5e00 0x70ad 0x87e0 0x000e 0x5e06 0x7006
		0x1f00 0xdc80 0x5062 0x5e00 0x70bc 0x5e06 0x7046 0x41c0
		0x5e7a 0x5e06 0x7006 0x5e01 0xd97a 0x41c0 0x9aa8 0x5e06
		0x701c 0x41c0 0x5ea9 0x5e06 0x7006 0xd880 0x5042 0x5e06
		0x7046 0x41c0 0x5ea9 0x4180 0x03b4 0x8de2 0x0004 0x5051
		0xf887 0x4181 0x03b4 0x4180 0x0353 0xf987 0x4181 0x03b4
		0x5e01 0x81e5 0x4180 0x0393 0x8de2 0x0004 0x5071 0xf887
		0x4181 0x03b4 0xe187 0x0100 0x4180 0x0366 0xf987 0x4181
		0x03b4 0xe187 0x0200 0x5e01 0x81f4 0x370f 0x41c0 0x294e
		0x5e00 0x81e5 0x5e06 0x8219 0x41c0 0x5e7a 0x5e00 0x81e5
		0x87e0 0x000e 0x5e06 0x8203 0x1f00 0xdc80 0x5062 0x5e00
		0x81f4 0x5e06 0x8243 0x41c0 0x5e7a 0x5e06 0x8203 0x5e01
		0xf6e3 0x41c0 0x04b5 0x5e06 0x8219 0x41c0 0x5ea9 0x5e06
		0x8203 0xd880 0x5042 0x5e06 0x8243 0x41c0 0x5ea9 0x5210
		0x370f 0x41c0 0x294e 0x51d0 0x901a 0x5102 0x911a 0x5051
		0xe1cb 0x0040 0xe3cb 0x0080 0x5140 0x8df3 0x0004 0x5031
		0xe387 0x0100 0x50e0 0xe387 0x0200 0x50b0 0x911a 0x5052
		0xe385 0x0010 0x41c0 0x3456 0x5040 0xe1c9 0x1000 0xe3c9
		0x2000 0x4580 0xcd00 0x4181 0x03de 0x4580 0xcd05 0x4181
		0x03bd 0x4580 0x5e78 0x5e01 0x81bd 0x5b61 0xdd85 0x6760
		0x5826 0x87e1 0x0006 0x0c0f 0x1b49 0x5e01 0xf66b 0x0c17
		0x1b49 0x5e01 0xf683 0x0c17 0x1b49 0x5e01 0x2b50 0x0c0f
		0x1b49 0x5e01 0x2b60 0x0c0f 0x1b49 0x5826 0x87e1 0x0001
		0x0c03 0x1b49 0x4580 0x5e78 0x5e49 0x048f 0x5e01 0x81bd
		0x83e8 0x0021 0x4d82 0x22ef 0x24f4 0x5b41 0xc60a 0x381a
		0x5e18 0xf683 0x38fd 0x5e18 0xf66b 0x38fc 0x5b06 0x86c0
		0x0016 0x38f5 0x5b06 0x86c0 0x0040 0x38f6 0xd880 0x38f7
		0xd897 0x38f0 0xcc78 0x4183 0x046a 0xd898 0x9b79 0x805a
		0x5b0b 0x86c0 0x0100 0x9b77 0x38f1 0x60f4 0x64f4 0x5e02
		0x2b50 0xd89a 0x587a 0x5887 0x5e05 0x0000 0x41c0 0x5e20
		0x60f4 0x64f4 0x0088 0x0089 0x5e02 0x2b60 0xd89a 0x0000
		0x041a 0x01fd 0x587a 0x5887 0x5e05 0x0000 0x41c0 0x5e20
		0x68f4 0x71f7 0x4181 0x042e 0x60f4 0x78f5 0x41c0 0x5efc
		0x20f4 0x83e8 0x0021 0x4d82 0x4180 0x0465 0x5e18 0x2950
		0x38f8 0x5e18 0x29c8 0x38fa 0x60f8 0x64fa 0x68f4 0x71f0
		0x41c0 0x0db8 0x60f8 0x6cef 0x5e01 0xf66b 0x41c0 0x046f
		0x60fa 0x6c1a 0x5e01 0xf683 0x41c0 0x046f 0x60f8 0x64fa
		0x68f0 0x41c0 0x0dab 0x5e00 0x2950 0x78f5 0x41c0 0x5efc
		0x5e00 0x29c8 0x78f6 0x41c0 0x5efc 0x83e8 0x0021 0x4d82
		0x5e00 0x2950 0x5e01 0x29c8 0x68f4 0x72f0 0x67e0 0x5d1a
		0x0463 0x1f88 0x9289 0x1b8a 0x24f4 0x72f1 0x67e0 0x38f1
		0x4183 0x0421 0x81e8 0x0021 0x4d80 0x5e69 0x4580 0x5881
		0x5843 0x79f0 0x7700 0x77e0 0x5e18 0x0002 0x59da 0x5e1f
		0x4000 0x5e40 0x41c0 0x0486 0x5e60 0x0088 0x79f0 0x7700
		0x77e0 0x87e4 0x000c 0x41c0 0x0486 0x4580 0x5b44 0xc608
		0x58ba 0x5d1b 0x04b3 0x1e00 0x5c01 0x04ad 0x5824 0xd02b
		0x5b0b 0xd22b 0x5b2b 0xda2b 0xd24b 0x1ce1 0x18ec 0x1a09
		0x58f0 0x8a33 0x822d 0x6700 0x8eb9 0xdb57 0x0093 0x77c0
		0xdb07 0x87ab 0xda07 0x9ff0 0x8eb9 0x1b4d 0x18ed 0x1ce1
		0x18ec 0x1b81 0x86bf 0x9a41 0x87e3 0x0004 0x5862 0x8fe4
		0x0008 0x8fe5 0x0004 0x1a18 0x4580 0x5e01 0x81d1 0x5b61
		0xdd85 0x6760 0x5826 0x87e1 0x0006 0x0c0f 0x1b49 0x5e01
		0xf69b 0x0c17 0x1b49 0x5e01 0xf6b3 0x0c17 0x1b49 0x5e01
		0x8296 0x0c0f 0x1b49 0x5e01 0x82a6 0x0c0f 0x1b49 0x5826
		0x87e1 0x0001 0x0c03 0x1b49 0x4580 0x5e49 0x048f 0x5e01
		0x81d1 0x83e8 0x0021 0x4d82 0x22ef 0x24f4 0x5b41 0xc60a
		0x381a 0x5e18 0xf6b3 0x38fd 0x5e18 0xf69b 0x38fc 0x5b06
		0x86c0 0x0016 0x38f5 0x5b06 0x86c0 0x0040 0x38f6 0xd880
		0x38f7 0xd897 0x38f0 0xcc78 0x4183 0x0560 0xd898 0x9b79
		0x805a 0x5b0b 0x86c0 0x0100 0x9b77 0x38f1 0x60f4 0x64f4
		0x5e02 0x8296 0xd89a 0x587a 0x5887 0x5e05 0x0000 0x41c0
		0x5e20 0x60f4 0x64f4 0x0088 0x0089 0x5e02 0x82a6 0xd89a
		0x587a 0x5887 0x5e05 0x0000 0x41c0 0x5e20 0x68f4 0x71f7
		0x4181 0x0524 0x60f4 0x78f5 0x41c0 0x5efc 0x20f4 0x83e8
		0x0021 0x4d82 0x4180 0x055b 0x5e18 0x2950 0x38f8 0x5e18
		0x29c8 0x38fa 0x60f8 0x64fa 0x68f4 0x71f0 0x41c0 0x0db8
		0x60f8 0x6cef 0x5e01 0xf69b 0x41c0 0x046f 0x60fa 0x6c1a
		0x5e01 0xf6b3 0x41c0 0x046f 0x60f8 0x64fa 0x68f0 0x41c0
		0x0dab 0x5e00 0x2950 0x78f5 0x41c0 0x5efc 0x5e00 0x29c8
		0x78f6 0x41c0 0x5efc 0x83e8 0x0021 0x4d82 0x5e00 0x2950
		0x5e01 0x29c8 0x68f4 0x72f0 0x67e0 0x5d1a 0x0559 0x1f88
		0x9289 0x1b8a 0x24f4 0x72f1 0x67e0 0x38f1 0x4183 0x0517
		0x81e8 0x0021 0x4d80 0x5e69 0x4580 0xcd06 0x4181 0x0572
		0xcd05 0x4181 0x0592 0xcd03 0x4181 0x0596 0xcd02 0x4181
		0x05a0 0x4580 0x5e78 0x048f 0x81e8 0x0001 0x4d80 0x6760
		0x3847 0x3848 0x3849 0x384a 0x384b 0x384d 0x384e 0x384f
		0x3850 0xd4bc 0x8ffe 0x2101 0x384c 0x048f 0x3705 0x5e06
		0x2598 0x5e01 0xcd7a 0x5e02 0x25bb 0x41c0 0x5638 0x048d
		0x4180 0x540d 0x6760 0xd4bc 0x8ffe 0x4580 0x5e78 0x5f40
		0x059b 0x5e5a 0x4580 0x5e18 0x0001 0xd4bc 0x8ffe 0x4580
		0x5e78 0x5e06 0x0055 0xd881 0x581a 0xd883 0x4602 0x1c28
		0x8ca0 0x5083 0xd883 0x581a 0x5e18 0x0001 0xd5b8 0x8ffe
		0x6762 0x384c 0x4180 0x54cf 0xcd04 0x5071 0xcd03 0x4181
		0x063e 0xcd09 0x4181 0x0625 0x4580 0x5e7a 0x5e41 0x5e45
		0x5e06 0x0049 0xd882 0x4e05 0xd982 0x8cb9 0x67f3 0xd4bc
		0xad03 0xed34 0x0000 0x51d2 0xd880 0x581a 0x0000 0x1c40
		0x8ce2 0x0001 0x5162 0x5e18 0x0002 0x1b4a 0x1f4a 0x3831
		0x2433 0x2101 0x3832 0x0088 0xd883 0x4602 0x96bc 0x9ea0
		0x5023 0xd883 0x581a 0x5b40 0xdc80 0xd885 0x67e3 0xdc85
		0x50d0 0x5e1a 0x00f0 0x3831 0x5e18 0x7f9a 0x3833 0x581a
		0x6760 0x3832 0x5e19 0x01e1 0x0d1b 0x1b48 0xed39 0x0001
		0x50c2 0x41c0 0x5061 0x048d 0x5e41 0x5e45 0x2303 0x41c0
		0x2327 0x5e65 0x5e61 0x048f 0x51d0 0xed38 0xffff 0x5082
		0xd4b8 0x004b 0xd4ff 0x004e 0xcc01 0x5093 0x2101 0x3838
		0xd4b8 0x004e 0xac38 0x50e3 0x5e18 0xffff 0x3838 0x0000
		0x0617 0x01fd 0x2108 0xd4bc 0xbe91 0xd4b8 0xad03 0xd4bc
		0x7f99 0x5e18 0x0002 0xd4bc 0xbe10 0x5e65 0x5e61 0x4580
		0xd4b8 0x8d87 0x981a 0x5142 0x6436 0x6837 0x5e18 0x0001
		0xd4bc 0xbea3 0x1f21 0x7720 0x58fb 0x5e06 0x8203 0x5e01
		0x81d1 0x41c0 0x04d5 0x5e18 0x0000 0xd4bc 0xbea3 0x048f
		0x4580 0x5e7a 0x0000 0x712d 0x9b42 0x86c0 0x0648 0x0000
		0x599a 0x0000 0x0000 0x5e00 0x1fe7 0x4180 0x0652 0x5e00
		0x1fe7 0x4180 0x0652 0x5e00 0x827e 0x4180 0x5049 0xcd1e
		0x4181 0x066c 0x4580 0x5e78 0x4180 0x642c 0xf086 0x4581
		0x5e78 0x4580 0xeb12 0x0002 0x4582 0xd4b8 0xb20b 0x9b7e
		0x82c0 0x0001 0x84c0 0x0001 0xd4bc 0x8d17 0x4580 0x7112
		0x4582 0x7981 0x60b3 0x6760 0x0d1b 0x1b48 0x4580 0xcd03
		0x4181 0x0678 0x4580 0x5e78 0x25ff 0x3aa2 0x3a9e 0x3ac7
		0x5e06 0x826e 0x5e00 0x006f 0x5e01 0xf6cb 0x5e02 0xf6cb
		0x2f04 0x3300 0x41c0 0x42bc 0x41c0 0x42f3 0x4180 0x3f27
		0xcd0e 0x4181 0x0694 0xcd0d 0x4181 0x06a8 0x4580 0x5e78
		0x71c7 0x5091 0x5e19 0x0001 0xf086 0x5051 0xfa84 0x5031
		0xfb84 0x5011 0x5020 0x5e19 0x0003 0xd5bc 0xbea5 0xd5bc
		0xad02 0x4180 0x49db 0xed8f 0x0003 0x4582 0x5e78 0xf083
		0x4182 0x071d 0x5e00 0x0039 0x41c0 0x0dc4 0x5e00 0x0039
		0xff84 0x41c1 0x4f8b 0x5e00 0x2642 0x5e01 0x0039 0x7290
		0x6720 0x585a 0x41c0 0x44f9 0xd4b8 0x175d 0x50b1 0x5e01
		0x0039 0x6090 0x5e19 0x0001 0x5e06 0x175d 0x5e05 0xacf4
		0x41c0 0x5816 0xd4b8 0x0c73 0x5bfa 0xd4b8 0x0c74 0x58fa
		0x5e00 0x0039 0x5e03 0x0039 0x5e01 0x0b5c 0x7190 0x67e0
		0x5d1a 0x06e8 0x8028 0x5b0b 0xdac0 0x67a0 0x1b8b 0x8028
		0x5b0b 0xdac0 0x67a0 0x1b89 0xf184 0x5202 0x5e06 0x0060
		0x5e00 0x0039 0x6490 0x5e05 0xe631 0xd4b8 0x0006 0x41c2
		0x4398 0xd4b8 0x0006 0x41c1 0x42ff 0xf184 0x50f2 0x5e06
		0x826e 0x5e00 0x0b5c 0x6490 0x5e05 0xf6db 0xd4b8 0x0006
		0x41c2 0x4398 0xd4b8 0x0006 0x41c1 0x42ff 0x5e00 0x0039
		0x5e01 0x0b14 0x5e03 0x0b5c 0x5c05 0x0716 0x1f48 0x1b49
		0x1f4b 0x1b49 0x5e04 0xcd76 0x5e00 0x0b14 0x41c0 0x4469
		0x4180 0x4a8f 0x5e78 0x7760 0x714c 0x67e0 0x5d1a 0x08a9
		0x5e5b 0x7ced 0x600d 0x0000 0x8028 0x5b0b 0x200d 0x6013
		0x0000 0x1fa0 0x9ffd 0x8fb8 0xf0f1 0x5031 0xf1f1 0x4182
		0x07cc 0x9fc3 0x49f0 0x7cf2 0x6010 0x0000 0x1f80 0x96bd
		0x805c 0x5b0b 0x93bc 0x1ba0 0xf0f1 0x5052 0x6014 0x0000
		0x1f88 0x2014 0x4981 0xf1f1 0x4182 0x07c7 0x6013 0x0000
		0x9a80 0x5b0b 0x6011 0x0000 0x1f68 0x9380 0x5e12 0x000b
		0x41c0 0x9c95 0x5e07 0x7c12 0x815a 0x77b0 0x9ff0 0x9b70
		0x815a 0x5b0b 0x87b8 0x5e1a 0xb852 0x5e07 0xe41e 0x92a7
		0x87b8 0x5e1a 0x2b7e 0x9ff0 0x050b 0x41c0 0x9c44 0x77f0
		0x2301 0x93a0 0x6700 0x7700 0x41c0 0x9d6c 0x9b50 0x6012
		0x0000 0x1fa0 0x8fb8 0x4980 0xd4b8 0x7eef 0x58fa 0x815b
		0x67b0 0x9b70 0x805d 0x5b2b 0x87b8 0x4980 0x87b8 0x1ba8
		0x2012 0x8dfd 0x7eb8 0x5056 0x8dfc 0x7eb8 0x5026 0x5e1c
		0x7eb8 0x6013 0x0000 0x9a80 0x58fc 0x5b0b 0x6011 0x0000
		0x1f68 0x9380 0x8fb8 0x4980 0x815b 0x67b0 0x9b70 0x805d
		0x5b2b 0x87b8 0x4980 0x87b8 0x6010 0x0000 0x1f00 0x5154
		0xd4b8 0x7ef0 0x58fa 0x6011 0x0000 0x1f48 0x9290 0x8eb9
		0x4982 0x815a 0x77b0 0x9ff0 0x805c 0x5b0b 0x87b8 0x4980
		0x87b8 0x1b68 0x1ba8 0x67f0 0x5040 0x6011 0x0000 0x1f48
		0x9288 0x2011 0x41c0 0x7c69 0x6700 0x9b50 0x5e00 0x4000
		0x92a0 0x4981 0x6016 0x0000 0x1a28 0x2016 0x5030 0x6010
		0x0000 0x1ba0 0x6010 0x0000 0x1f08 0x2010 0x4184 0x088d
		0xf4f1 0x4182 0x0834 0x6017 0x5e7b 0x5e5b 0x5e01 0x7f23
		0x95a1 0x583b 0x1f88 0x1fa1 0x2017 0x8cb9 0x53e3 0x2101
		0xd4bc 0x7f93 0x6016 0x0090 0x1f80 0x6720 0x6790 0x9b70
		0x5b9a 0x41c0 0x7c83 0x6013 0x0000 0x9a88 0x5b2b 0x2013
		0x4983 0x6817 0x0092 0x1ce2 0x815a 0x77b0 0x9ff0 0x805c
		0x5b0b 0x87b8 0x5ed9 0x5e1c 0x7fff 0x9682 0x58fc 0x4981
		0x815a 0x77b0 0x9ff0 0x805c 0x5b0b 0x87b8 0xd2d0 0x87b8
		0x600e 0x0000 0x1f48 0x9290 0x8eb9 0x5ed9 0x7cee 0x0000
		0x0814 0x01fd 0x815a 0x77b0 0x9ff0 0x805c 0x5b0b 0x87b8
		0xd2d0 0x86b9 0x5ed8 0x6016 0x0090 0x1e20 0x4180 0x0854
		0x6013 0x0088 0x2013 0x6760 0xd4bc 0x7f93 0x600e 0x0088
		0x0088 0x200e 0x600f 0x0088 0x200f 0x6015 0x0088 0x2015
		0x4180 0x0854 0x600e 0x0000 0x1f48 0x9290 0x6013 0x0000
		0x9a88 0x5b2b 0x2013 0x8eb9 0x5ed9 0x7cee 0x815a 0x77b0
		0x9ff0 0x805c 0x5b0b 0x87b8 0x4980 0x87b8 0x67f0 0x5ed8
		0x5e19 0x0001 0xd5bc 0x7f93 0x6016 0x0090 0x1e20 0x6017
		0x0088 0x2017 0xd5b8 0x7f93 0x4181 0x089d 0x41c0 0x7c69
		0x9b4f 0x5e07 0x4000 0x92a7 0xf0f1 0x5021 0xf1f1 0x5162
		0x6015 0x0000 0x1fa8 0x2015 0x8db8 0x67f5 0x77f0 0x4981
		0x8fb8 0x4981 0xb7f3 0x5174 0x600e 0x0000 0x1a48 0x1a08
		0x200e 0x600f 0x0000 0x1b88 0x200f 0x5250 0x6015 0x0088
		0x2015 0x600e 0x0000 0x1a48 0x1a08 0x200e 0x600f 0x0000
		0x1b88 0x200f 0x5180 0x600e 0x0088 0x0088 0x200e 0x600f
		0x0088 0x200f 0x5100 0x600e 0x0088 0x0088 0x200e 0x600f
		0x0088 0x200f 0x6013 0x0088 0x2013 0x6015 0x0088 0x2015
		0x6017 0x0088 0x2017 0xf4f1 0x5092 0x600f 0x6415 0x0090
		0x0091 0x1fa0 0x1f81 0x8db8 0x5016 0x1b80 0x5e7b 0x77d0
		0x4d83 0x5e00 0x4c59 0x5e01 0x7d9c 0x5e02 0x7dcc 0x794c
		0x77e0 0x71ec 0x5072 0x7cf0 0x5d1b 0x08ba 0x8028 0x5b0b
		0x1b8a 0x5130 0xcc01 0x5072 0x7cef 0x5d1b 0x08c3 0x8029
		0x5b0b 0x1b8a 0x50a0 0x5d1b 0x08ce 0x7cf0 0x8028 0x5b0b
		0x7cef 0x8029 0x5b2b 0x8660 0x1b8a 0x4d82 0x4580 0xcd0f
		0x4181 0x08e4 0xcd0c 0x4181 0x097e 0xcd0b 0x4181 0x099b
		0xcd0a 0x4181 0x0a23 0xcd10 0x4181 0x0a33 0xcd07 0x4181
		0x071f 0x4580 0x5e78 0x7168 0x5161 0xfa6c 0x5142 0x5e00
		0x2e1d 0x5e01 0x7ddc 0x5e02 0xd3a0 0x7151 0x67e0 0x5d1a
		0x08f4 0x1f09 0x1b4a 0x5b62 0x714f 0x67e0 0x5d1a 0x08fb
		0x1f08 0x1b4a 0x3c0c 0x6009 0x7150 0x67e0 0x380a 0x4b88
		0x41c0 0x8198 0x41c0 0x837a 0x4b88 0xf167 0x5262 0x724a
		0x67d0 0x59fa 0x7afe 0xb3fe 0x5ef9 0x71ff 0x67e0 0x5d1a
		0x092e 0x5e03 0x2dcd 0x67c0 0x5e02 0x8e39 0x740b 0x703a
		0x794a 0x77e0 0x5d1b 0x0927 0x1fab 0x1e0c 0x97b0 0x58f1
		0x805d 0x5bb0 0x87ab 0x1ba2 0xd046 0x86ab 0x7760 0xd6f0
		0x93b3 0x5ef9 0x1b88 0x009d 0x2a0b 0x724a 0x67d0 0x59fa
		0x7152 0x79ff 0x8eb9 0x67e0 0x5d1a 0x0944 0x5e03 0x2dcd
		0x67c0 0x740b 0x794a 0xcf02 0xd04f 0x0d1b 0xd24f 0x86ab
		0x1b88 0x009d 0x2a0b 0xf167 0x5092 0x5e03 0x2dcd 0x683a
		0x724a 0x67e0 0x5d1a 0x094f 0x1f0b 0x1b4a 0x7168 0x5051
		0xfa6c 0x5032 0x710c 0xa64a 0x380c 0x6760 0x720a 0x4182
		0x08ff 0x5e18 0xd140 0xa64f 0x58ba 0x7005 0x7151 0x67e0
		0x5d1a 0x0965 0x1f0d 0x1b4c 0x7168 0x5151 0xfa6c 0x5132
		0xf96c 0x5112 0xd4b8 0x7f21 0x67d0 0xd4bc 0x7f21 0x5e18
		0xd3a0 0xa64f 0x58ba 0x5e04 0x7ddc 0x7151 0x67e0 0x5d1a
		0x097c 0x1f0d 0x1b4c 0x4580 0x5e78 0x7254 0x67d0 0x3854
		0xbe5b 0x5156 0x6760 0x3854 0x5e00 0x2dfd 0x6407 0x6808
		0x6c06 0x714c 0x67e0 0x5d1a 0x0998 0x1f02 0x1f21 0x8db8
		0x67f5 0x1b6a 0x1f28 0x8db8 0x67f5 0x1b69 0x1b4b 0x4180
		0x82b5 0x5e78 0x5e00 0x2dfd 0x6806 0x7168 0x5061 0xf96c
		0x5042 0xfa6c 0x5022 0x5e02 0x7dcc 0x5e03 0xd120 0x3300
		0x794c 0x77e0 0x5d1b 0x0a03 0x7167 0x901a 0x5292 0x7157
		0x7958 0x8de4 0x0000 0x77f1 0x1f08 0x8e8a 0x58fa 0x805b
		0x5b0b 0x6720 0x41c0 0x7c83 0x67a0 0x49c0 0x7e65 0x9abc
		0x5b0b 0x98ba 0x50e6 0x9458 0xdac0 0x3a03 0x0c0f 0x0f03
		0x5b3b 0xdee0 0x7700 0x5e18 0x7fff 0x8dc0 0x7fff 0x77f3
		0x5020 0x5e19 0x7fff 0x7c4e 0x805b 0x5b0b 0x9b42 0x5200
		0x794d 0x1f00 0x8e82 0x8cb9 0x50d6 0x7958 0x7157 0x8de4
		0x0000 0x77f1 0x1f00 0x8e82 0xae5d 0x6765 0x58fa 0x805b
		0x5b0b 0x5010 0x6760 0x008a 0x0088 0x41c0 0x7c83 0x67a0
		0x49c0 0x5e19 0x7fff 0x8fbc 0x58fb 0xe04e 0x5b0b 0x9b42
		0x7e66 0x8cb9 0x67f3 0x5b3c 0x7156 0x6700 0x8cb9 0x77f3
		0x1b6b 0x3301 0x714d 0x6006 0x7968 0x5061 0xf96c 0x5042
		0xfa6c 0x5022 0x5e00 0x7dcc 0x5e01 0x2dfe 0x0088 0x0000
		0x0a11 0x01fd 0x1fa8 0xb35e 0x49f0 0x5b7d 0x8d89 0x5025
		0xa661 0x5010 0xae62 0x795f 0x8cb9 0x67f3 0x7960 0x8cb9
		0x67f5 0x384d 0x4180 0x8342 0x5e78 0x1f00 0xa64d 0xa65d
		0xa664 0x5b3a 0x7163 0x8db8 0x77f5 0x5b1b 0x8c81 0x4584
		0xd5b8 0x2dff 0x4180 0x8354 0x5e78 0x5e19 0x0000 0x3cff
		0xf167 0x5092 0x5e19 0x0007 0x714f 0x8cc0 0x0140 0x5021
		0x5e19 0x0003 0x3cff 0xf167 0x5092 0x5e19 0x1000 0x714f
		0x8cc0 0x0140 0x5021 0x5e19 0x2000 0x3cfe 0x5e02 0x9230
		0x5e03 0x9020 0x714f 0x8cc0 0x0140 0x5042 0x5e02 0x9130
		0x5e03 0x9000 0x4180 0x8119 0xcd08 0x4181 0x0a5f 0x4580
		0x5e78 0x83e8 0x0001 0x4d82 0xf96c 0x5142 0xfa6c 0x5122
		0xd4b8 0x38dc 0x581a 0x5e01 0x2e1d 0x716b 0x67e0 0x5d1a
		0x0a71 0x1f88 0x1b89 0x5e00 0x2e1d 0x5e01 0x7edc 0x796b
		0x41c0 0x6cc7 0x726f 0x3809 0x5e01 0x4c39 0x2204 0x5e01
		0x4c89 0x2205 0x5e01 0x4c59 0x2206 0x5e01 0x4c69 0x2207
		0x5e01 0x4c79 0x2208 0x5e01 0x817c 0x223a 0x41c0 0x8100
		0x4d80 0x81e8 0x0001 0x4580 0xcd11 0x4181 0x0aa0 0xcd0d
		0x4181 0x0abd 0xcd06 0x4181 0x0ada 0xcd15 0x4181 0x0b2c
		0x4580 0x5e78 0xf36d 0x4182 0x6f9c 0xf16c 0x4181 0x6f9c
		0x2101 0x3868 0x5e01 0x4c39 0x2204 0x5e01 0x4c89 0x2205
		0x5e01 0x4c59 0x2206 0x5e01 0x4c69 0x2207 0x5e01 0x4c79
		0x2208 0x5e01 0x817c 0x223a 0x4180 0x6f98 0x5e78 0xf16d
		0x4182 0x711f 0xf06c 0x4181 0x711f 0x6760 0x3868 0x5e01
		0x4d9b 0x2204 0x5e01 0x4deb 0x2205 0x5e01 0x4dbb 0x2206
		0x5e01 0x4dcb 0x2207 0x5e01 0x4ddb 0x2208 0x5e01 0x819c
		0x223a 0x4180 0x711b 0x5e78 0x716a 0x50d2 0x2180 0x3851
		0x2110 0x384a 0x2104 0x384b 0x2110 0x3852 0x210a 0x3850
		0x21a0 0x384f 0x50e0 0x5e1a 0x0100 0x3851 0x2120 0x384a
		0x2105 0x384b 0x2120 0x3852 0x210a 0x3850 0x5e1a 0x0140
		0x384f 0x714a 0x6700 0x384c 0x2108 0x3853 0x6760 0x3855
		0x3854 0x5e18 0x0400 0x384d 0x5e18 0x2000 0x384e 0x6005
		0x7951 0x77e0 0x6760 0x0d1b 0x1b48 0xf167 0x5062 0x603a
		0x794a 0x77e0 0x6760 0x0d1b 0x1b48 0x704c 0x5e18 0x7fff
		0x6008 0x6404 0x6807 0x6c06 0x5e19 0x0400 0x0094 0x5d04
		0x0b24 0x1b48 0x1ba9 0x1b69 0x1b4a 0x1b4b 0x6760 0x7a68
		0x5021 0x5e18 0x001e 0x3869 0x4580 0x5e78 0xf66e 0x5022
		0xe36c 0x0800 0xf76e 0x50a2 0xfb6c 0x5081 0x5e00 0x62c5
		0x5e01 0x633a 0x5c74 0x0b3c 0x1f48 0x1b49 0xf06e 0x5022
		0xe36c 0x0100 0xf16e 0x5062 0xf86c 0x5041 0xd4b8 0x38f0
		0xd4bc 0x70e3 0xfe6d 0x5022 0xe36c 0x0080 0xff6d 0x5152
		0xf76c 0x5131 0x5e00 0x38e6 0x1f08 0xd4bc 0x8dc8 0x5e00
		0x38e7 0x5e01 0x38dd 0x5c03 0x0b5d 0x1f88 0x1b89 0x5e01
		0x38e1 0x5c04 0x0b63 0x1f88 0x1b89 0xf26e 0x5022 0xe36c
		0x0200 0xf36e 0x50d2 0xf96c 0x50b1 0x5e00 0x7b01 0x5e01
		0x7c40 0x5e1b 0x011d 0x77e0 0x5d1b 0x0b76 0x1f48 0x1b49
		0xf06d 0x5022 0xe36c 0x0001 0xf16d 0x5042 0xf06c 0x5021
		0x41c0 0x71c2 0xf26d 0x5022 0xe36c 0x0002 0xf36d 0x50a2
		0xf16c 0x5081 0x5e00 0x4c27 0x5e01 0x8e56 0x5c11 0x0b90
		0x1f48 0x1b49 0xf46e 0x5022 0xe36c 0x0400 0x4180 0x6e66
		0x4180 0x6e7e 0xcd00 0x4181 0x0b9d 0x4580 0x5e78 0x83e8
		0x0001 0x4d82 0x2009 0x5e01 0x4d9b 0x2204 0x5e01 0x4deb
		0x2205 0x5e01 0x4dbb 0x2206 0x5e01 0x4dcb 0x2207 0x5e01
		0x4ddb 0x2208 0x5e01 0x819c 0x223a 0x41c0 0x8100 0x4d80
		0x81e8 0x0001 0x4580 0xcd04 0x50d1 0xcd03 0x4181 0x0c56
		0xcd05 0x4181 0x0c9e 0xcd09 0x4181 0x0c6f 0xcd02 0x4181
		0x0cb6 0x4580 0x5e7a 0x5e41 0x5e45 0x5e06 0x004f 0xed41
		0x0000 0x5292 0xd880 0x581a 0x0000 0x1c40 0x8ce2 0x0001
		0x5222 0x5e18 0x0002 0x1b4a 0x1f4a 0x383e 0x2440 0x2101
		0x383f 0x0088 0xd883 0x4602 0x96bc 0x9ea0 0x5023 0xd883
		0x581a 0x5b40 0xdc80 0xd885 0x67e3 0xdc85 0xd4b8 0x827d
		0x67e3 0xd4bc 0x827d 0x67d0 0xdaf0 0xd882 0x8eb9 0xd982
		0x8cb9 0x67f3 0x5140 0x5e1a 0x00f0 0x383e 0x5e18 0x7f9a
		0x3840 0x581a 0x6760 0x383f 0x5e19 0x01e1 0x0d1b 0x1b48
		0xd5b8 0x827d 0xd882 0x8eb9 0xd982 0x8cb9 0x67f3 0x0000
		0x0c0e 0x01f9 0xd4bc 0xb3e8 0xed46 0x0001 0x5232 0xed3a
		0x0002 0x5142 0xd4b8 0x827d 0x8dfa 0x0000 0x5052 0x5e18
		0x0001 0xd4bc 0x8294 0x5332 0xd882 0x8ec0 0x0004 0xd5b8
		0x827d 0x8db8 0x52c2 0x41c0 0x0d5c 0x5020 0x41c0 0x5265
		0x048d 0x5e41 0x5e45 0x2304 0x41c0 0x2327 0x5e65 0x5e61
		0x048f 0x51d0 0xed45 0xffff 0x5082 0xd4b8 0x0051 0xd4ff
		0x0054 0xcc01 0x5093 0x2101 0x3845 0xd4b8 0x0054 0xac45
		0x50e3 0x5e18 0xffff 0x3845 0x2120 0xd4bc 0xbe91 0xd4b8
		0xb3e8 0xd4bc 0x81bc 0x5e18 0x0002 0xd4bc 0xbe10 0x5e65
		0x5e61 0x4580 0x5e7a 0x0000 0x713a 0x9b42 0x86c0 0x0c60
		0x0000 0x599a 0x0000 0x0000 0x5e00 0x1fea 0x4180 0x0c6a
		0x5e00 0x1fea 0x4180 0x0c6a 0x5e00 0x827e 0x6760 0xd4bc
		0x827d 0x4180 0x524d 0x5e7a 0xd4b8 0x8d87 0x991a 0x5142
		0x6443 0x6844 0x5e18 0x0001 0xd4bc 0xbea3 0x1f21 0x7720
		0x58fb 0x5e06 0x8203 0x5e01 0x81d1 0x41c0 0x04d5 0x5e18
		0x0000 0xd4bc 0xbea3 0x048f 0x6042 0x2101 0x1b40 0xd4b8
		0x8f41 0x67d2 0xd4bc 0x8f41 0x048d 0x0000 0xf587 0x5021
		0xe187 0x0010 0x5e06 0x004f 0xd885 0x4c02 0x67d5 0xdc85
		0x4180 0x532b 0x5e7a 0x048f 0x5e06 0x004f 0xd881 0x581a
		0xd883 0x4602 0x96bc 0x1c28 0x9ea0 0x5023 0xd883 0x581a
		0x5b40 0xdc81 0xd4b8 0x827d 0x4c02 0x67d5 0xd4bc 0x827d
		0x4180 0x527d 0x5e7a 0x048f 0x0000 0x713e 0x41c1 0x5389
		0x723f 0x59da 0x6040 0x5e01 0x0b98 0x713e 0x8ec0 0x0006
		0x5085 0xdaf0 0x5c05 0x0ccb 0x1f58 0x1b49 0x1f58 0x1b49
		0x51b0 0xdaf0 0x87c0 0x0006 0x6790 0x58ba 0x77e0 0x5d1b
		0x0cd8 0x1f58 0x1b49 0x1f58 0x1b49 0x41c0 0x5389 0x723f
		0x59da 0x6040 0x5b05 0x7a3e 0x8fa5 0x67e0 0x5d1a 0x0ce7
		0x1f58 0x1b49 0x1f58 0x1b49 0x2040 0x3c3e 0xdb82 0xd4b8
		0x0d06 0x5bfa 0xd4b8 0x0d07 0x58fa 0x5e00 0x0b98 0x5c05
		0x0cf9 0x8020 0x5b0b 0xdac0 0x67a0 0x1b98 0xd4b8 0x0d0d
		0x5bfa 0xd4b8 0x0d0e 0x58fa 0x5e00 0x0b99 0x5c05 0x0d08
		0x8020 0x5b0b 0xdac0 0x67a0 0x1b98 0xed46 0x0001 0x4182
		0x0d5a 0xed3a 0x0002 0x4182 0x0d5a 0xd4b8 0x8294 0x8dfa
		0x0001 0x4182 0x0d5a 0xd4b8 0x8295 0x67d0 0xd4bc 0x8295
		0xd4b8 0x8295 0x5e06 0x004f 0xd984 0x8cb9 0x5375 0x6760
		0xd4bc 0x8295 0x5e06 0x004f 0xd982 0x77e0 0xd4b8 0x827d
		0x8db8 0x50c1 0x41c0 0x5265 0x048d 0x5e41 0x5e45 0x2304
		0x41c0 0x2327 0x5e65 0x5e61 0x048f 0x5200 0x5e06 0x004f
		0xd4b8 0x827d 0x4c02 0x67d5 0xd4bc 0x827d 0xd882 0xd4ff
		0x827d 0x8cb9 0x67f3 0xd4bc 0xb3e8 0x5e02 0x1d63 0x5e00
		0xab14 0x5cf0 0x0d52 0x1f48 0x1b4a 0x1f48 0x1b4a 0x5e18
		0x2000 0xd4bc 0xbe10 0x6760 0xd4bc 0x8294 0x048d 0x4580
		0x048f 0x5e06 0x004f 0xd881 0x581a 0xd883 0x4602 0x96bc
		0x1c28 0x9ea0 0x5023 0xd883 0x581a 0x5b40 0xdc81 0x2100
		0x1b41 0x5841 0x87e2 0x0002 0x5e00 0x1d63 0x713d 0xed3b
		0x0000 0x6722 0xdaf0 0x83c0 0x000f 0x8eb9 0x9b7c 0x58bb
		0x589a 0x8de4 0x0000 0x5226 0x1f48 0x1b4a 0x1f48 0x1b4a
		0x1f48 0x1b4a 0x1f48 0x1b4a 0x1f48 0x1b4a 0x1f48 0x1b4a
		0x1f48 0x1b4a 0x1f48 0x1b4a 0x1f48 0x1b4a 0x1f48 0x1b4a
		0x1f48 0x1b4a 0x1f48 0x1b4a 0x1f48 0x1b4a 0x1f48 0x1b4a
		0x1f48 0x1b4a 0x1f48 0x1b4a 0x0094 0x55ec 0x8de5 0x0000
		0x5046 0x1f48 0x1b4a 0x0095 0x57cc 0x048d 0x4580 0x5b42
		0x67e0 0x5d1a 0x0db6 0x1f80 0x1fa1 0x5a1c 0x86b9 0x1b88
		0x5b90 0x8eb9 0x1b89 0x4580 0x67e0 0x5d1a 0x0dbe 0x1f8a
		0x6700 0x1b88 0x1b89 0x4580 0xcd0f 0x4181 0x0dd5 0x4580
		0x023f 0xdb81 0x81ea 0x0002 0x648d 0x7290 0x67e0 0x5d1a
		0x0dd0 0x1f59 0x1b48 0x1f59 0x1b48 0x228d 0x83ea 0x0002
		0x4580 0x5e78 0x228f 0x87e1 0x90f0 0x0000 0x1f01 0x3890
		0x5e18 0xb900 0x388d 0x5e01 0xb900 0x6760 0x0c3f 0x1b49
		0x5e19 0xb980 0x3c8e 0x5e01 0xb980 0x6760 0x0c3f 0x1b49
		0xd4bc 0x7f96 0x5e19 0x0003 0xd4bc 0xbe45 0xd5bc 0xbe44
		0xd4bc 0xbe51 0xd5bc 0xbe50 0x6760 0x5e01 0xcc00 0x0c3f
		0x1b49 0x5e01 0xcc46 0x0c0f 0x1b49 0x5e01 0xf6cb 0x0c0f
		0x1b49 0x4180 0x3977 0x0000 0x17e0 0x0020 0x4180 0x279f
		0x4180 0x279f 0x4180 0x279f 0x4180 0x279f 0x4180 0x279f
		0x4180 0x279f 0x4180 0x279f 0x4180 0x279f 0x4180 0x279f
		0x4180 0x279f 0x4180 0x279f 0x4180 0x279f 0x4180 0x279f
		0x4180 0x279f 0x4180 0x279f 0x4180 0x279f 0x0001 0x1fe7
		0x0006 0x0002 0x17bd 0x199f 0x0002 0x1b81 0x1d63 0x0001
		0x2620 0x0036 0x0000 0x0000 0x0000 0x0000 0x0000 0x0000
		0x0000 0x0000 0x0000 0x0000 0x0000 0x0000 0x0000 0x0000
		0x0000 0x0000 0x0000 0x0000 0x0000 0x0000 0x0000 0x0000
		0x0000 0x0000 0x0000 0x0000 0xa934 0x1b81 0x0002 0x0000
		0x0000 0xab14 0x1d63 0x0004 0x0000 0x0000 0x0600 0x0000
		0x0000 0x0000 0x0000 0x0000 0x0000 0x0000 0x0000 0x0000
		0x0600 0x0000 0x0600 0x0000 0x0600 0x0000 0x0000 0x0000
		0x0001 0x827e 0x0016 0x0014 0x3000 0x31e2 0x33c4 0x35a6
		0x3788 0x396a 0x3b4c 0x3d2e 0x3f10 0x40f2 0x42d4 0x44b6
		0x4698 0x487a 0x4a5c 0x4c3e 0x4e20 0x5002 0x51e4 0x53c6
		0x55a8 0x0002 0x0020
	>;
};
