#ifdef CONFIG_X86_INTEL_SOFIA
main_hirq:main-hirq-interrupt-controller {
	compatible = "intel,sofia-main-hirq";
	#interrupt-cells = <2>;
	interrupt-controller;
	interrupt-parent = <&pic>;
	interrupts =
		< HIRQ IRQ_TYPE_DEFAULT >;
};
hirq:hirq-interrupt-controller {
	compatible = "intel,sofia-hirq";
	#interrupt-cells = <2>;
	interrupt-controller;
	interrupt-parent = <&main_hirq>;
	interrupts =
		< 0 IRQ_TYPE_DEFAULT >, /* VMM_BROADCAST */
		< 0 IRQ_TYPE_DEFAULT >, /* LNX_PERF_CNT_INT */
		< 0 IRQ_TYPE_DEFAULT >, /* LNX_SOC_WATCH_INT */
		< 0 IRQ_TYPE_DEFAULT >, /* PRH_SIGNALING_INT */
		< 0 IRQ_TYPE_DEFAULT >, /* vtimer = 516 */
                < 0 IRQ_TYPE_DEFAULT >, /* SPCU_T0LOW_INT */
                < 0 IRQ_TYPE_DEFAULT >, /* SPCU_T0HIGH_INT */
                < 0 IRQ_TYPE_DEFAULT >, /* SPCU_T1LOW_INT */
                < 0 IRQ_TYPE_DEFAULT >, /* SPCU_T1HIGH_INT = 520 */
		< 0 IRQ_TYPE_DEFAULT >, /* RTC_ALARM = 521 */
		< 0 IRQ_TYPE_DEFAULT >, /* CPU_CLK_CHANGE_INT = 522 */
		< 0 IRQ_TYPE_DEFAULT >, /* MODEM_DVFS_INT = 523 */
		< 0 IRQ_TYPE_DEFAULT >,  /* 524 */
		< 0 IRQ_TYPE_DEFAULT >,  /* SPCU_T2LOW_INT = 525 */
		< 0 IRQ_TYPE_DEFAULT >,  /* SPCU_T2HIGH_INT = 526 */
		< 0 IRQ_TYPE_DEFAULT >,  /* 527 */
		< 0 IRQ_TYPE_DEFAULT >,  /* 528 */
		< 0 IRQ_TYPE_DEFAULT >,  /* 529 */
		< 0 IRQ_TYPE_DEFAULT >,  /* 530 */
		< 0 IRQ_TYPE_DEFAULT >,  /* 531 */
		< 0 IRQ_TYPE_DEFAULT >,  /* 532 */
		< 0 IRQ_TYPE_DEFAULT >,  /* 533 */
		< 0 IRQ_TYPE_DEFAULT >,  /* 534 */
		< 0 IRQ_TYPE_DEFAULT >,  /* 535 */
		< 0 IRQ_TYPE_DEFAULT >,  /* 536 */
		< 0 IRQ_TYPE_DEFAULT >,  /* 537 */
		< 0 IRQ_TYPE_DEFAULT >,  /* 538 */
		< 0 IRQ_TYPE_DEFAULT >,  /* 539 */
		< 0 IRQ_TYPE_DEFAULT >,  /* 540 */
		< 0 IRQ_TYPE_DEFAULT >,  /* 541 */
		< 0 IRQ_TYPE_DEFAULT >,  /* 542 */
		< 0 IRQ_TYPE_DEFAULT >,  /* 543 */
		< 0 IRQ_TYPE_DEFAULT >,  /* 544 */
		< 0 IRQ_TYPE_DEFAULT >,  /* 545 */
		< 0 IRQ_TYPE_DEFAULT >,  /* 546 */
		< 0 IRQ_TYPE_DEFAULT >,  /* 547 */
		< 0 IRQ_TYPE_DEFAULT >,  /* 548 */
		< 0 IRQ_TYPE_DEFAULT >,  /* 549 */
		< 0 IRQ_TYPE_DEFAULT >,  /* 550 */
		< 0 IRQ_TYPE_DEFAULT >,  /* 551 */
		< 0 IRQ_TYPE_DEFAULT >,  /* 552 */
		< 0 IRQ_TYPE_DEFAULT >,  /* 553 */
		< 0 IRQ_TYPE_DEFAULT >,  /* 554 */
		< 0 IRQ_TYPE_DEFAULT >,  /* 555 */
		< 0 IRQ_TYPE_DEFAULT >,  /* 556 */
		< 0 IRQ_TYPE_DEFAULT >,  /* 557 */
		< 0 IRQ_TYPE_DEFAULT >,  /* 558 */
		< 0 IRQ_TYPE_DEFAULT >,  /* 559 */
		< 0 IRQ_TYPE_DEFAULT >,  /* 560 */
		< 0 IRQ_TYPE_DEFAULT >,  /* 561 */
		< 0 IRQ_TYPE_DEFAULT >,  /* 562 */
		< 0 IRQ_TYPE_DEFAULT >,  /* 563 */
		< 0 IRQ_TYPE_DEFAULT >,  /* 564 */
		< 0 IRQ_TYPE_DEFAULT >,  /* 565 */
		< 0 IRQ_TYPE_DEFAULT >,  /* 566 */
		< 0 IRQ_TYPE_DEFAULT >,  /* 567 */
		< 0 IRQ_TYPE_DEFAULT >,  /* 568 */
		< 0 IRQ_TYPE_DEFAULT >,  /* 569 */
		< 0 IRQ_TYPE_DEFAULT >,  /* 570 */
		< 0 IRQ_TYPE_DEFAULT >,  /* 571 */
		< 0 IRQ_TYPE_DEFAULT >,  /* 572 */
		< 0 IRQ_TYPE_DEFAULT >,  /* 573 */
		< 0 IRQ_TYPE_DEFAULT >,  /* 574 */
		< 0 IRQ_TYPE_DEFAULT >,  /* 575 */
		< 0 IRQ_TYPE_DEFAULT >,  /* 576 */
		< 0 IRQ_TYPE_DEFAULT >,  /* 577 */
		< 0 IRQ_TYPE_DEFAULT >,  /* 578 */
		< 0 IRQ_TYPE_DEFAULT >,  /* 579 */
		< 0 IRQ_TYPE_DEFAULT >,  /* 580 */
		< 0 IRQ_TYPE_DEFAULT >,  /* 581 */
		< 0 IRQ_TYPE_DEFAULT >,  /* 582 */
		< 0 IRQ_TYPE_DEFAULT >,  /* 583 */
		< 0 IRQ_TYPE_DEFAULT >,  /* 584 */
		< 0 IRQ_TYPE_DEFAULT >,  /* 585 */
		< 0 IRQ_TYPE_DEFAULT >,  /* 586 */
		< 0 IRQ_TYPE_DEFAULT >,  /* 587 */
		< 0 IRQ_TYPE_DEFAULT >,  /* 588 */
		< 0 IRQ_TYPE_DEFAULT >,  /* 589 */
		< 0 IRQ_TYPE_DEFAULT >,  /* 590 */
		< 0 IRQ_TYPE_DEFAULT >,  /* 591 */
		< 0 IRQ_TYPE_DEFAULT >,  /* 592 */
		< 0 IRQ_TYPE_DEFAULT >,  /* 593 */
		< 0 IRQ_TYPE_DEFAULT >,  /* 594 */
		< 0 IRQ_TYPE_DEFAULT >,  /* 595 */
		< 0 IRQ_TYPE_DEFAULT >,  /* 596 */
		< 0 IRQ_TYPE_DEFAULT >,  /* 597 */
		< 0 IRQ_TYPE_DEFAULT >,  /* 598 */
		< 0 IRQ_TYPE_DEFAULT >,  /* 599 */
		< 0 IRQ_TYPE_DEFAULT >,  /* 600 */
		< 0 IRQ_TYPE_DEFAULT >,  /* 601 */
		< 0 IRQ_TYPE_DEFAULT >,  /* 602 */
		< 0 IRQ_TYPE_DEFAULT >,  /* 603 */
		< 0 IRQ_TYPE_DEFAULT >,  /* 604 */
		< 0 IRQ_TYPE_DEFAULT >,  /* 605 */
		< 0 IRQ_TYPE_DEFAULT >,  /* 606 */
		< 0 IRQ_TYPE_DEFAULT >,  /* 607 */
		< 0 IRQ_TYPE_DEFAULT >,  /* 608 */
		< 0 IRQ_TYPE_DEFAULT >,  /* 609 */
		< 0 IRQ_TYPE_DEFAULT >,  /* 610 */
		< 0 IRQ_TYPE_DEFAULT >,  /* 611 */
		< 0 IRQ_TYPE_DEFAULT >,  /* 612 */
		< 0 IRQ_TYPE_DEFAULT >,  /* 613 */
		< 0 IRQ_TYPE_DEFAULT >,  /* 614 */
		< 0 IRQ_TYPE_DEFAULT >,  /* 615 */
		< 0 IRQ_TYPE_DEFAULT >,  /* 616 */
		< 0 IRQ_TYPE_DEFAULT >,  /* 617 */
		< 0 IRQ_TYPE_DEFAULT >,  /* 618 */
		< 0 IRQ_TYPE_DEFAULT >,  /* 619 */
		< 0 IRQ_TYPE_DEFAULT >,  /* 620 */
		< 0 IRQ_TYPE_DEFAULT >,  /* 621 */
		< 0 IRQ_TYPE_DEFAULT >,  /* 622 */
		< 0 IRQ_TYPE_DEFAULT >,  /* 623 */
		< 0 IRQ_TYPE_DEFAULT >,  /* 624 */
		< 0 IRQ_TYPE_DEFAULT >,  /* 625 */
		< 0 IRQ_TYPE_DEFAULT >,  /* 626 */
		< 0 IRQ_TYPE_DEFAULT >,  /* 627 */
		< 0 IRQ_TYPE_DEFAULT >,  /* 628 */
		< 0 IRQ_TYPE_DEFAULT >,  /* 629 */
		< 0 IRQ_TYPE_DEFAULT >,  /* 630 */
		< 0 IRQ_TYPE_DEFAULT >,  /* 631 */
		< 0 IRQ_TYPE_DEFAULT >,  /* 632 */
		< 0 IRQ_TYPE_DEFAULT >,  /* 633 */
		< 0 IRQ_TYPE_DEFAULT >,  /* 634 */
		< 0 IRQ_TYPE_DEFAULT >,  /* 635 */
		< 0 IRQ_TYPE_DEFAULT >,  /* 636 */
		< 0 IRQ_TYPE_DEFAULT >,  /* 637 */
		< 0 IRQ_TYPE_DEFAULT >,  /* 638 */
		< 0 IRQ_TYPE_DEFAULT >,  /* 639 */
		< 0 IRQ_TYPE_DEFAULT >,  /* 640 */
		< 0 IRQ_TYPE_DEFAULT >,  /* 641 */
		< 0 IRQ_TYPE_DEFAULT >,  /* 642 */
		< 0 IRQ_TYPE_DEFAULT >,  /* 643 */
		< 0 IRQ_TYPE_DEFAULT >,  /* 644 */
		< 0 IRQ_TYPE_DEFAULT >,  /* 645 */
		< 0 IRQ_TYPE_DEFAULT >,  /* 646 */
		< 0 IRQ_TYPE_DEFAULT >,  /* 647 */
		< 0 IRQ_TYPE_DEFAULT >,  /* 648 */
		< 0 IRQ_TYPE_DEFAULT >,  /* 649 */
		< 0 IRQ_TYPE_DEFAULT >,  /* 650 */
		< 0 IRQ_TYPE_DEFAULT >,  /* 651 */
		< 0 IRQ_TYPE_DEFAULT >,  /* 652 */
		< 0 IRQ_TYPE_DEFAULT >,  /* 653 */
		< 0 IRQ_TYPE_DEFAULT >,  /* 654 */
		< 0 IRQ_TYPE_DEFAULT >,  /* 655 */
		< 0 IRQ_TYPE_DEFAULT >,  /* 656 */
		< 0 IRQ_TYPE_DEFAULT >,  /* 657 */
		< 0 IRQ_TYPE_DEFAULT >,  /* 658 */
		< 0 IRQ_TYPE_DEFAULT >,  /* 659 */
		< 0 IRQ_TYPE_DEFAULT >,  /* 660 */
		< 0 IRQ_TYPE_DEFAULT >,  /* 661 */
		< 0 IRQ_TYPE_DEFAULT >,  /* 662 */
		< 0 IRQ_TYPE_DEFAULT >,  /* 663 */
		< 0 IRQ_TYPE_DEFAULT >,  /* 664 */
		< 0 IRQ_TYPE_DEFAULT >,  /* 665 */
		< 0 IRQ_TYPE_DEFAULT >,  /* 666 */
		< 0 IRQ_TYPE_DEFAULT >,  /* 667 */
		< 0 IRQ_TYPE_DEFAULT >,  /* 668 */
		< 0 IRQ_TYPE_DEFAULT >,  /* 669 */
		< 0 IRQ_TYPE_DEFAULT >,  /* 670 */
		< 0 IRQ_TYPE_DEFAULT >,  /* 671 */
		< 0 IRQ_TYPE_DEFAULT >,  /* 672 */
		< 0 IRQ_TYPE_DEFAULT >,  /* 673 */
		< 0 IRQ_TYPE_DEFAULT >,  /* 674 */
		< 0 IRQ_TYPE_DEFAULT >,  /* 675 */
		< 0 IRQ_TYPE_DEFAULT >,  /* 676 */
		< 0 IRQ_TYPE_DEFAULT >,  /* 677 */
		< 0 IRQ_TYPE_DEFAULT >,  /* 678 */
		< 0 IRQ_TYPE_DEFAULT >,  /* 679 */
		< 0 IRQ_TYPE_DEFAULT >,  /* 680 */
		< 0 IRQ_TYPE_DEFAULT >,  /* 681 */
		< 0 IRQ_TYPE_DEFAULT >,  /* 682 */
		< 0 IRQ_TYPE_DEFAULT >,  /* 683 */
		< 0 IRQ_TYPE_DEFAULT >,  /* 684 */
		< 0 IRQ_TYPE_DEFAULT >,  /* 685 */
		< 0 IRQ_TYPE_DEFAULT >,  /* 686 */
		< 0 IRQ_TYPE_DEFAULT >,  /* 687 */
		< 0 IRQ_TYPE_DEFAULT >,  /* 688 */
		< 0 IRQ_TYPE_DEFAULT >,  /* 689 */
		< 0 IRQ_TYPE_DEFAULT >,  /* 690 */
		< 0 IRQ_TYPE_DEFAULT >,  /* 691 */
		< 0 IRQ_TYPE_DEFAULT >,  /* 692 */
		< 0 IRQ_TYPE_DEFAULT >,  /* 693 */
		< 0 IRQ_TYPE_DEFAULT >,  /* 694 */
		< 0 IRQ_TYPE_DEFAULT >,  /* 695 */
		< 0 IRQ_TYPE_DEFAULT >,  /* 696 */
		< 0 IRQ_TYPE_DEFAULT >,  /* 697 */
		< 0 IRQ_TYPE_DEFAULT >,  /* 698 */
		< 0 IRQ_TYPE_DEFAULT >,  /* 699 */
		< 0 IRQ_TYPE_DEFAULT >,  /* 700 */
		< 0 IRQ_TYPE_DEFAULT >,  /* 701 */
		< 0 IRQ_TYPE_DEFAULT >,  /* 702 */
		< 0 IRQ_TYPE_DEFAULT >,  /* 703 */
		< 0 IRQ_TYPE_DEFAULT >,  /* 704 */
		< 0 IRQ_TYPE_DEFAULT >,  /* 705 */
		< 0 IRQ_TYPE_DEFAULT >,  /* 706 */
		< 0 IRQ_TYPE_DEFAULT >,  /* 707 */
		< 0 IRQ_TYPE_DEFAULT >,  /* 708 */
		< 0 IRQ_TYPE_DEFAULT >,  /* 709 */
		< 0 IRQ_TYPE_DEFAULT >,  /* 710 */
		< 0 IRQ_TYPE_DEFAULT >,  /* 711 */
		< 0 IRQ_TYPE_DEFAULT >,  /* 712 */
		< 0 IRQ_TYPE_DEFAULT >,  /* 713 */
		< 0 IRQ_TYPE_DEFAULT >,  /* 714 */
		< 0 IRQ_TYPE_DEFAULT >,  /* 715 */
		< 0 IRQ_TYPE_DEFAULT >,  /* 716 */
		< 0 IRQ_TYPE_DEFAULT >,  /* 717 */
		< 0 IRQ_TYPE_DEFAULT >,  /* 718 */
		< 0 IRQ_TYPE_DEFAULT >,  /* 719 */
		< 0 IRQ_TYPE_DEFAULT >,  /* 720 */
		< 0 IRQ_TYPE_DEFAULT >,  /* 721 */
		< 0 IRQ_TYPE_DEFAULT >,  /* 722 */
		< 0 IRQ_TYPE_DEFAULT >,  /* 723 */
		< 0 IRQ_TYPE_DEFAULT >,  /* 724 */
		< 0 IRQ_TYPE_DEFAULT >,  /* 725 */
		< 0 IRQ_TYPE_DEFAULT >,  /* 726 */
		< 0 IRQ_TYPE_DEFAULT >,  /* 727 */
		< 0 IRQ_TYPE_DEFAULT >,  /* 728 */
		< 0 IRQ_TYPE_DEFAULT >,  /* 729 */
		< 0 IRQ_TYPE_DEFAULT >,  /* 730 */
		< 0 IRQ_TYPE_DEFAULT >,  /* 731 */
		< 0 IRQ_TYPE_DEFAULT >,  /* 732 */
		< 0 IRQ_TYPE_DEFAULT >,  /* 733 */
		< 0 IRQ_TYPE_DEFAULT >,  /* 734 */
		< 0 IRQ_TYPE_DEFAULT >,  /* 735 */
		< 0 IRQ_TYPE_DEFAULT >,  /* 736 */
		< 0 IRQ_TYPE_DEFAULT >,  /* 737 */
		< 0 IRQ_TYPE_DEFAULT >,  /* 738 */
		< 0 IRQ_TYPE_DEFAULT >,  /* 739 */
		< 0 IRQ_TYPE_DEFAULT >,  /* 740 */
		< 0 IRQ_TYPE_DEFAULT >,  /* 741 */
		< 0 IRQ_TYPE_DEFAULT >,  /* 742 */
		< 0 IRQ_TYPE_DEFAULT >,  /* 743 */
		< 0 IRQ_TYPE_DEFAULT >,  /* 744 */
		< 0 IRQ_TYPE_DEFAULT >,  /* 745 */
		< 0 IRQ_TYPE_DEFAULT >,  /* 746 */
		< 0 IRQ_TYPE_DEFAULT >,  /* 747 */
		< 0 IRQ_TYPE_DEFAULT >,  /* 748 */
		< 0 IRQ_TYPE_DEFAULT >,  /* 749 */
		< 0 IRQ_TYPE_DEFAULT >,  /* 750 */
		< 0 IRQ_TYPE_DEFAULT >,  /* 751 */
		< 0 IRQ_TYPE_DEFAULT >,  /* 752 */
		< 0 IRQ_TYPE_DEFAULT >,  /* 753 */
		< 0 IRQ_TYPE_DEFAULT >,  /* 754 */
		< 0 IRQ_TYPE_DEFAULT >,  /* 755 */
		< 0 IRQ_TYPE_DEFAULT >,  /* 756 */
		< 0 IRQ_TYPE_DEFAULT >,  /* 757 */
		< 0 IRQ_TYPE_DEFAULT >,  /* 758 */
		< 0 IRQ_TYPE_DEFAULT >,  /* 759 */
		< 0 IRQ_TYPE_DEFAULT >,  /* 760 */
		< 0 IRQ_TYPE_DEFAULT >,  /* 761 */
		< 0 IRQ_TYPE_DEFAULT >,  /* 762 */
		< 0 IRQ_TYPE_DEFAULT >,  /* 763 */
		< 0 IRQ_TYPE_DEFAULT >,  /* 764 */
		< 0 IRQ_TYPE_DEFAULT >,  /* 765 */
		< 0 IRQ_TYPE_DEFAULT >,  /* 766 */
		< 0 IRQ_TYPE_DEFAULT >,  /* 767 */
		< 0 IRQ_TYPE_DEFAULT >,  /* 768 */
		< 0 IRQ_TYPE_DEFAULT >,  /* 769 */
		< 0 IRQ_TYPE_DEFAULT >,  /* 770 */
		< 0 IRQ_TYPE_DEFAULT >,  /* 771 */
		< 0 IRQ_TYPE_DEFAULT >,  /* 772 */
		< 0 IRQ_TYPE_DEFAULT >,  /* 773 */
		< 0 IRQ_TYPE_DEFAULT >,  /* 774 */
		< 0 IRQ_TYPE_DEFAULT >,  /* 775 */
		< 0 IRQ_TYPE_DEFAULT >,  /* 776 */
		< 0 IRQ_TYPE_DEFAULT >,  /* 777 */
		< 0 IRQ_TYPE_DEFAULT >,  /* 778 */
		< 0 IRQ_TYPE_DEFAULT >,  /* 779 */
		< 0 IRQ_TYPE_DEFAULT >,  /* 780 */
		< 0 IRQ_TYPE_DEFAULT >,  /* 781 */
		< 0 IRQ_TYPE_DEFAULT >,  /* 782 */
		< 0 IRQ_TYPE_DEFAULT >,  /* 783 */
		< 0 IRQ_TYPE_DEFAULT >,  /* 784 */
		< 0 IRQ_TYPE_DEFAULT >,  /* 785 */
		< 0 IRQ_TYPE_DEFAULT >,  /* 786 */
		< 0 IRQ_TYPE_DEFAULT >,  /* 787 */
		< 0 IRQ_TYPE_DEFAULT >,  /* 788 */
		< 0 IRQ_TYPE_DEFAULT >,  /* 789 */
		< 0 IRQ_TYPE_DEFAULT >,  /* 790 */
		< 0 IRQ_TYPE_DEFAULT >,  /* 791 */
		< 0 IRQ_TYPE_DEFAULT >,  /* 792 */
		< 0 IRQ_TYPE_DEFAULT >,  /* 793 */
		< 0 IRQ_TYPE_DEFAULT >,  /* 794 */
		< 0 IRQ_TYPE_DEFAULT >,  /* 795 */
		< 0 IRQ_TYPE_DEFAULT >,  /* 796 */
		< 0 IRQ_TYPE_DEFAULT >,  /* 797 */
		< 0 IRQ_TYPE_DEFAULT >,  /* 798 */
		< 0 IRQ_TYPE_DEFAULT >,  /* 799 */
		< 0 IRQ_TYPE_DEFAULT >,  /* 800 */
		< 0 IRQ_TYPE_DEFAULT >,  /* 801 */
		< 0 IRQ_TYPE_DEFAULT >,  /* 802 */
		< 0 IRQ_TYPE_DEFAULT >,  /* 803 */
		< 0 IRQ_TYPE_DEFAULT >,  /* 804 */
		< 0 IRQ_TYPE_DEFAULT >,  /* 805 */
		< 0 IRQ_TYPE_DEFAULT >,  /* 806 */
		< 0 IRQ_TYPE_DEFAULT >,  /* 807 */
		< 0 IRQ_TYPE_DEFAULT >,  /* 808 */
		< 0 IRQ_TYPE_DEFAULT >,  /* 809 */
		< 0 IRQ_TYPE_DEFAULT >,  /* 810 */
		< 0 IRQ_TYPE_DEFAULT >,  /* 811 */
		< 0 IRQ_TYPE_DEFAULT >,  /* 812 */
		< 0 IRQ_TYPE_DEFAULT >,  /* 813 */
		< 0 IRQ_TYPE_DEFAULT >,  /* 814 */
		< 0 IRQ_TYPE_DEFAULT >,  /* 815 */
		< 0 IRQ_TYPE_DEFAULT >,  /* 816 */
		< 0 IRQ_TYPE_DEFAULT >,  /* 817 */
		< 0 IRQ_TYPE_DEFAULT >,  /* 818 */
		< 0 IRQ_TYPE_DEFAULT >,  /* 819 */
		< 0 IRQ_TYPE_DEFAULT >,  /* 820 */
		< 0 IRQ_TYPE_DEFAULT >,  /* 821 */
		< 0 IRQ_TYPE_DEFAULT >,  /* 822 */
		< 0 IRQ_TYPE_DEFAULT >,  /* 823 */
		< 0 IRQ_TYPE_DEFAULT >,  /* 824 */
		< 0 IRQ_TYPE_DEFAULT >,  /* 825 */
		< 0 IRQ_TYPE_DEFAULT >,  /* 826 */
		< 0 IRQ_TYPE_DEFAULT >,  /* 827 */
		< 0 IRQ_TYPE_DEFAULT >,  /* 828 */
		< 0 IRQ_TYPE_DEFAULT >,  /* 829 */
		< 0 IRQ_TYPE_DEFAULT >,  /* 830 */
		< 0 IRQ_TYPE_DEFAULT >,  /* 831 */
		< 0 IRQ_TYPE_DEFAULT >,  /* 832 */
		< 0 IRQ_TYPE_DEFAULT >,  /* 833 */
		< 0 IRQ_TYPE_DEFAULT >,  /* 834 */
		< 0 IRQ_TYPE_DEFAULT >,  /* 835 */
		< 0 IRQ_TYPE_DEFAULT >,  /* 836 */
		< 0 IRQ_TYPE_DEFAULT >,  /* 837 */
		< 0 IRQ_TYPE_DEFAULT >,  /* 838 */
		< 0 IRQ_TYPE_DEFAULT >,  /* 839 */
		< 0 IRQ_TYPE_DEFAULT >,  /* 840 */
		< 0 IRQ_TYPE_DEFAULT >,  /* 841 */
		< 0 IRQ_TYPE_DEFAULT >,  /* 842 */
		< 0 IRQ_TYPE_DEFAULT >,  /* 843 */
		< 0 IRQ_TYPE_DEFAULT >,  /* 844 */
		< 0 IRQ_TYPE_DEFAULT >,  /* 845 */
		< 0 IRQ_TYPE_DEFAULT >,  /* 846 */
		< 0 IRQ_TYPE_DEFAULT >,  /* 847 */
		< 0 IRQ_TYPE_DEFAULT >,  /* 848 */
		< 0 IRQ_TYPE_DEFAULT >,  /* 849 */
		< 0 IRQ_TYPE_DEFAULT >,  /* 850 */
		< 0 IRQ_TYPE_DEFAULT >,  /* 851 */
		< 0 IRQ_TYPE_DEFAULT >,  /* 852 */
		< 0 IRQ_TYPE_DEFAULT >,  /* 853 */
		< 0 IRQ_TYPE_DEFAULT >,  /* 854 */
		< 0 IRQ_TYPE_DEFAULT >,  /* 855 */
		< 0 IRQ_TYPE_DEFAULT >,  /* 856 */
		< 0 IRQ_TYPE_DEFAULT >,  /* 857 */
		< 0 IRQ_TYPE_DEFAULT >,  /* 858 */
		< 0 IRQ_TYPE_DEFAULT >,  /* 859 */
		< 0 IRQ_TYPE_DEFAULT >,  /* 860 */
		< 0 IRQ_TYPE_DEFAULT >,  /* 861 */
		< 0 IRQ_TYPE_DEFAULT >,  /* 862 */
		< 0 IRQ_TYPE_DEFAULT >,  /* 863 */
		< 0 IRQ_TYPE_DEFAULT >,  /* 864 */
		< 0 IRQ_TYPE_DEFAULT >,  /* 865 */
		< 0 IRQ_TYPE_DEFAULT >,  /* 866 */
		< 0 IRQ_TYPE_DEFAULT >,  /* 867 */
		< 0 IRQ_TYPE_DEFAULT >,  /* 868 */
		< 0 IRQ_TYPE_DEFAULT >,  /* 869 */
		< 0 IRQ_TYPE_DEFAULT >,  /* 870 */
		< 0 IRQ_TYPE_DEFAULT >,  /* 871 */
		< 0 IRQ_TYPE_DEFAULT >,  /* 872 */
		< 0 IRQ_TYPE_DEFAULT >,  /* 873 */
		< 0 IRQ_TYPE_DEFAULT >,  /* 874 */
		< 0 IRQ_TYPE_DEFAULT >,  /* 875 */
		< 0 IRQ_TYPE_DEFAULT >,  /* 876 */
		< 0 IRQ_TYPE_DEFAULT >,  /* 877 */
		< 0 IRQ_TYPE_DEFAULT >,  /* 878 */
		< 0 IRQ_TYPE_DEFAULT >,  /* 879 */
		< 0 IRQ_TYPE_DEFAULT >,  /* 880 */
		< 0 IRQ_TYPE_DEFAULT >,  /* 881 */
		< 0 IRQ_TYPE_DEFAULT >,  /* 882 */
		< 0 IRQ_TYPE_DEFAULT >,  /* 883 */
		< 0 IRQ_TYPE_DEFAULT >,  /* 884 */
		< 0 IRQ_TYPE_DEFAULT >,  /* 885 */
		< 0 IRQ_TYPE_DEFAULT >,  /* 886 */
		< 0 IRQ_TYPE_DEFAULT >,  /* 887 */
		< 0 IRQ_TYPE_DEFAULT >,  /* 888 */
		< 0 IRQ_TYPE_DEFAULT >,  /* 889 */
		< 0 IRQ_TYPE_DEFAULT >,  /* 890 */
		< 0 IRQ_TYPE_DEFAULT >,  /* 891 */
		< 0 IRQ_TYPE_DEFAULT >,  /* 892 */
		< 0 IRQ_TYPE_DEFAULT >,  /* 893 */
		< 0 IRQ_TYPE_DEFAULT >,  /* 894 */
		< 0 IRQ_TYPE_DEFAULT >,  /* 895 */
		< 0 IRQ_TYPE_DEFAULT >,  /* 896 */
		< 0 IRQ_TYPE_DEFAULT >,  /* 897 */
		< 0 IRQ_TYPE_DEFAULT >,  /* 898 */
		< 0 IRQ_TYPE_DEFAULT >,  /* 899 */
		< 0 IRQ_TYPE_DEFAULT >,  /* 900 */
		< 0 IRQ_TYPE_DEFAULT >,  /* 901 */
		< 0 IRQ_TYPE_DEFAULT >,  /* 902 */
		< 0 IRQ_TYPE_DEFAULT >,  /* 903 */
		< 0 IRQ_TYPE_DEFAULT >,  /* 904 */
		< 0 IRQ_TYPE_DEFAULT >,  /* 905 */
		< 0 IRQ_TYPE_DEFAULT >,  /* 906 */
		< 0 IRQ_TYPE_DEFAULT >,  /* 907 */
		< 0 IRQ_TYPE_DEFAULT >,  /* 908 */
		< 0 IRQ_TYPE_DEFAULT >,  /* 909 */
		< 0 IRQ_TYPE_DEFAULT >,  /* 910 */
		< 0 IRQ_TYPE_DEFAULT >,  /* 911 */
		< 0 IRQ_TYPE_DEFAULT >,  /* 912 */
		< 0 IRQ_TYPE_DEFAULT >,  /* 913 */
		< 0 IRQ_TYPE_DEFAULT >,  /* 914 */
		< 0 IRQ_TYPE_DEFAULT >,  /* 915 */
		< 0 IRQ_TYPE_DEFAULT >,  /* 916 */
		< 0 IRQ_TYPE_DEFAULT >,  /* 917 */
		< 0 IRQ_TYPE_DEFAULT >,  /* 918 */
		< 0 IRQ_TYPE_DEFAULT >,  /* 919 */
		< 0 IRQ_TYPE_DEFAULT >,  /* 920 */
		< 0 IRQ_TYPE_DEFAULT >,  /* 921 */
		< 0 IRQ_TYPE_DEFAULT >,  /* 922 */
		< 0 IRQ_TYPE_DEFAULT >,  /* 923 */
		< 0 IRQ_TYPE_DEFAULT >,  /* 924 */
		< 0 IRQ_TYPE_DEFAULT >,  /* 925 */
		< 0 IRQ_TYPE_DEFAULT >,  /* 926 */
		< 0 IRQ_TYPE_DEFAULT >,  /* 927 */
		< 0 IRQ_TYPE_DEFAULT >,  /* 928 */
		< 0 IRQ_TYPE_DEFAULT >,  /* 929 */
		< 0 IRQ_TYPE_DEFAULT >,  /* 930 */
		< 0 IRQ_TYPE_DEFAULT >,  /* 931 */
		< 0 IRQ_TYPE_DEFAULT >,  /* 932 */
		< 0 IRQ_TYPE_DEFAULT >,  /* 933 */
		< 0 IRQ_TYPE_DEFAULT >,  /* 934 */
		< 0 IRQ_TYPE_DEFAULT >,  /* 935 */
		< 0 IRQ_TYPE_DEFAULT >,  /* 936 */
		< 0 IRQ_TYPE_DEFAULT >,  /* 937 */
		< 0 IRQ_TYPE_DEFAULT >,  /* 938 */
		< 0 IRQ_TYPE_DEFAULT >,  /* 939 */
		< 0 IRQ_TYPE_DEFAULT >,  /* 940 */
		< 0 IRQ_TYPE_DEFAULT >,  /* 941 */
		< 0 IRQ_TYPE_DEFAULT >,  /* 942 */
		< 0 IRQ_TYPE_DEFAULT >,  /* 943 */
		< 0 IRQ_TYPE_DEFAULT >,  /* 944 */
		< 0 IRQ_TYPE_DEFAULT >,  /* 945 */
		< 0 IRQ_TYPE_DEFAULT >,  /* 946 */
		< 0 IRQ_TYPE_DEFAULT >,  /* 947 */
		< 0 IRQ_TYPE_DEFAULT >,  /* 948 */
		< 0 IRQ_TYPE_DEFAULT >,  /* 949 */
		< 0 IRQ_TYPE_DEFAULT >,  /* 950 */
		< 0 IRQ_TYPE_DEFAULT >,  /* 951 */
		< 0 IRQ_TYPE_DEFAULT >,  /* 952 */
		< 0 IRQ_TYPE_DEFAULT >,  /* 953 */
		< 0 IRQ_TYPE_DEFAULT >,  /* 954 */
		< 0 IRQ_TYPE_DEFAULT >,  /* 955 */
		< 0 IRQ_TYPE_DEFAULT >,  /* 956 */
		< 0 IRQ_TYPE_DEFAULT >,  /* 957 */
		< 0 IRQ_TYPE_DEFAULT >,  /* 958 */
		< 0 IRQ_TYPE_DEFAULT >,  /* 959 */
		< 0 IRQ_TYPE_DEFAULT >,  /* 960 */
		< 0 IRQ_TYPE_DEFAULT >,  /* 961 */
		< 0 IRQ_TYPE_DEFAULT >,  /* 962 */
		< 0 IRQ_TYPE_DEFAULT >,  /* 963 */
		< 0 IRQ_TYPE_DEFAULT >,  /* 964 */
		< 0 IRQ_TYPE_DEFAULT >,  /* 965 */
		< 0 IRQ_TYPE_DEFAULT >,  /* 966 */
		< 0 IRQ_TYPE_DEFAULT >,  /* 967 */
		< 0 IRQ_TYPE_DEFAULT >,  /* 968 */
		< 0 IRQ_TYPE_DEFAULT >,  /* 969 */
		< 0 IRQ_TYPE_DEFAULT >,  /* 970 */
		< 0 IRQ_TYPE_DEFAULT >,  /* 971 */
		< 0 IRQ_TYPE_DEFAULT >,  /* 972 */
		< 0 IRQ_TYPE_DEFAULT >,  /* 973 */
		< 0 IRQ_TYPE_DEFAULT >,  /* 974 */
		< 0 IRQ_TYPE_DEFAULT >,  /* 975 */
		< 0 IRQ_TYPE_DEFAULT >,  /* 976 */
		< 0 IRQ_TYPE_DEFAULT >,  /* 977 */
		< 0 IRQ_TYPE_DEFAULT >,  /* 978 */
		< 0 IRQ_TYPE_DEFAULT >,  /* 979 */
		< 0 IRQ_TYPE_DEFAULT >,  /* 980 */
		< 0 IRQ_TYPE_DEFAULT >,  /* 981 */
		< 0 IRQ_TYPE_DEFAULT >,  /* 982 */
		< 0 IRQ_TYPE_DEFAULT >,  /* 983 */
		< 0 IRQ_TYPE_DEFAULT >,  /* 984 */
		< 0 IRQ_TYPE_DEFAULT >,  /* 985 */
		< 0 IRQ_TYPE_DEFAULT >,  /* 986 */
		< 0 IRQ_TYPE_DEFAULT >,  /* 987 */
		< 0 IRQ_TYPE_DEFAULT >,  /* 988 */
		< 0 IRQ_TYPE_DEFAULT >,  /* 989 */
		< 0 IRQ_TYPE_DEFAULT >,  /* 990 */
		< 0 IRQ_TYPE_DEFAULT >,  /* 991 */
		< 0 IRQ_TYPE_DEFAULT >,  /* 992 */
		< 0 IRQ_TYPE_DEFAULT >,  /* 993 */
		< 0 IRQ_TYPE_DEFAULT >,  /* 994 */
		< 0 IRQ_TYPE_DEFAULT >,  /* 995 */
		< 0 IRQ_TYPE_DEFAULT >,  /* 996 */
		< 0 IRQ_TYPE_DEFAULT >,  /* 997 */
		< 0 IRQ_TYPE_DEFAULT >,  /* 998 */
		< 0 IRQ_TYPE_DEFAULT >,  /* 999 */
		< 0 IRQ_TYPE_DEFAULT >,  /* 1000 */
		< 0 IRQ_TYPE_DEFAULT >,  /* 1001 */
		< 0 IRQ_TYPE_DEFAULT >,  /* 1002 */
		< 0 IRQ_TYPE_DEFAULT >,  /* 1003 */
		< 0 IRQ_TYPE_DEFAULT >,  /* 1004 */
		< 0 IRQ_TYPE_DEFAULT >,  /* 1005 */
		< 0 IRQ_TYPE_DEFAULT >,  /* 1006 */
		< 0 IRQ_TYPE_DEFAULT >,  /* 1007 */
		< 0 IRQ_TYPE_DEFAULT >,  /* 1008 */
		< 0 IRQ_TYPE_DEFAULT >,  /* 1009 */
		< 0 IRQ_TYPE_DEFAULT >,  /* 1010 */
		< 0 IRQ_TYPE_DEFAULT >,  /* 1011 */
		< 0 IRQ_TYPE_DEFAULT >,  /* 1012 */
		< 0 IRQ_TYPE_DEFAULT >,  /* 1013 */
		< 0 IRQ_TYPE_DEFAULT >,  /* 1014 */
		< 0 IRQ_TYPE_DEFAULT >,  /* 1015 */
		< 0 IRQ_TYPE_DEFAULT >,  /* 1016 */
		< 0 IRQ_TYPE_DEFAULT >,  /* 1017 */
		< 0 IRQ_TYPE_DEFAULT >,  /* 1018 */
		< 0 IRQ_TYPE_DEFAULT >,  /* 1019 */
		< 0 IRQ_TYPE_DEFAULT >,  /* 1020 */
		< 0 IRQ_TYPE_DEFAULT >,  /* 1021 */
		< 0 IRQ_TYPE_DEFAULT >,  /* 1022 */
		< 0 IRQ_TYPE_DEFAULT >;  /* 1023 */

	intel,hirq_offset = <512>;
	intel,hirq = <HIRQ>;
};
#endif
