#ifndef CPUFREQ_CLOCK_LATENCY_US
#define CPUFREQ_CLOCK_LATENCY_US 50000
#endif
cpufreq:cpufreq {
		compatible = "intel,xgold-cpufreq";
		clocks = <&clk_cpu>,<&MUX_CPU>,<&B_0_1>,<&G_0_1>;
		clock-names = "core","mux","pll","bank";
		#ifdef SOFIA_3GR_GARNET_4_LEVEL_CPUFREQ
		#ifdef SOFIA_3GR_ES_2.0
		intel,cpufreq-table = <416000 728000 900000 1160000>;
                #else
		intel,cpufreq-table = <416000 728000 900000 1040000>;
                #endif
		#else
		#ifdef SOFIA_3GR_ES_2.0
		intel,cpufreq-table = <416000 900000 1160000>;
                #else
		intel,cpufreq-table = <416000 900000 1040000>;
                #endif
		#endif
		intel,table-from-vmm;
		intel,start-freq-limits = <416000 900000>;
		intel,clock_latency = <CPUFREQ_CLOCK_LATENCY_US>;
		#address-cells = < 0 >;
		interrupts = < 0 >;
		interrupt-parent = <&cpufreq>;
		#interrupt-cells = < 1 >;
		interrupt-map = < 0 &hirq HIRQ_CPU_CLK_NOTIFY IRQ_TYPE_DEFAULT>;
		interrupt-names = "CPU_CLK_CHANGE";
	};
