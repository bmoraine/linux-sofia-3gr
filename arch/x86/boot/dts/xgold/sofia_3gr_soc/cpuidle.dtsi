		 idle-states {
#if defined(USE_LAPIC_TIMER)
			S0 {
				compatible = "intel,sofia,idle-state";
				desc = "mclk un-gated in MC4";
				power-usage = <37>;
				exit-latency = <20>;
				target-residency= <35>; /* 15+20 (entry+exit) */
				flags = <1>;	/* CPUIDLE_FLAG_TIME_VALID */
				vmm-id = <0>; /* Disable MCLK gating */
			};
			S1 {
#else
			S0 {
#endif
				compatible = "intel,sofia,idle-state";
				desc = "mclk gated in MC4";
				power-usage = <3>;
				exit-latency = <22>;
				target-residency = <50>; /* 15+20 (entry+exit+broadcast overhead) */
				/*
				 * CPUIDLE_FLAG_TIMER_STOP must be enabled only if timer is
				 * disabled during idle.
				 * This is true for LAPIC Timer on Sofia3g and Sofia3gr.
				 */

				flags = <1>;	/* CPUIDLE_FLAG_TIME_VALID */
				vmm-id = <1>; /* Enable MCLK gating */
			};
		};

