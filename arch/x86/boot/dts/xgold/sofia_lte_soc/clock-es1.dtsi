clocks {
	compatible = "intel,xgold-clock";
	intel,reg-phys = <&cgu>;
	intel,reg-defaults = <752 0x30 131248 0x0 652 0x0 688 0xCBFFFF5A 131252 0x10 656 0x0 692 0x150100 648 0x0>;
	intel,vreq-mapping = <1 2 3>;
	intel,cpu-vreq = <696 6 2>;
	intel,global-vreq = <696 8 2>;
	OFF:OFF {
		compatible = "fixed-clock";
		#clock-cells = <0>;
		clock-frequency= <0>;
		clock-output-names = "OFF";
	};
	RTC_0_1:RTC_0_1 {
		compatible = "fixed-clock";
		#clock-cells = <0>;
		clock-frequency= <32000>;
		clock-output-names = "RTC_0_1";
	};
	IN_0_1:IN_0_1 {
		compatible = "fixed-clock";
		#clock-cells = <0>;
		clock-frequency= <26000000>;
		clock-output-names = "IN_0_1";
	};
	IN2_0_1:IN2_0_1 {
		compatible = "fixed-clock";
		#clock-cells = <0>;
		clock-frequency= <26000000>;
		clock-output-names = "IN2_0_1";
	};
	A_0_1:A_0_1 {
		compatible = "intel,xgold-pll";
		#clock-cells = <0>;
		clock-frequency= <416000000>;
		clock-output-names = "A_0_1";
		clocks = <&IN_0_1>;
		clock-names = "ref";
		intel,pll-type = "analog";
		intel,pll-parameters = < 15 0 >;
		intel,pll-mux = <131172 8 1>;
		intel,pll-mult = <131168 16 8>;
		intel,pll-up = <131168 0 1>;
		intel,pll-div = <131168 12 4>;
		intel,pll-status-lock = <131232 0 1>;
		intel,pll-status-mux = <131236 8 1>;
	};
	B_0_1:B_0_1 {
/*		compatible = "intel,xgold-pll";*/
		#clock-cells = <0>;
		clock-frequency= <1040000000>;
		clock-output-names = "B_0_1";
		clocks = <&IN_0_1>;
		clock-names = "ref";
		intel,flags-cpu;
		intel,flags-ignore-unused;
		intel,pll-type = "analog";
		intel,pll-parameters = < 39 0 >;
		intel,pll-mux = <131176 8 1>;
		intel,pll-mult = <131176 16 8>;
		intel,pll-up = <131176 0 1>;
		intel,pll-div = <131176 12 4>;
		intel,pll-status-lock = <131232 1 1>;
	};
	C_0_1:C_0_1 {
/*		compatible = "intel,xgold-pll";*/
		#clock-cells = <0>;
		clock-frequency= <338000000>;
		clock-output-names = "C_0_1";
		clocks = <&IN_0_1>;
		clock-names = "ref";
		intel,pll-type = "analog";
		intel,pll-parameters = < 12 0 >;
		intel,pll-mux = <131180 8 1>;
		intel,pll-mult = <131180 16 8>;
		intel,pll-up = <131180 0 1>;
		intel,pll-div = <131180 12 4>;
		intel,pll-status-lock = <131232 2 1>;
	};
	F_0_1:F_0_1 {
/*		compatible = "intel,xgold-pll";*/
		#clock-cells = <0>;
		clock-frequency= <800000000>;
		clock-output-names = "F_0_1";
		clocks = <&IN_0_1>;
		clock-names = "ref";
		intel,flags-noinit;
		intel,flags-ignore-unused;
		intel,pll-type = "digital";
		intel,pll-parameters = < 1950956 1 >;
		intel,pll-mux = <131188 1 1>;
		intel,pll-mult = <131188 4 23>;
		intel,pll-up = <131188 0 1>;
		intel,pll-status-lock = <131232 5 1>;
		intel,pll-update = <131220 17 1>;
	};
	G_0_1:G_0_1 {
		compatible = "intel,xgold-pll";
		#clock-cells = <0>;
		clock-frequency= <456000000>;
		clock-output-names = "G_0_1";
		clocks = <&IN_0_1>;
		clock-names = "ref";
		intel,pll-type = "digital";
		intel,pll-parameters = < 1083865 1 >;
		intel,pll-mux = <131192 1 1>;
		intel,pll-mult = <131192 4 23>;
		intel,pll-up = <131192 0 1>;
		intel,pll-status-lock = <131232 6 1>;
		intel,pll-update = <131220 18 1>;
	};
	H_0_1:H_0_1 {
		compatible = "intel,xgold-pll";
		#clock-cells = <0>;
		clock-frequency= <273000000>;
		clock-output-names = "H_0_1";
		clocks = <&IN_0_1>;
		clock-names = "ref";
		intel,pll-type = "analog";
		intel,pll-parameters = < 20 1 >;
		intel,pll-mux = <131196 8 1>;
		intel,pll-mult = <131196 16 8>;
		intel,pll-up = <131196 0 1>;
		intel,pll-div = <131196 12 4>;
		intel,pll-status-lock = <131232 7 1>;
	};
	I_0_1:I_0_1 {
		compatible = "intel,xgold-pll";
		#clock-cells = <0>;
		clock-frequency= <256000000>;
		clock-output-names = "I_0_1";
		clocks = <&IN_0_1>;
		clock-names = "ref";
		intel,pll-type = "digital";
		intel,pll-sd-div = < 8388608 >;
		intel,pll-parameters = < 74206917 1 >;
		intel,pll-mux = <131200 1 1>;
		intel,pll-mult = <132172 0 30>;
		intel,pll-up = <131200 0 1>;
		intel,pll-status-lock = <131232 8 1>;
		intel,pll-update = <131220 19 1>;
	};
	K_0_1:K_0_1 {
/*		compatible = "intel,xgold-pll";*/
		#clock-cells = <0>;
		clock-frequency= <598000000>;
		clock-output-names = "K_0_1";
		clocks = <&IN_0_1>;
		clock-names = "ref";
		intel,pll-type = "analog";
		intel,pll-parameters = < 22 0 >;
		intel,pll-mux = <131204 8 1>;
		intel,pll-mult = <131204 16 8>;
		intel,pll-up = <131204 0 1>;
		intel,pll-div = <131204 12 4>;
		intel,pll-status-lock = <131232 9 1>;
	};
	M_0_1:M_0_1 {
/*		compatible = "intel,xgold-pll";*/
		#clock-cells = <0>;
		clock-frequency= <400000000>;
		clock-output-names = "M_0_1";
		clocks = <&IN_0_1>;
		clock-names = "ref";
		intel,pll-type = "digital";
		intel,pll-parameters = < 942710 1 >;
		intel,pll-mux = <131208 1 1>;
		intel,pll-mult = <131208 4 23>;
		intel,pll-up = <131208 0 1>;
		intel,pll-status-lock = <131232 10 1>;
		intel,pll-update = <131220 20 1>;
	};
	A_1_1:A_1_1 {
		compatible = "intel,xgold-phs";
		#clock-cells = <0>;
		clock-output-names = "A_1_1";
		clocks = <&A_0_1>;
		clock-names = "ref";
		intel,phs-parameters = < 2 1 >;
		intel,phs-mux = <131172 9 1>;
		intel,phs-Y = <131212 3 4>;
		intel,phs-up = <131172 1 1>;
		intel,phs-X = <131212 0 3>;
		intel,phs-status-up = <131236 1 1>;
		intel,phs-status-Y = <131240 3 4>;
		intel,phs-status-X = <131240 0 3>;
		intel,phs-status-mux = <131236 9 1>;
		intel,phs-update = <131220 0 1>;
	};
	A_2_1:A_2_1 {
		compatible = "intel,xgold-phs";
		#clock-cells = <0>;
		clock-output-names = "A_2_1";
		clocks = <&A_0_1>;
		clock-names = "ref";
		intel,phs-parameters = < 4 1 >;
		intel,phs-mux = <131172 10 1>;
		intel,phs-Y = <131212 11 4>;
		intel,phs-up = <131172 2 1>;
		intel,phs-X = <131212 8 3>;
		intel,phs-status-up = <131236 2 1>;
		intel,phs-status-Y = <131240 11 4>;
		intel,phs-status-X = <131240 8 3>;
		intel,phs-status-mux = <131236 10 1>;
		intel,phs-update = <131220 1 1>;
	};
	A_3_1:A_3_1 {
		compatible = "intel,xgold-phs";
		#clock-cells = <0>;
		clock-output-names = "A_3_1";
		clocks = <&A_0_1>;
		clock-names = "ref";
		intel,phs-parameters = < 1 2 >;
		intel,phs-mux = <131172 11 1>;
		intel,phs-Y = <131212 19 4>;
		intel,phs-up = <131172 3 1>;
		intel,phs-X = <131212 16 3>;
		intel,phs-status-up = <131236 3 1>;
		intel,phs-status-Y = <131240 19 4>;
		intel,phs-status-X = <131240 16 3>;
		intel,phs-status-mux = <131236 11 1>;
		intel,phs-update = <131220 2 1>;
	};
	A_4_1:A_4_1 {
		compatible = "intel,xgold-phs";
		#clock-cells = <0>;
		clock-output-names = "A_4_1";
		clocks = <&A_0_1>;
		clock-names = "ref";
		intel,phs-parameters = < 1 1 >;
		intel,phs-mux = <131172 12 1>;
		intel,phs-Y = <131212 27 4>;
		intel,phs-up = <131172 4 1>;
		intel,phs-X = <131212 24 3>;
		intel,phs-status-up = <131236 4 1>;
		intel,phs-status-Y = <131240 27 4>;
		intel,phs-status-X = <131240 24 3>;
		intel,phs-status-mux = <131236 12 1>;
		intel,phs-update = <131220 3 1>;
	};
	A_5_1:A_5_1 {
		compatible = "intel,xgold-phs";
		#clock-cells = <0>;
		clock-output-names = "A_5_1";
		clocks = <&A_0_1>;
		clock-names = "ref";
		intel,phs-parameters = < 3 1 >;
		intel,phs-mux = <131172 13 1>;
		intel,phs-Y = <131216 3 4>;
		intel,phs-up = <131172 5 1>;
		intel,phs-X = <131216 0 3>;
		intel,phs-status-up = <131236 5 1>;
		intel,phs-status-Y = <131244 3 4>;
		intel,phs-status-X = <131244 0 3>;
		intel,phs-status-mux = <131236 13 1>;
		intel,phs-update = <131220 5 1>;
	};
	A_6_1:A_6_1 {
		compatible = "intel,xgold-phs";
		#clock-cells = <0>;
		clock-output-names = "A_6_1";
		clocks = <&A_0_1>;
		clock-names = "ref";
		intel,phs-parameters = < 1 1 >;
		intel,phs-mux = <131172 14 1>;
		intel,phs-Y = <131216 11 4>;
		intel,phs-up = <131172 6 1>;
		intel,phs-X = <131216 8 3>;
		intel,phs-status-up = <131236 6 1>;
		intel,phs-status-Y = <131244 11 4>;
		intel,phs-status-X = <131244 8 3>;
		intel,phs-status-mux = <131236 14 1>;
		intel,phs-update = <131220 6 1>;
	};
	A_7_1:A_7_1 {
		compatible = "intel,xgold-phs";
		#clock-cells = <0>;
		clock-output-names = "A_7_1";
		clocks = <&A_0_1>;
		clock-names = "ref";
		intel,phs-parameters = < 1 7 >;
		intel,phs-mux = <131172 15 1>;
		intel,phs-Y = <131216 19 4>;
		intel,phs-up = <131172 7 1>;
		intel,phs-X = <131216 16 3>;
		intel,phs-status-up = <131236 7 1>;
		intel,phs-status-Y = <131244 19 4>;
		intel,phs-status-X = <131244 16 3>;
		intel,phs-status-mux = <131236 15 1>;
		intel,phs-update = <131220 7 1>;
	};
	A_0_z:A_0_z {
		compatible = "intel,xgold-divider";
		#clock-cells = <0>;
		clock-output-names = "A_0_z";
		clocks = <&A_0_1>;
		clock-names = "ref";
		intel,divider-type = "Natural";
		intel,divider-div = <131168 28 4>;
	};
	F_0_z:F_0_z {
		compatible = "intel,xgold-divider";
		#clock-cells = <0>;
		clock-output-names = "F_0_z";
		clocks = <&F_0_1>;
		clock-names = "ref";
		intel,divider-type = "Natural";
		intel,divider-div = <131188 28 4>;
	};
	A_0_2:A_0_2 {
		compatible = "intel,xgold-fixed-divider";
		#clock-cells = <0>;
		clock-output-names = "A_0_2";
		clocks = <&A_0_1>;
		clock-names = "ref";
		intel,divider = < 2 >;
		intel,mult = < 1 >;
	};
	A_0_4:A_0_4 {
		compatible = "intel,xgold-fixed-divider";
		#clock-cells = <0>;
		clock-output-names = "A_0_4";
		clocks = <&A_0_1>;
		clock-names = "ref";
		intel,divider = < 4 >;
		intel,mult = < 1 >;
	};
	A_0_6:A_0_6 {
		compatible = "intel,xgold-fixed-divider";
		#clock-cells = <0>;
		clock-output-names = "A_0_6";
		clocks = <&A_0_1>;
		clock-names = "ref";
		intel,divider = < 6 >;
		intel,mult = < 1 >;
	};
	A_0_8:A_0_8 {
		compatible = "intel,xgold-fixed-divider";
		#clock-cells = <0>;
		clock-output-names = "A_0_8";
		clocks = <&A_0_1>;
		clock-names = "ref";
		intel,divider = < 8 >;
		intel,mult = < 1 >;
	};
	A_0_13:A_0_13 {
		compatible = "intel,xgold-fixed-divider";
		#clock-cells = <0>;
		clock-output-names = "A_0_13";
		clocks = <&A_0_1>;
		clock-names = "ref";
		intel,divider = < 13 >;
		intel,mult = < 1 >;
	};
	A_1_2:A_1_2 {
		compatible = "intel,xgold-fixed-divider";
		#clock-cells = <0>;
		clock-output-names = "A_1_2";
		clocks = <&A_1_1>;
		clock-names = "ref";
		intel,divider = < 2 >;
		intel,mult = < 1 >;
	};
	A_1_4:A_1_4 {
		compatible = "intel,xgold-fixed-divider";
		#clock-cells = <0>;
		clock-output-names = "A_1_4";
		clocks = <&A_1_1>;
		clock-names = "ref";
		intel,divider = < 4 >;
		intel,mult = < 1 >;
	};
	A_1_5:A_1_5 {
		compatible = "intel,xgold-fixed-divider";
		#clock-cells = <0>;
		clock-output-names = "A_1_5";
		clocks = <&A_1_1>;
		clock-names = "ref";
		intel,divider = < 5 >;
		intel,mult = < 1 >;
	};
	A_1_8:A_1_8 {
		compatible = "intel,xgold-fixed-divider";
		#clock-cells = <0>;
		clock-output-names = "A_1_8";
		clocks = <&A_1_1>;
		clock-names = "ref";
		intel,divider = < 8 >;
		intel,mult = < 1 >;
	};
	A_2_2:A_2_2 {
		compatible = "intel,xgold-fixed-divider";
		#clock-cells = <0>;
		clock-output-names = "A_2_2";
		clocks = <&A_2_1>;
		clock-names = "ref";
		intel,divider = < 2 >;
		intel,mult = < 1 >;
	};
	A_2_4:A_2_4 {
		compatible = "intel,xgold-fixed-divider";
		#clock-cells = <0>;
		clock-output-names = "A_2_4";
		clocks = <&A_2_1>;
		clock-names = "ref";
		intel,divider = < 4 >;
		intel,mult = < 1 >;
	};
	A_3_2:A_3_2 {
		compatible = "intel,xgold-fixed-divider";
		#clock-cells = <0>;
		clock-output-names = "A_3_2";
		clocks = <&A_3_1>;
		clock-names = "ref";
		intel,divider = < 2 >;
		intel,mult = < 1 >;
	};
	A_3_4:A_3_4 {
		compatible = "intel,xgold-fixed-divider";
		#clock-cells = <0>;
		clock-output-names = "A_3_4";
		clocks = <&A_3_1>;
		clock-names = "ref";
		intel,divider = < 4 >;
		intel,mult = < 1 >;
	};
	A_3_5:A_3_5 {
/*		compatible = "intel,xgold-fixed-divider";*/
		#clock-cells = <0>;
		clock-output-names = "A_3_5";
		clocks = <&A_3_1>;
		clock-names = "ref";
		intel,divider = < 5 >;
		intel,mult = < 1 >;
	};
	A_3_6:A_3_6 {
/*		compatible = "intel,xgold-fixed-divider";*/
		#clock-cells = <0>;
		clock-output-names = "A_3_6";
		clocks = <&A_3_1>;
		clock-names = "ref";
		intel,divider = < 6 >;
		intel,mult = < 1 >;
	};
	A_4_2:A_4_2 {
/*		compatible = "intel,xgold-fixed-divider";*/
		#clock-cells = <0>;
		clock-output-names = "A_4_2";
		clocks = <&A_4_1>;
		clock-names = "ref";
		intel,divider = < 2 >;
		intel,mult = < 1 >;
	};
	A_4_4:A_4_4 {
/*		compatible = "intel,xgold-fixed-divider";*/
		#clock-cells = <0>;
		clock-output-names = "A_4_4";
		clocks = <&A_4_1>;
		clock-names = "ref";
		intel,divider = < 4 >;
		intel,mult = < 1 >;
	};
	A_5_2:A_5_2 {
/*		compatible = "intel,xgold-fixed-divider";*/
		#clock-cells = <0>;
		clock-output-names = "A_5_2";
		clocks = <&A_5_1>;
		clock-names = "ref";
		intel,divider = < 2 >;
		intel,mult = < 1 >;
	};
	A_6_2:A_6_2 {
/*		compatible = "intel,xgold-fixed-divider";*/
		#clock-cells = <0>;
		clock-output-names = "A_6_2";
		clocks = <&A_6_1>;
		clock-names = "ref";
		intel,divider = < 2 >;
		intel,mult = < 1 >;
	};
	A_6_4:A_6_4 {
		compatible = "intel,xgold-fixed-divider";
		#clock-cells = <0>;
		clock-output-names = "A_6_4";
		clocks = <&A_6_1>;
		clock-names = "ref";
		intel,divider = < 4 >;
		intel,mult = < 1 >;
	};
	A_6_5:A_6_5 {
/*		compatible = "intel,xgold-fixed-divider";*/
		#clock-cells = <0>;
		clock-output-names = "A_6_5";
		clocks = <&A_6_1>;
		clock-names = "ref";
		intel,divider = < 5 >;
		intel,mult = < 1 >;
	};
	A_6_8:A_6_8 {
		compatible = "intel,xgold-fixed-divider";
		#clock-cells = <0>;
		clock-output-names = "A_6_8";
		clocks = <&A_6_1>;
		clock-names = "ref";
		intel,divider = < 8 >;
		intel,mult = < 1 >;
	};
	A_7_5:A_7_5 {
/*		compatible = "intel,xgold-fixed-divider";*/
		#clock-cells = <0>;
		clock-output-names = "A_7_5";
		clocks = <&A_7_1>;
		clock-names = "ref";
		intel,divider = < 5 >;
		intel,mult = < 1 >;
	};
	B_0_2:B_0_2 {
/*		compatible = "intel,xgold-fixed-divider";*/
		#clock-cells = <0>;
		clock-output-names = "B_0_2";
		clocks = <&B_0_1>;
		clock-names = "ref";
		intel,divider = < 2 >;
		intel,mult = < 1 >;
	};
	B_0_3:B_0_3 {
/*		compatible = "intel,xgold-fixed-divider";*/
		#clock-cells = <0>;
		clock-output-names = "B_0_3";
		clocks = <&B_0_1>;
		clock-names = "ref";
		intel,divider = < 3 >;
		intel,mult = < 1 >;
	};
	B_0_4:B_0_4 {
/*		compatible = "intel,xgold-fixed-divider";*/
		#clock-cells = <0>;
		clock-output-names = "B_0_4";
		clocks = <&B_0_1>;
		clock-names = "ref";
		intel,divider = < 4 >;
		intel,mult = < 1 >;
	};
	C_0_2:C_0_2 {
/*		compatible = "intel,xgold-fixed-divider";*/
		#clock-cells = <0>;
		clock-output-names = "C_0_2";
		clocks = <&C_0_1>;
		clock-names = "ref";
		intel,divider = < 2 >;
		intel,mult = < 1 >;
	};
	F_0_2:F_0_2 {
/*		compatible = "intel,xgold-fixed-divider";*/
		#clock-cells = <0>;
		clock-output-names = "F_0_2";
		clocks = <&F_0_1>;
		clock-names = "ref";
		intel,divider = < 2 >;
		intel,mult = < 1 >;
	};
	F_0_3:F_0_3 {
/*		compatible = "intel,xgold-fixed-divider";*/
		#clock-cells = <0>;
		clock-output-names = "F_0_3";
		clocks = <&F_0_1>;
		clock-names = "ref";
		intel,divider = < 3 >;
		intel,mult = < 1 >;
	};
	G_0_2:G_0_2 {
/*		compatible = "intel,xgold-fixed-divider";*/
		#clock-cells = <0>;
		clock-output-names = "G_0_2";
		clocks = <&G_0_1>;
		clock-names = "ref";
		intel,divider = < 2 >;
		intel,mult = < 1 >;
	};
	G_0_3:G_0_3 {
/*		compatible = "intel,xgold-fixed-divider";*/
		#clock-cells = <0>;
		clock-output-names = "G_0_3";
		clocks = <&G_0_1>;
		clock-names = "ref";
		intel,divider = < 3 >;
		intel,mult = < 1 >;
	};
	I_0_2:I_0_2 {
		compatible = "intel,xgold-fixed-divider";
		#clock-cells = <0>;
		clock-output-names = "I_0_2";
		clocks = <&I_0_1>;
		clock-names = "ref";
		intel,divider = < 2 >;
		intel,mult = < 1 >;
	};
	I_0_25:I_0_25 {
/*		compatible = "intel,xgold-fixed-divider";*/
		#clock-cells = <0>;
		clock-output-names = "I_0_25";
		clocks = <&I_0_1>;
		clock-names = "ref";
		intel,divider = < 25 >;
		intel,mult = < 1 >;
	};
	M_0_2:M_0_2 {
/*		compatible = "intel,xgold-fixed-divider";*/
		#clock-cells = <0>;
		clock-output-names = "M_0_2";
		clocks = <&M_0_1>;
		clock-names = "ref";
		intel,divider = < 2 >;
		intel,mult = < 1 >;
	};
	MUX_26M:MUX_26M {
		compatible = "intel,xgold-mux";
		#clock-cells = <0>;
		clock-output-names = "mclk_26m";
		clocks = < &OFF >, < &RTC_0_1 >, < &IN_0_1 > ;
		clock-names = "ref";
		intel,mux-type = "power";
		intel,mux-default = < 2 >;
		intel,mux-update = <131276 0 1>;
		intel,mux-status-select = <131288 0 4>;
		intel,mux-select = <131584 0 8>;
	};
	MUX_3G_124M:MUX_3G_124M {
/*		compatible = "intel,xgold-mux";*/
		#clock-cells = <0>;
		clock-output-names = "mclk_3g_124m";
		clocks = < &OFF >, < &A_2_2 >, < &IN_0_1 > ;
		clock-names = "ref";
		intel,mux-type = "power";
		intel,mux-default = < 0 >;
		intel,mux-update = <131280 0 1>;
		intel,mux-xreq = <131708 29 1>;
		intel,mux-status-select = <131300 0 4>;
		intel,mux-select = <131708 0 3>;
	};
	MUX_3G_178M:MUX_3G_178M {
/*		compatible = "intel,xgold-mux";*/
		#clock-cells = <0>;
		clock-output-names = "mclk_3g_178m";
		clocks = < &OFF >, < &A_4_2 >, < &IN_0_1 > ;
		clock-names = "ref";
		intel,mux-type = "power";
		intel,mux-default = < 0 >;
		intel,mux-update = <131280 2 1>;
		intel,mux-xreq = <131712 29 1>;
		intel,mux-status-select = <131300 4 4>;
		intel,mux-select = <131712 0 3>;
	};
	MUX_3G_208M:MUX_3G_208M {
/*		compatible = "intel,xgold-mux";*/
		#clock-cells = <0>;
		clock-output-names = "mclk_3g_208m";
		clocks = < &OFF >, < &A_0_2 >, < &IN_0_1 > ;
		clock-names = "ref";
		intel,mux-type = "power";
		intel,mux-default = < 0 >;
		intel,mux-update = <131280 3 1>;
		intel,mux-xreq = <131716 29 1>;
		intel,mux-status-select = <131300 8 4>;
		intel,mux-select = <131716 0 3>;
	};
	MUX_3G_DSP:MUX_3G_DSP {
/*		compatible = "intel,xgold-mux";*/
		#clock-cells = <0>;
		clock-output-names = "mclk_3g_dsp";
		clocks = < &OFF >, < &IN_0_1 >, < &A_1_8 >, < &A_1_4 >, < &A_2_2 >, < &A_1_2 >, < &A_4_2 >, < &I_0_1 >, < &C_0_1 > ;
		clock-names = "ref";
		intel,mux-type = "power";
		intel,mux-default = < 0 >;
		intel,mux-update = <131280 6 1>;
		intel,mux-xreq = <131724 29 1>;
		intel,mux-status-select = <131300 16 4>;
		intel,mux-select = <131724 0 8>;
	};
	MUX_3G_HSORX:MUX_3G_HSORX {
/*		compatible = "intel,xgold-mux";*/
		#clock-cells = <0>;
		clock-output-names = "mclk_3g_hsorx";
		clocks = < &OFF >, < &A_2_4 >, < &A_2_2 >, < &H_0_1 > ;
		clock-names = "ref";
		intel,mux-type = "power";
		intel,mux-default = < 0 >;
		intel,mux-update = <131280 7 1>;
		intel,mux-xreq = <131728 29 1>;
		intel,mux-status-select = <131300 20 4>;
		intel,mux-select = <131728 0 8>;
	};
	MUX_3G_SEARCHER:MUX_3G_SEARCHER {
/*		compatible = "intel,xgold-mux";*/
		#clock-cells = <0>;
		clock-output-names = "mclk_3g_searcher";
		clocks = < &OFF >, < &A_2_4 >, < &A_2_2 >, < &A_4_2 >, < &A_0_2 > ;
		clock-names = "ref";
		intel,mux-type = "power";
		intel,mux-default = < 0 >;
		intel,mux-update = <131280 8 1>;
		intel,mux-xreq = <131732 29 1>;
		intel,mux-status-select = <131300 24 4>;
		intel,mux-select = <131732 0 8>;
	};
	MUX_3G_SYSTEM:MUX_3G_SYSTEM {
/*		compatible = "intel,xgold-mux";*/
		#clock-cells = <0>;
		clock-output-names = "mclk_3g_system";
		clocks = < &OFF >, < &IN_0_1 >, < &A_2_2 >, < &A_5_2 >, < &A_1_2 >, < &A_0_2 >, < &I_0_1 >, < &H_0_1 > ;
		clock-names = "ref";
		intel,mux-type = "power";
		intel,mux-default = < 0 >;
		intel,mux-update = <131280 9 1>;
		intel,mux-xreq = <131736 29 1>;
		intel,mux-status-select = <131300 28 4>;
		intel,mux-select = <131736 0 8>;
	};
	MUX_3G_TEAK:MUX_3G_TEAK {
/*		compatible = "intel,xgold-mux";*/
		#clock-cells = <0>;
		clock-output-names = "mclk_3g_teak";
		clocks = < &OFF >, < &IN_0_1 >, < &A_2_2 >, < &A_0_2 >, < &H_0_1 >, < &C_0_1 >, < &A_0_1 >, < &A_1_2 >, < &G_0_1 > ;
		clock-names = "ref";
		intel,mux-type = "power";
		intel,mux-default = < 0 >;
		intel,mux-update = <131280 5 1>;
		intel,mux-xreq = <131720 29 1>;
		intel,mux-status-select = <131300 12 4>;
		intel,mux-select = <131720 0 8>;
	};
	MUX_AHB_MACOM:MUX_AHB_MACOM {
/*		compatible = "intel,xgold-mux";*/
		#clock-cells = <0>;
		clock-output-names = "mclk_ahb_macom";
		clocks = < &OFF >, < &RTC_0_1 >, < &IN_0_1 >, < &A_0_4 >, < &A_2_2 >, < &A_6_4 >, < &A_2_4 >, < &A_0_8 >, < &A_1_4 > ;
		clock-names = "ref";
		intel,mux-type = "power";
		intel,mux-default = < 2 >;
		intel,mux-update = <131280 10 1>;
		intel,mux-sleep = <131700 31 1>;
		intel,mux-xreq = <131700 29 1>;
		intel,mux-status-select = <131308 16 4>;
		intel,mux-select = <131700 0 8>;
	};
	MUX_ATCLK:MUX_ATCLK {
/*		compatible = "intel,xgold-mux";*/
		#clock-cells = <0>;
		clock-output-names = "mclk_atclk";
		clocks = < &OFF >, < &RTC_0_1 >, < &IN_0_1 >, < &A_5_2 >, < &C_0_2 >, < &A_4_2 >, < &G_0_2 >, < &H_0_1 >, < &A_1_1 > ;
		clock-names = "ref";
		intel,flags-noinit;
		intel,flags-ignore-unused;
		intel,mux-type = "power";
		intel,mux-default = < 2 >;
		intel,mux-update = <131276 28 1>;
		intel,mux-sleep = <131692 31 1>;
		intel,mux-xreq = <131692 29 1>;
		intel,mux-status-select = <131312 4 4>;
		intel,mux-select = <131692 0 8>;
	};
	MUX_CORESIGHT:MUX_CORESIGHT {
/*		compatible = "intel,xgold-mux";*/
		#clock-cells = <0>;
		clock-output-names = "mclk_coresight";
		clocks = < &OFF >, < &RTC_0_1 >, < &IN_0_1 >, < &H_0_1 >, < &A_1_1 >, < &C_0_1 >, < &G_0_1 >, < &G_0_1 >, < &A_0_1 > ;
		clock-names = "ref";
		intel,mux-type = "power";
		intel,mux-default = < 16 >;
		intel,mux-update = <131276 19 1>;
		intel,mux-sleep = <131672 31 1>;
		intel,mux-xreq = <131672 29 1>;
		intel,mux-status-select = <131296 12 4>;
		intel,mux-select = <131672 0 8>;
	};
	MUX_CPU:MUX_CPU {
/*		compatible = "intel,xgold-mux";*/
		#clock-cells = <0>;
		clock-output-names = "mclk_cpu";
		clocks = < &OFF >, < &RTC_0_1 >, < &A_0_2 >, < &H_0_1 >, < &B_0_2 >, < &B_0_1 >, < &G_0_1 >, < &A_1_1 >, < &IN_0_1 > ;
		clock-names = "ref";
		intel,frequency-banks = < 3 >;
		intel,mux-type = "power";
		intel,mux-default = < 2 2 2>;
		intel,mux-update = <131276 1 1>;
		intel,mux-sleep = <131600 31 1>;
		intel,mux-xreq = <131600 29 1>;
		intel,mux-status-select = <131288 4 4>;
		intel,mux-select = <131600 0 8 131600 8 8 131600 16 8>;
	};
	MUX_L1L2NOC:MUX_L1L2NOC {
		compatible = "intel,xgold-mux";
		#clock-cells = <0>;
		clock-output-names = "mclk_l1l2noc";
		clocks = < &OFF >, < &RTC_0_1 >, < &MUX_CPU >, < &A_2_1 >, < &A_1_1 >, < &A_6_1 >, < &M_0_1 >, < &IN_0_1 >, < &C_0_1 > ;
		clock-names = "ref";
		intel,mux-type = "power";
		intel,mux-default = < 32 >;
		intel,mux-update = <131280 16 1>;
		intel,mux-sleep = <131812 31 1>;
		intel,mux-xreq = <131812 29 1>;
		intel,mux-status-select = <131316 0 4>;
		intel,mux-select = <131812 0 8>;
	};
	MUX_MM_GPU:MUX_MM_GPU {
		compatible = "intel,xgold-mux";
		#clock-cells = <0>;
		clock-output-names = "mclk_mm_gpu";
		clocks = < &OFF >, < &RTC_0_1 >, < &IN_0_1 >, < &A_1_2 >, < &A_1_1 >, < &A_0_1 >, < &G_0_1 >, < &A_4_1 >, < &A_0_4 > ;
		clock-names = "ref";
		intel,mux-type = "power";
		intel,mux-default = < 16 >;
		intel,mux-update = <131280 17 1>;
		intel,mux-sleep = <131784 31 1>;
		intel,mux-xreq = <131784 29 1>;
		intel,mux-status-select = <131316 20 4>;
		intel,mux-select = <131784 0 8>;
	};
	MUX_MM_VIDEO:MUX_MM_VIDEO {
		compatible = "intel,xgold-mux";
		#clock-cells = <0>;
		clock-output-names = "mclk_mm_video";
		clocks = < &OFF >, < &RTC_0_1 >, < &IN_0_1 >, < &A_1_2 >, < &A_1_1 >, < &A_0_1 >, < &G_0_1 >, < &A_4_1 >, < &A_0_4 > ;
		clock-names = "ref";
		intel,mux-type = "power";
		intel,mux-default = < 16 >;
		intel,mux-update = <131280 18 1>;
		intel,mux-sleep = <131788 31 1>;
		intel,mux-xreq = <131788 29 1>;
		intel,mux-status-select = <131316 24 4>;
		intel,mux-select = <131788 0 8>;
	};
	MUX_MM_CIFKERNEL:MUX_MM_CIFKERNEL {
		compatible = "intel,xgold-mux";
		#clock-cells = <0>;
		clock-output-names = "mclk_mm_cifkernel";
		clocks = < &OFF >, < &RTC_0_1 >, < &IN_0_1 >, < &A_1_2 >, < &A_1_1 >, < &A_0_1 >, < &G_0_1 >, < &A_4_1 >, < &A_0_4 > ;
		clock-names = "ref";
		intel,mux-type = "power";
		intel,mux-default = < 16 >;
		intel,mux-update = <131280 19 1>;
		intel,mux-sleep = <131792 31 1>;
		intel,mux-xreq = <131792 29 1>;
		intel,mux-status-select = <131316 8 4>;
		intel,mux-select = <131792 0 8>;
	};
	MUX_MM_DCC:MUX_MM_DCC {
		compatible = "intel,xgold-mux";
		#clock-cells = <0>;
		clock-output-names = "mclk_mm_dcc";
		clocks = < &OFF >, < &RTC_0_1 >, < &IN_0_1 >, < &A_1_2 >, < &A_1_1 >, < &A_0_1 >, < &G_0_1 >, < &A_4_1 >, < &A_0_4 > ;
		clock-names = "ref";
		intel,mux-type = "power";
		intel,mux-default = < 16 >;
		intel,mux-update = <131280 21 1>;
		intel,mux-sleep = <131800 31 1>;
		intel,mux-xreq = <131800 29 1>;
		intel,mux-status-select = <131316 28 4>;
		intel,mux-select = <131800 0 8>;
	};
	MUX_EMMC:MUX_EMMC {
		compatible = "intel,xgold-mux";
		#clock-cells = <0>;
		clock-output-names = "mclk_emmc";
		clocks = < &OFF >, < &RTC_0_1 >, < &IN_0_1 >, < &A_3_4 >, < &A_0_8 >, < &A_3_2 >, < &A_0_4 >, < &A_1_2 >, < &A_0_2 > ;
		clock-names = "ref";
		intel,mux-type = "power";
		intel,mux-default = < 8 >;
		intel,mux-update = <131280 13 1>;
		intel,mux-sleep = <131808 31 1>;
		intel,mux-xreq = <131808 29 1>;
		intel,mux-status-select = <131316 4 4>;
		intel,mux-select = <131808 0 8>;
	};
	MUX_DSP_2G_I:MUX_DSP_2G_I {
/*		compatible = "intel,xgold-mux";*/
		#clock-cells = <0>;
		clock-output-names = "mclk_dsp_2g_i";
		clocks = < &OFF >, < &RTC_0_1 >, < &IN_0_1 >, < &H_0_1 >, < &C_0_1 >, < &A_4_2 >, < &A_5_2 >, < &A_1_2 >, < &A_0_2 > ;
		clock-names = "ref";
		intel,frequency-banks = < 3 >;
		intel,mux-type = "power";
		intel,mux-default = < 0 0 0 >;
		intel,mux-update = <131276 3 1>;
		intel,mux-sleep = <131604 31 1>;
		intel,mux-status-select = <131288 12 4>;
		intel,mux-select = <131604 0 8 131604 8 8 131604 16 8>;
	};
	MUX_DSP_2G_O:MUX_DSP_2G_O {
/*		compatible = "intel,xgold-mux";*/
		#clock-cells = <0>;
		clock-output-names = "mclk_dsp_2g_o";
		clocks = < &OFF >, < &RTC_0_1 >, < &IN_0_1 >, < &A_6_2 >, < &A_0_4 >, < &A_4_2 >, < &A_5_2 >, < &A_1_2 >, < &A_0_2 > ;
		clock-names = "ref";
		intel,frequency-banks = < 3 >;
		intel,mux-type = "power";
		intel,mux-default = < 0 0 0 >;
		intel,mux-update = <131276 4 1>;
		intel,mux-sleep = <131608 31 1>;
		intel,mux-status-select = <131288 16 4>;
		intel,mux-select = <131608 0 8 131608 8 8 131608 16 8>;
	};
	MUX_DSP_AUD_F:MUX_DSP_AUD_F {
/*		compatible = "intel,xgold-mux";*/
		#clock-cells = <0>;
		clock-output-names = "mclk_dsp_aud_f";
		clocks = < &OFF >, < &RTC_0_1 >, < &IN_0_1 >, < &A_6_2 >, < &A_0_4 >, < &A_4_2 >, < &A_5_2 >, < &A_1_2 >, < &A_0_2 > ;
		clock-names = "ref";
		intel,frequency-banks = < 3 >;
		intel,mux-type = "power";
		intel,mux-default = < 4 4 4 >;
		intel,mux-update = <131276 5 1>;
		intel,mux-sleep = <131612 31 1>;
		intel,mux-status-select = <131288 20 4>;
		intel,mux-select = <131612 0 8 131612 8 8 131612 16 8>;
	};
	MUX_DSP_AUD_S:MUX_DSP_AUD_S {
/*		compatible = "intel,xgold-mux";*/
		#clock-cells = <0>;
		clock-output-names = "mclk_dsp_aud_s";
		clocks = < &OFF >, < &RTC_0_1 >, < &IN_0_1 >, < &A_6_2 >, < &A_0_4 >, < &A_4_2 >, < &A_5_2 >, < &A_1_2 >, < &A_0_2 > ;
		clock-names = "ref";
		intel,frequency-banks = < 3 >;
		intel,mux-type = "power";
		intel,mux-default = < 4 4 4 >;
		intel,mux-update = <131276 6 1>;
		intel,mux-sleep = <131616 31 1>;
		intel,mux-status-select = <131288 24 4>;
		intel,mux-select = <131616 0 8 131616 8 8 131616 16 8>;
	};
	MUX_FIX1:MUX_FIX1 {
		compatible = "intel,xgold-mux";
		#clock-cells = <0>;
		clock-output-names = "mclk_fix1";
		clocks = < &OFF >, < &RTC_0_1 >, < &IN_0_1 >, < &A_6_4 >, < &A_0_4 >, < &A_6_8 > ;
		clock-names = "ref";
		intel,mux-type = "power";
		intel,mux-default = < 8 >;
		intel,mux-update = <131276 8 1>;
		intel,mux-sleep = <131592 31 1>;
		intel,mux-xreq = <131592 29 1>;
		intel,mux-status-select = <131292 0 4>;
		intel,mux-select = <131592 0 8>;
	};
	MUX_LTE_CTRL_CSC:MUX_LTE_CTRL_CSC {
/*		compatible = "intel,xgold-mux";*/
		#clock-cells = <0>;
		clock-output-names = "mclk_lte_ctrl_csc";
		clocks = < &OFF >, < &RTC_0_1 >, < &IN_0_1 >, < &A_0_4 >, < &A_2_2 >, < &A_1_2 >, < &A_0_2 > ;
		clock-names = "ref";
		intel,mux-type = "power";
		intel,mux-default = < 0 >;
		intel,mux-update = <131284 1 1>;
		intel,mux-sleep = <131744 31 1>;
		intel,mux-xreq = <131744 29 1>;
		intel,mux-status-select = <131304 4 4>;
		intel,mux-select = <131744 0 8>;
	};
	MUX_LTE_CTRL_FE:MUX_LTE_CTRL_FE {
/*		compatible = "intel,xgold-mux";*/
		#clock-cells = <0>;
		clock-output-names = "mclk_lte_ctrl_fe";
		clocks = < &OFF >, < &RTC_0_1 >, < &IN_0_1 >, < &A_0_4 >, < &A_2_2 >, < &A_1_2 >, < &A_0_2 > ;
		clock-names = "ref";
		intel,mux-type = "power";
		intel,mux-default = < 0 >;
		intel,mux-update = <131284 3 1>;
		intel,mux-sleep = <131752 31 1>;
		intel,mux-xreq = <131752 29 1>;
		intel,mux-status-select = <131304 12 4>;
		intel,mux-select = <131752 0 8>;
	};
	MUX_LTE_CTRL_IRX:MUX_LTE_CTRL_IRX {
/*		compatible = "intel,xgold-mux";*/
		#clock-cells = <0>;
		clock-output-names = "mclk_lte_ctrl_irx";
		clocks = < &OFF >, < &RTC_0_1 >, < &IN_0_1 >, < &A_0_4 >, < &A_2_2 >, < &A_1_2 >, < &A_0_2 > ;
		clock-names = "ref";
		intel,mux-type = "power";
		intel,mux-default = < 0 >;
		intel,mux-update = <131284 4 1>;
		intel,mux-sleep = <131756 31 1>;
		intel,mux-xreq = <131756 29 1>;
		intel,mux-status-select = <131304 16 4>;
		intel,mux-select = <131756 0 8>;
	};
	MUX_LTE_CTRL_L1CC:MUX_LTE_CTRL_L1CC {
/*		compatible = "intel,xgold-mux";*/
		#clock-cells = <0>;
		clock-output-names = "mclk_lte_ctrl_l1cc";
		clocks = < &OFF >, < &RTC_0_1 >, < &IN_0_1 >, < &A_0_4 >, < &A_2_2 >, < &A_1_2 >, < &A_0_2 > ;
		clock-names = "ref";
		intel,mux-type = "power";
		intel,mux-default = < 0 >;
		intel,mux-update = <131284 2 1>;
		intel,mux-sleep = <131748 31 1>;
		intel,mux-xreq = <131748 29 1>;
		intel,mux-status-select = <131304 8 4>;
		intel,mux-select = <131748 0 8>;
	};
	MUX_LTE_CTRL_ORX:MUX_LTE_CTRL_ORX {
/*		compatible = "intel,xgold-mux";*/
		#clock-cells = <0>;
		clock-output-names = "mclk_lte_ctrl_orx";
		clocks = < &OFF >, < &RTC_0_1 >, < &IN_0_1 >, < &A_0_4 >, < &A_2_2 >, < &A_1_2 >, < &A_0_2 > ;
		clock-names = "ref";
		intel,mux-type = "power";
		intel,mux-default = < 0 >;
		intel,mux-update = <131284 5 1>;
		intel,mux-sleep = <131760 31 1>;
		intel,mux-xreq = <131760 29 1>;
		intel,mux-status-select = <131304 20 4>;
		intel,mux-select = <131760 0 8>;
	};
	MUX_LTE_SYS_CSC:MUX_LTE_SYS_CSC {
/*		compatible = "intel,xgold-mux";*/
		#clock-cells = <0>;
		clock-output-names = "mclk_lte_sys_csc";
		clocks = < &OFF >, < &IN_0_1 >, < &A_0_4 >, < &A_1_2 >, < &A_0_2 >, < &H_0_1 > ;
		clock-names = "ref";
		intel,mux-type = "power";
		intel,mux-default = < 0 >;
		intel,mux-update = <131284 7 1>;
		intel,mux-xreq = <131768 29 1>;
		intel,mux-status-select = <131304 28 4>;
		intel,mux-select = <131768 0 8>;
	};
	MUX_LTE_SYS_FE:MUX_LTE_SYS_FE {
/*		compatible = "intel,xgold-mux";*/
		#clock-cells = <0>;
		clock-output-names = "mclk_lte_sys_fe";
		clocks = < &OFF >, < &IN_0_1 >, < &A_0_4 >, < &A_1_2 >, < &A_0_2 >, < &H_0_1 > ;
		clock-names = "ref";
		intel,mux-type = "power";
		intel,mux-default = < 0 >;
		intel,mux-update = <131284 6 1>;
		intel,mux-xreq = <131764 29 1>;
		intel,mux-status-select = <131304 24 4>;
		intel,mux-select = <131764 0 8>;
	};
	MUX_LTE_SYS_ODRX:MUX_LTE_SYS_ODRX {
/*		compatible = "intel,xgold-mux";*/
		#clock-cells = <0>;
		clock-output-names = "mclk_lte_sys_odrx";
		clocks = < &OFF >, < &IN_0_1 >, < &A_0_4 >, < &A_1_2 >, < &A_0_2 >, < &H_0_1 >, < &A_1_1 >, < &C_0_1 > ;
		clock-names = "ref";
		intel,mux-type = "power";
		intel,mux-default = < 0 >;
		intel,mux-update = <131284 9 1>;
		intel,mux-xreq = <131776 29 1>;
		intel,mux-status-select = <131308 24 4>;
		intel,mux-select = <131776 0 8>;
	};
	MUX_LTE_SYS_RX:MUX_LTE_SYS_RX {
/*		compatible = "intel,xgold-mux";*/
		#clock-cells = <0>;
		clock-output-names = "mclk_lte_sys_rx";
		clocks = < &OFF >, < &IN_0_1 >, < &A_0_4 >, < &A_1_2 >, < &A_0_2 >, < &H_0_1 > ;
		clock-names = "ref";
		intel,mux-type = "power";
		intel,mux-default = < 0 >;
		intel,mux-update = <131284 8 1>;
		intel,mux-xreq = <131772 29 1>;
		intel,mux-status-select = <131308 20 4>;
		intel,mux-select = <131772 0 8>;
	};
	MUX_LTE_TDEC:MUX_LTE_TDEC {
/*		compatible = "intel,xgold-mux";*/
		#clock-cells = <0>;
		clock-output-names = "mclk_lte_tdec";
		clocks = < &OFF >, < &A_0_4 >, < &A_2_2 >, < &A_1_2 >, < &A_0_2 >, < &H_0_1 >, < &C_0_1 >, < &G_0_1 >, < &A_0_1 > ;
		clock-names = "ref";
		intel,mux-type = "power";
		intel,mux-default = < 0 >;
		intel,mux-update = <131284 10 1>;
		intel,mux-xreq = <131780 29 1>;
		intel,mux-status-select = <131308 28 4>;
		intel,mux-select = <131780 0 8>;
	};
	MUX_LTE_TOP:MUX_LTE_TOP {
/*		compatible = "intel,xgold-mux";*/
		#clock-cells = <0>;
		clock-output-names = "mclk_lte_top";
		clocks = < &OFF >, < &RTC_0_1 >, < &IN_0_1 >, < &A_0_4 >, < &A_0_2 > ;
		clock-names = "ref";
		intel,mux-type = "power";
		intel,mux-default = < 0 >;
		intel,mux-update = <131284 0 1>;
		intel,mux-sleep = <131740 31 1>;
		intel,mux-xreq = <131740 29 1>;
		intel,mux-status-select = <131304 0 4>;
		intel,mux-select = <131740 0 8>;
	};
	MUX_MACPHY_TILE:MUX_MACPHY_TILE {
/*		compatible = "intel,xgold-mux";*/
		#clock-cells = <0>;
		clock-output-names = "mclk_macphy_tile";
		clocks = < &OFF >, < &RTC_0_1 >, < &IN_0_1 >, < &A_0_4 >, < &A_1_2 >, < &A_4_2 >, < &A_0_2 >, < &A_2_1 >, < &I_0_1 > ;
		clock-names = "ref";
		intel,flags-noinit;
		intel,mux-type = "power";
		intel,mux-default = < 2 >;
		intel,mux-update = <131276 7 1>;
		intel,mux-sleep = <131704 31 1>;
		intel,mux-xreq = <131704 29 1>;
		intel,mux-status-select = <131288 28 4>;
		intel,mux-select = <131704 0 8>;
	};
	MUX_MC2:MUX_MC2 {
/*		compatible = "intel,xgold-mux";*/
		#clock-cells = <0>;
		clock-output-names = "mclk_mc2";
		clocks = < &OFF >, < &RTC_0_1 >, < &IN_0_1 >, < &A_0_2 >, < &C_0_1 >, < &G_0_1 >, < &F_0_3 >, < &G_0_1 >, < &A_0_1 > ;
		clock-names = "ref";
		intel,flags-noinit;
		intel,mux-type = "custom";
		intel,mux-selectors = < 0 1 2 4 8 16 16 32 64 > ;
		intel,mux-default = < 2 >;
		intel,mux-update = <131276 13 1>;
		intel,mux-sleep = <131668 31 1>;
		intel,mux-xreq = <131668 29 1>;
		intel,mux-status-select = <131292 20 4>;
		intel,mux-select = <131668 0 8>;
	};
	MUX_OCT_OUT:MUX_OCT_OUT {
		compatible = "intel,xgold-mux";
		#clock-cells = <0>;
		clock-output-names = "mclk_oct_out";
		clocks = < &OFF >, < &RTC_0_1 >, < &IN_0_1 >, < &A_0_4 >, < &A_5_2 >, < &C_0_2 >, < &A_4_2 >, < &A_0_2 >, < &G_0_2 > ;
		clock-names = "ref";
		intel,mux-type = "power";
		intel,mux-default = < 0 >;
		intel,mux-update = <131276 29 1>;
		intel,mux-sleep = <131696 31 1>;
		intel,mux-xreq = <131696 29 1>;
		intel,mux-status-select = <131312 8 4>;
		intel,mux-select = <131696 0 8>;
	};
	MUX_OUT_0:MUX_OUT_0 {
		compatible = "intel,xgold-mux";
		#clock-cells = <0>;
		clock-output-names = "mclk_out_0";
		clocks = < &OFF >, < &RTC_0_1 >, < &IN_0_1 >, < &A_0_2 >, < &A_2_2 >, < &A_4_2 >, < &A_6_2 >, < &A_1_2 >, < &A_3_2 > ;
		clock-names = "ref";
		intel,mux-type = "power";
		intel,mux-default = < 2 >;
		intel,mux-update = <131276 24 1>;
		intel,mux-sleep = <131624 31 1>;
		intel,mux-xreq = <131624 29 1>;
		intel,mux-status-select = <131308 0 4>;
		intel,mux-select = <131624 0 8>;
	};
	MUX_OUT_1:MUX_OUT_1 {
		compatible = "intel,xgold-mux";
		#clock-cells = <0>;
		clock-output-names = "mclk_out_1";
		clocks = < &OFF >, < &RTC_0_1 >, < &IN_0_1 >, < &A_0_2 >, < &A_2_2 >, < &A_4_2 >, < &A_6_2 >, < &A_5_2 >, < &A_3_2 > ;
		clock-names = "ref";
		intel,mux-type = "power";
		intel,mux-default = < 2 >;
		intel,mux-update = <131276 25 1>;
		intel,mux-sleep = <131628 31 1>;
		intel,mux-xreq = <131628 29 1>;
		intel,mux-status-select = <131308 4 4>;
		intel,mux-select = <131628 0 8>;
	};
	MUX_OUT_2:MUX_OUT_2 {
/*		compatible = "intel,xgold-mux";*/
		#clock-cells = <0>;
		clock-output-names = "mclk_out_2";
		clocks = < &OFF >, < &RTC_0_1 >, < &IN_0_1 >, < &A_0_2 >, < &A_2_2 >, < &A_4_2 >, < &A_3_1 >, < &A_5_2 >, < &A_3_2 > ;
		clock-names = "ref";
		intel,mux-type = "power";
		intel,mux-default = < 2 >;
		intel,mux-update = <131276 26 1>;
		intel,mux-sleep = <131632 31 1>;
		intel,mux-xreq = <131632 29 1>;
		intel,mux-status-select = <131308 8 4>;
		intel,mux-select = <131632 0 8>;
	};
	MUX_SDIO:MUX_SDIO {
		compatible = "intel,xgold-mux";
		#clock-cells = <0>;
		clock-output-names = "mclk_sdio";
		clocks = < &OFF >, < &RTC_0_1 >, < &IN_0_1 >, < &A_0_2 >, < &A_0_8 >, < &A_0_4 >, < &A_6_4 >, < &A_3_2 >, < &A_1_4 > ;
		clock-names = "ref";
		intel,mux-type = "power";
		intel,mux-default = < 4 >;
		intel,mux-update = <131276 18 1>;
		intel,mux-sleep = <131648 31 1>;
		intel,mux-xreq = <131648 29 1>;
		intel,mux-status-select = <131296 8 4>;
		intel,mux-select = <131648 0 8>;
	};
	MUX_SDMMC:MUX_SDMMC {
		compatible = "intel,xgold-mux";
		#clock-cells = <0>;
		clock-output-names = "mclk_sdmmc";
		clocks = < &OFF >, < &RTC_0_1 >, < &IN_0_1 >, < &A_3_4 >, < &A_0_8 >, < &A_0_4 >, < &A_6_4 >, < &A_3_2 >, < &A_1_4 > ;
		clock-names = "ref";
		intel,mux-type = "power";
		intel,mux-default = < 16 >;
		intel,mux-update = <131276 17 1>;
		intel,mux-sleep = <131644 31 1>;
		intel,mux-xreq = <131644 29 1>;
		intel,mux-status-select = <131296 4 4>;
		intel,mux-select = <131644 0 8>;
	};
	MUX_SYSTRACE:MUX_SYSTRACE {
/*		compatible = "intel,xgold-mux";*/
		#clock-cells = <0>;
		clock-output-names = "mclk_systrace";
		clocks = < &OFF >, < &RTC_0_1 >, < &IN_0_1 >, < &G_0_2 >, < &H_0_1 >, < &C_0_1 >, < &G_0_1 >, < &A_1_1 >, < &A_0_1 > ;
		clock-names = "ref";
		intel,mux-type = "power";
		intel,mux-default = < 2 >;
		intel,mux-update = <131276 20 1>;
		intel,mux-sleep = <131676 31 1>;
		intel,mux-xreq = <131676 29 1>;
		intel,mux-status-select = <131296 16 4>;
		intel,mux-select = <131676 0 8>;
	};
	MUX_TDS_TH:MUX_TDS_TH {
/*		compatible = "intel,xgold-mux";*/
		#clock-cells = <0>;
		clock-output-names = "mclk_tds_th";
		clocks = < &OFF >, < &A_0_4 >, < &A_2_2 >, < &A_5_2 >, < &A_1_2 > ;
		clock-names = "ref";
		intel,mux-type = "power";
		intel,mux-default = < 0 >;
		intel,mux-update = <131280 11 1>;
		intel,mux-xreq = <132116 29 1>;
		intel,mux-status-select = <131312 12 4>;
		intel,mux-select = <132116 0 8>;
	};
	MUX_TDS_BUS:MUX_TDS_BUS {
/*		compatible = "intel,xgold-mux";*/
		#clock-cells = <0>;
		clock-output-names = "mclk_tds_bus";
		clocks = < &OFF >, < &A_0_6 >, < &A_3_2 >, < &A_0_4 >, < &A_1_2 >, < &A_0_8 > ;
		clock-names = "ref";
		intel,mux-type = "power";
		intel,mux-default = < 0 >;
		intel,mux-update = <131280 12 1>;
		intel,mux-xreq = <132120 29 1>;
		intel,mux-status-select = <131312 16 4>;
		intel,mux-select = <132120 0 8>;
	};
	MUX_TPIU_OUT:MUX_TPIU_OUT {
/*		compatible = "intel,xgold-mux";*/
		#clock-cells = <0>;
		clock-output-names = "mclk_tpiu_out";
		clocks = < &OFF >, < &RTC_0_1 >, < &IN_0_1 >, < &H_0_1 >, < &A_1_1 >, < &C_0_1 >, < &G_0_1 >, < &G_0_1 > ;
		clock-names = "ref";
		intel,mux-type = "power";
		intel,mux-default = < 0 >;
		intel,mux-update = <131276 23 1>;
		intel,mux-sleep = <131688 31 1>;
		intel,mux-xreq = <131688 29 1>;
		intel,mux-status-select = <131296 28 4>;
		intel,mux-select = <131688 0 8>;
	};
	MUX_TRACEOUT1:MUX_TRACEOUT1 {
/*		compatible = "intel,xgold-mux";*/
		#clock-cells = <0>;
		clock-output-names = "mclk_traceout1";
		clocks = < &OFF >, < &RTC_0_1 >, < &IN_0_1 >, < &H_0_1 >, < &A_1_1 >, < &C_0_1 >, < &G_0_1 >, < &G_0_1 >, < &A_0_2 > ;
		clock-names = "ref";
		intel,mux-type = "power";
		intel,mux-default = < 2 >;
		intel,mux-update = <131276 21 1>;
		intel,mux-sleep = <131680 31 1>;
		intel,mux-xreq = <131680 29 1>;
		intel,mux-status-select = <131296 20 4>;
		intel,mux-select = <131680 0 8>;
	};
	MUX_TRACEOUT2:MUX_TRACEOUT2 {
/*		compatible = "intel,xgold-mux";*/
		#clock-cells = <0>;
		clock-output-names = "mclk_traceout2";
		clocks = < &OFF >, < &RTC_0_1 >, < &IN_0_1 >, < &A_5_2 >, < &A_1_2 >, < &A_4_2 >, < &A_0_2 >, < &A_1_4 >, < &A_0_4 > ;
		clock-names = "ref";
		intel,mux-type = "power";
		intel,mux-default = < 2 >;
		intel,mux-update = <131276 22 1>;
		intel,mux-sleep = <131684 31 1>;
		intel,mux-xreq = <131684 29 1>;
		intel,mux-status-select = <131296 24 4>;
		intel,mux-select = <131684 0 8>;
	};
	MUX_USBSS:MUX_USBSS {
		compatible = "intel,xgold-mux";
		#clock-cells = <0>;
		clock-output-names = "mclk_usbss";
		clocks = < &OFF >, < &RTC_0_1 >, < &IN_0_1 >, < &A_2_2 >, < &I_0_2 >, < &A_5_2 >, < &A_1_2 >, < &I_0_1 >, < &H_0_1 > ;
		clock-names = "ref";
		intel,mux-type = "power";
		intel,mux-default = < 32 >;
		intel,mux-update = <131276 16 1>;
		intel,mux-sleep = <131660 31 1>;
		intel,mux-xreq = <131660 29 1>;
		intel,mux-status-select = <131296 0 4>;
		intel,mux-select = <131660 0 8>;
	};
	MUX_USIM:MUX_USIM {
/*		compatible = "intel,xgold-mux";*/
		#clock-cells = <0>;
		clock-output-names = "mclk_usim";
		clocks = < &OFF >, < &RTC_0_1 >, < &IN_0_1 >, < &A_1_4 > ;
		clock-names = "ref";
		intel,mux-type = "power";
		intel,mux-default = < 0 >;
		intel,mux-update = <131276 14 1>;
		intel,mux-sleep = <131664 31 1>;
		intel,mux-xreq = <131664 29 1>;
		intel,mux-status-select = <131292 24 4>;
		intel,mux-select = <131664 0 8>;
	};
	MUX_USPC:MUX_USPC {
/*		compatible = "intel,xgold-mux";*/
		#clock-cells = <0>;
		clock-output-names = "mclk_uspc";
		clocks = < &OFF >, < &RTC_0_1 >, < &IN_0_1 >, < &A_0_4 >, < &A_1_2 >, < &A_0_2 > ;
		clock-names = "ref";
		intel,mux-type = "power";
		intel,mux-default = < 16 >;
		intel,mux-update = <131276 2 1>;
		intel,mux-xreq = <131620 29 1>;
		intel,mux-status-select = <131288 8 4>;
		intel,mux-select = <131620 0 7>;
	};
	MUX_VSCALE:MUX_VSCALE {
		compatible = "intel,xgold-mux";
		#clock-cells = <0>;
		clock-output-names = "mclk_vscale";
		clocks = < &OFF >, < &RTC_0_1 >, < &IN_0_1 >, < &A_1_4 >, < &A_0_4 >, < &A_6_4 >, < &A_3_4 >, < &A_0_8 > ;
		clock-names = "ref";
		intel,mux-type = "power";
		intel,mux-default = < 8 >;
		intel,mux-update = <131276 9 1>;
		intel,mux-sleep = <131596 31 1>;
		intel,mux-xreq = <131596 29 1>;
		intel,mux-status-select = <131292 4 4>;
		intel,mux-select = <131596 0 8>;
	};
	clk_26s_gated:clk_26s_gated {
/*		compatible = "intel,xgold-block-clock";*/
		#clock-cells = <0>;
		clock-output-names = "clk_26s_gated";
		clocks = <&IN_0_1>;
		clock-names = "mux";
		intel,block-status-enable = <786496 22 1>;
		intel,block-enable = <131332 22 1>;
		intel,block-disable = <786480 22 1>;
	};
	clk_gser:clk_gser {
/*		compatible = "intel,xgold-block-clock";*/
		#clock-cells = <0>;
		clock-output-names = "clk_gser";
		clocks = <&IN_0_1>;
		clock-names = "mux";
		intel,block-status-enable = <786496 15 1>;
		intel,block-enable = <131332 15 1>;
		intel,block-disable = <786480 15 1>;
	};
	clk_modtim:clk_modtim {
/*		compatible = "intel,xgold-block-clock";*/
		#clock-cells = <0>;
		clock-output-names = "clk_modtim";
		clocks = <&IN_0_1>;
		clock-names = "mux";
		intel,block-status-enable = <786488 3 1>;
		intel,block-enable = <131324 3 1>;
		intel,block-disable = <131344 3 1>;
	};
	clk_26m_age:clk_26m_age {
/*		compatible = "intel,xgold-block-clock";*/
		#clock-cells = <0>;
		clock-output-names = "clk_26m_age";
		clocks = <&MUX_26M>;
		clock-names = "mux";
		intel,block-status-enable = <786484 0 1>;
		intel,block-enable = <131320 0 1>;
		intel,block-disable = <131340 0 1>;
	};
	clk_26m_dsp_2g_i:clk_26m_dsp_2g_i {
/*		compatible = "intel,xgold-block-clock";*/
		#clock-cells = <0>;
		clock-output-names = "clk_26m_dsp_2g_i";
		clocks = <&MUX_26M>;
		clock-names = "mux";
		intel,block-status-enable = <786484 1 1>;
		intel,block-enable = <131320 1 1>;
		intel,block-disable = <131340 1 1>;
	};
	clk_26m_dsp_2g_o:clk_26m_dsp_2g_o {
/*		compatible = "intel,xgold-block-clock";*/
		#clock-cells = <0>;
		clock-output-names = "clk_26m_dsp_2g_o";
		clocks = <&MUX_26M>;
		clock-names = "mux";
		intel,block-status-enable = <786484 2 1>;
		intel,block-enable = <131320 2 1>;
		intel,block-disable = <131340 2 1>;
	};
	clk_26m_dsp_aud_f:clk_26m_dsp_aud_f {
/*		compatible = "intel,xgold-block-clock";*/
		#clock-cells = <0>;
		clock-output-names = "clk_26m_dsp_aud_f";
		clocks = <&MUX_26M>;
		clock-names = "mux";
		intel,block-status-enable = <786484 3 1>;
		intel,block-enable = <131320 3 1>;
		intel,block-disable = <131340 3 1>;
	};
	clk_26m_dsp_aud_s:clk_26m_dsp_aud_s {
/*		compatible = "intel,xgold-block-clock";*/
		#clock-cells = <0>;
		clock-output-names = "clk_26m_dsp_aud_s";
		clocks = <&MUX_26M>;
		clock-names = "mux";
		intel,block-status-enable = <786484 4 1>;
		intel,block-enable = <131320 4 1>;
		intel,block-disable = <131340 4 1>;
	};
	clk_26m_stm:clk_26m_stm {
		compatible = "intel,xgold-block-clock";
		#clock-cells = <0>;
		clock-output-names = "clk_26m_stm";
		clocks = <&MUX_26M>;
		clock-names = "mux";
		intel,block-status-enable = <786484 5 1>;
		intel,block-enable = <131320 5 1>;
		intel,block-disable = <131340 5 1>;
	};
	clk_cap0:clk_cap0 {
/*		compatible = "intel,xgold-block-clock";*/
		#clock-cells = <0>;
		clock-output-names = "clk_cap0";
		clocks = <&MUX_26M>;
		clock-names = "mux";
		intel,block-status-enable = <786484 13 1>;
		intel,block-enable = <131320 13 1>;
		intel,block-disable = <131340 13 1>;
	};
	clk_cap1:clk_cap1 {
/*		compatible = "intel,xgold-block-clock";*/
		#clock-cells = <0>;
		clock-output-names = "clk_cap1";
		clocks = <&MUX_26M>;
		clock-names = "mux";
		intel,block-status-enable = <786484 14 1>;
		intel,block-enable = <131320 14 1>;
		intel,block-disable = <131340 14 1>;
	};
	clk_cap2:clk_cap2 {
/*		compatible = "intel,xgold-block-clock";*/
		#clock-cells = <0>;
		clock-output-names = "clk_cap2";
		clocks = <&MUX_26M>;
		clock-names = "mux";
		intel,block-status-enable = <786496 14 1>;
		intel,block-enable = <131332 14 1>;
		intel,block-disable = <131352 14 1>;
	};
	clk_gptu0:clk_gptu0 {
/*		compatible = "intel,xgold-block-clock";*/
		#clock-cells = <0>;
		clock-output-names = "clk_gptu0";
		clocks = <&MUX_26M>;
		clock-names = "mux";
		intel,block-status-enable = <786484 23 1>;
		intel,block-enable = <131320 23 1>;
		intel,block-disable = <131340 23 1>;
	};
	clk_gptu1:clk_gptu1 {
/*		compatible = "intel,xgold-block-clock";*/
		#clock-cells = <0>;
		clock-output-names = "clk_gptu1";
		clocks = <&MUX_26M>;
		clock-names = "mux";
		intel,block-status-enable = <786484 24 1>;
		intel,block-enable = <131320 24 1>;
		intel,block-disable = <131340 24 1>;
	};
	clk_mc_ctrl:clk_mc_ctrl {
/*		compatible = "intel,xgold-block-clock";*/
		#clock-cells = <0>;
		clock-output-names = "clk_mc_ctrl";
		clocks = <&MUX_26M>;
		clock-names = "mux";
		intel,block-status-enable = <786484 27 1>;
		intel,block-enable = <131320 27 1>;
		intel,block-disable = <131340 27 1>;
	};
	clk_mc3:clk_mc3 {
/*		compatible = "intel,xgold-block-clock";*/
		#clock-cells = <0>;
		clock-output-names = "clk_mc3";
		clocks = <&MUX_26M>;
		clock-names = "mux";
		intel,block-status-enable = <786484 30 1>;
		intel,block-enable = <131320 30 1>;
		intel,block-disable = <131340 30 1>;
	};
	int_dsp_aud_r:int_dsp_aud_r {
/*		compatible = "intel,xgold-block-clock";*/
		#clock-cells = <0>;
		clock-output-names = "int_dsp_aud_r";
		clocks = <&MUX_26M>;
		clock-names = "mux";
		intel,block-status-enable = <786488 7 1>;
		intel,block-enable = <131324 7 1>;
		intel,block-disable = <131344 7 1>;
	};
	clk_ahb_3G:clk_ahb_3G {
/*		compatible = "intel,xgold-block-clock";*/
		#clock-cells = <0>;
		clock-output-names = "clk_ahb_3G";
		clocks = <&MUX_AHB_MACOM>;
		clock-names = "mux";
		intel,flags-divider_div_fix;
		intel,block-divider-default = < 1 >;
		intel,block-status-enable = <786488 22 1>;
		intel,block-enable = <131324 22 1>;
		intel,block-divider-status = <131376 18 3>;
		intel,block-disable = <131344 22 1>;
		intel,block-divider = <131868 0 3>;
		intel,block-divider-activate = <131360 6 1>;
	};
	clk_3g_atclk:clk_3g_atclk {
/*		compatible = "intel,xgold-block-clock";*/
		#clock-cells = <0>;
		clock-output-names = "clk_3g_atclk";
		clocks = <&MUX_ATCLK>;
		clock-names = "mux";
		intel,block-status-enable = <786484 22 1>;
		intel,block-enable = <131320 22 1>;
		intel,block-disable = <131340 22 1>;
	};
	clk_cpu_atclk:clk_cpu_atclk {
/*		compatible = "intel,xgold-block-clock";*/
		#clock-cells = <0>;
		clock-output-names = "clk_cpu_atclk";
		clocks = <&MUX_ATCLK>;
		clock-names = "mux";
		intel,block-status-enable = <786484 20 1>;
		intel,block-enable = <131320 20 1>;
		intel,block-disable = <131340 20 1>;
	};
	clk_uspc_atclk:clk_uspc_atclk {
/*		compatible = "intel,xgold-block-clock";*/
		#clock-cells = <0>;
		clock-output-names = "clk_uspc_atclk";
		clocks = <&MUX_ATCLK>;
		clock-names = "mux";
		intel,block-status-enable = <786484 21 1>;
		intel,block-enable = <131320 21 1>;
		intel,block-disable = <131340 21 1>;
	};
	clk_coresight:clk_coresight {
/*		compatible = "intel,xgold-block-clock";*/
		#clock-cells = <0>;
		clock-output-names = "clk_coresight";
		clocks = <&MUX_CORESIGHT>;
		clock-names = "mux";
		intel,flags-divider_div_fix;
		intel,block-divider-default = < 1 >;
		intel,block-status-enable = <786484 26 1>;
		intel,block-enable = <131320 26 1>;
		intel,block-divider-status = <131388 21 3>;
		intel,block-disable = <131340 26 1>;
		intel,block-divider = <132048 0 3>;
		intel,block-divider-activate = <131364 5 1>;
	};
	pclkdbg:pclkdbg {
/*		compatible = "intel,xgold-block-clock";*/
		#clock-cells = <0>;
		clock-output-names = "pclkdbg";
		clocks = <&MUX_CORESIGHT>;
		clock-names = "mux";
		intel,flags-divider_div_fix;
		intel,block-divider-default = < 4 >;
		intel,block-status-enable = <786484 31 1>;
		intel,block-enable = <131320 31 1>;
		intel,block-divider-status = <131392 24 3>;
		intel,block-disable = <131340 31 1>;
		intel,block-divider = <132032 0 3>;
		intel,block-divider-activate = <131364 25 1>;
	};
	clk_ahb_per0:clk_ahb_per0 {
		compatible = "intel,xgold-block-clock";
		#clock-cells = <0>;
		clock-output-names = "clk_ahb_per0";
		clocks = <&MUX_L1L2NOC>;
		clock-names = "mux";
		intel,flags-divider_div_fix;
		intel,block-divider-default = < 4 >;
		intel,block-status-enable = <786488 16 1>;
		intel,block-enable = <131324 16 1>;
		intel,block-divider-status = <131376 0 3>;
		intel,block-disable = <131344 16 1>;
		intel,block-divider = <131844 0 3>;
		intel,block-divider-activate = <131360 0 1>;
	};
	clk_ahb_per0_dmac8:clk_ahb_per0_dmac8 {
		compatible = "intel,xgold-block-clock";
		#clock-cells = <0>;
		clock-output-names = "clk_ahb_per0_dmac8";
		clocks = <&clk_ahb_per0>;
		clock-names = "mux";
		intel,block-status-enable = <786492 6 1>;
		intel,block-enable = <131328 6 1>;
		intel,block-disable = <131348 6 1>;
	};
	clk_cpu_kernel:clk_cpu_kernel {
/*		compatible = "intel,xgold-block-clock";*/
		#clock-cells = <0>;
		clock-output-names = "clk_cpu_kernel";
		clocks = <&MUX_CPU>;
		clock-names = "mux";
		intel,flags-divider_div_fix;
		intel,flags-noinit;
		intel,flags-ignore-unused;
		intel,block-divider-default = < 1 >;
		intel,block-divider-status = <131376 27 3>;
		intel,block-divider = <131824 0 3>;
		intel,block-divider-activate = <131360 9 1>;
	};
	clk_czclk:clk_czclk {
/*		compatible = "intel,xgold-block-clock";*/
		#clock-cells = <0>;
		clock-output-names = "clk_czclk";
		clocks = <&MUX_CPU>;
		clock-names = "mux";
		intel,flags-divider_div_fix;
		intel,flags-noinit;
		intel,flags-ignore-unused;
		intel,block-divider-default = < 1 >;
		intel,block-enable = <131336 15 1>;
		intel,block-disable = <131356 15 1>;
		intel,block-divider = <132084 0 3>;
		intel,block-divider-activate = <131372 15 1>;
	};
	clk_L1_NoC:clk_L1_NoC {
		compatible = "intel,xgold-block-clock";
		#clock-cells = <0>;
		clock-output-names = "clk_L1_NoC";
		clocks = <&MUX_L1L2NOC>;
		clock-names = "mux";
		intel,flags-divider_div_fix;
		intel,flags-noinit;
		intel,flags-ignore-unused;
		intel,block-divider-default = < 2 >;
		intel,block-status-enable = <786492 20 1>;
		intel,block-enable = <131328 20 1>;
		intel,block-divider-status = <131380 3 3>;
		intel,block-disable = <131348 20 1>;
		intel,block-divider = <131828 0 3>;
		intel,block-divider-activate = <131360 10 1>;
	};
	clk_L2_NoC:clk_L2_NoC {
/*		compatible = "intel,xgold-block-clock";*/
		#clock-cells = <0>;
		clock-output-names = "clk_L2_NoC";
		clocks = <&MUX_L1L2NOC>;
		clock-names = "mux";
		intel,flags-divider_div_fix;
		intel,flags-noinit;
		intel,flags-ignore-unused;
		intel,block-divider-default = < 2 >;
		intel,block-status-enable = <786492 21 1>;
		intel,block-enable = <131328 21 1>;
		intel,block-divider-status = <131380 6 3>;
		intel,block-disable = <131348 21 1>;
		intel,block-divider = <131828 0 3>;
		intel,block-divider-activate = <131360 11 1>;
	};
	clk_lmu:clk_lmu {
/*		compatible = "intel,xgold-block-clock";*/
		#clock-cells = <0>;
		clock-output-names = "clk_lmu";
		clocks = <&MUX_L1L2NOC>;
		clock-names = "mux";
		intel,block-status-enable = <786488 25 1>;
		intel,block-enable = <131324 25 1>;
		intel,block-disable = <131344 25 1>;
	};
	clk_pdb_en:clk_pdb_en {
/*		compatible = "intel,xgold-block-clock";*/
		#clock-cells = <0>;
		clock-output-names = "clk_pdb_en";
		clocks = <&MUX_MACPHY_TILE>;
		clock-names = "mux";
		intel,flags-divider_div_fix;
		intel,block-divider-default = < 2 >;
		intel,block-status-enable = <786492 23 1>;
		intel,block-enable = <131328 23 1>;
		intel,block-divider-status = <131392 3 3>;
		intel,block-disable = <131348 23 1>;
		intel,block-divider = <131992 0 3>;
		intel,block-divider-activate = <131364 22 1>;
	};
	clk_pdb_cfg_en:clk_pdb_cfg_en {
/*		compatible = "intel,xgold-block-clock";*/
		#clock-cells = <0>;
		clock-output-names = "clk_pdb_cfg_en";
		clocks = <&MUX_MACPHY_TILE>;
		clock-names = "mux";
		intel,flags-divider_div_fix;
		intel,block-divider-default = < 2 >;
		intel,block-status-enable = <786492 0 1>;
		intel,block-enable = <131328 0 1>;
		intel,block-divider-status = <131392 15 3>;
		intel,block-disable = <131348 0 1>;
		intel,block-divider = <132152 0 3>;
		intel,block-divider-activate = <131368 15 1>;
	};
	clk_mm_gpu:clk_mm_gpu {
		compatible = "intel,xgold-block-clock";
		#clock-cells = <0>;
		clock-output-names = "clk_mm_gpu";
		clocks = <&MUX_MM_GPU>;
		clock-names = "mux";
		intel,block-status-enable = <786508 6 1>;
		intel,block-enable = <131336 9 1>;
		intel,block-disable = <131356 9 1>;
	};
	clk_mm_video:clk_mm_video {
		compatible = "intel,xgold-block-clock";
		#clock-cells = <0>;
		clock-output-names = "clk_mm_video";
		clocks = <&MUX_MM_VIDEO>;
		clock-names = "mux";
		intel,block-status-enable = <786508 7 1>;
		intel,block-enable = <131336 10 1>;
		intel,block-disable = <131356 10 1>;
	};
	clk_mm_cifkernel:clk_mm_cifkernel {
		compatible = "intel,xgold-block-clock";
		#clock-cells = <0>;
		clock-output-names = "clk_mm_cifkernel";
		clocks = <&MUX_MM_CIFKERNEL>;
		clock-names = "mux";
		intel,block-status-enable = <786508 3 1>;
		intel,block-enable = <131336 2 1>;
		intel,block-disable = <131356 3 1>;
	};
	clk_mm_dcc:clk_mm_dcc {
		compatible = "intel,xgold-block-clock";
		#clock-cells = <0>;
		clock-output-names = "clk_mm_dcc";
		clocks = <&MUX_MM_DCC>;
		clock-names = "mux";
		intel,block-status-enable = <786508 1 1>;
		intel,block-enable = <131336 11 1>;
		intel,block-disable = <131356 11 1>;
	};
	clk_l1l2noc:clk_l1l2noc {
/*		compatible = "intel,xgold-block-clock";*/
		#clock-cells = <0>;
		clock-output-names = "clk_l1l2noc";
		clocks = <&MUX_L1L2NOC>;
		clock-names = "mux";
		intel,block-status-enable = <786508 0 1>;
		intel,block-enable = <131336 0 1>;
		intel,block-disable = <131356 0 1>;
	};
	clk_dsp_2g_i:clk_dsp_2g_i {
/*		compatible = "intel,xgold-block-clock";*/
		#clock-cells = <0>;
		clock-output-names = "clk_dsp_2g_i";
		clocks = <&MUX_DSP_2G_I>;
		clock-names = "mux";
		intel,flags-divider_add_one;
		intel,block-divider-default = < 1 >;
		intel,block-status-enable = <786484 15 1>;
		intel,block-enable = <131320 15 1>;
		intel,block-divider-status = <131464 0 8>;
		intel,block-disable = <131340 15 1>;
		intel,block-divider = <131464 0 8>;
		intel,block-divider-activate = <131276 30 1>;
	};
	clk_dsp_2g_o:clk_dsp_2g_o {
/*		compatible = "intel,xgold-block-clock";*/
		#clock-cells = <0>;
		clock-output-names = "clk_dsp_2g_o";
		clocks = <&MUX_DSP_2G_O>;
		clock-names = "mux";
		intel,flags-divider_add_one;
		intel,block-divider-default = < 1 >;
		intel,block-status-enable = <786484 16 1>;
		intel,block-enable = <131320 16 1>;
		intel,block-divider-status = <131464 8 8>;
		intel,block-disable = <131340 16 1>;
		intel,block-divider = <131464 8 8>;
		intel,block-divider-activate = <131276 30 1>;
	};
	clk_dsp_aud_f:clk_dsp_aud_f {
/*		compatible = "intel,xgold-block-clock";*/
		#clock-cells = <0>;
		clock-output-names = "clk_dsp_aud_f";
		clocks = <&MUX_DSP_AUD_F>;
		clock-names = "mux";
		intel,flags-divider_add_one;
		intel,block-divider-default = < 1 >;
		intel,block-status-enable = <786484 17 1>;
		intel,block-enable = <131320 17 1>;
		intel,block-divider-status = <131468 0 8>;
		intel,block-disable = <131340 17 1>;
		intel,block-divider = <131468 0 8>;
		intel,block-divider-activate = <131276 30 1>;
	};
	clk_dsp_aud_s:clk_dsp_aud_s {
/*		compatible = "intel,xgold-block-clock";*/
		#clock-cells = <0>;
		clock-output-names = "clk_dsp_aud_s";
		clocks = <&MUX_DSP_AUD_S>;
		clock-names = "mux";
		intel,flags-divider_add_one;
		intel,block-divider-default = < 1 >;
		intel,block-status-enable = <786484 18 1>;
		intel,block-enable = <131320 18 1>;
		intel,block-divider-status = <131468 8 8>;
		intel,block-disable = <131340 18 1>;
		intel,block-divider = <131468 8 8>;
		intel,block-divider-activate = <131276 30 1>;
	};
	clk_cpu_periph:clk_cpu_periph {
/*		compatible = "intel,xgold-block-clock";*/
		#clock-cells = <0>;
		clock-output-names = "clk_cpu_periph";
		clocks = <&MUX_FIX1>;
		clock-names = "mux";
		intel,flags-divider_add_one;
		intel,flags-ignore-unused;
		clock-alias-dev = "smp_twd";
		intel,block-divider-default = < 1 >;
		intel,block-divider-status = <131472 24 8>;
		intel,block-divider = <131472 24 8>;
		intel,block-divider-activate = <131276 30 1>;
	};
	clk_dap_hclk:clk_dap_hclk {
/*		compatible = "intel,xgold-block-clock";*/
		#clock-cells = <0>;
		clock-output-names = "clk_dap_hclk";
		clocks = <&MUX_FIX1>;
		clock-names = "mux";
		intel,flags-divider_div_fix;
		intel,block-divider-default = < 1 >;
		intel,block-status-enable = <786492 31 1>;
		intel,block-enable = <131328 31 1>;
		intel,block-divider-status = <131392 21 3>;
		intel,block-disable = <131348 31 1>;
		intel,block-divider = <132028 0 3>;
		intel,block-divider-activate = <131364 26 1>;
	};
	clk_gc:clk_gc {
/*		compatible = "intel,xgold-block-clock";*/
		#clock-cells = <0>;
		clock-output-names = "clk_gc";
		clocks = <&MUX_FIX1>;
		clock-names = "mux";
		intel,flags-divider_div_fix;
		intel,block-divider-default = < 1 >;
		intel,block-status-enable = <786492 1 1>;
		intel,block-enable = <131328 1 1>;
		intel,block-divider-status = <131392 6 3>;
		intel,block-disable = <131348 1 1>;
		intel,block-divider = <131984 0 3>;
		intel,block-divider-activate = <131364 24 1>;
	};
	clk_i2c1:clk_i2c1 {
		compatible = "intel,xgold-block-clock";
		#clock-cells = <0>;
		clock-output-names = "clk_i2c1";
		clocks = <&MUX_FIX1>;
		clock-names = "mux";
		intel,flags-divider_div_fix;
		intel,block-divider-default = < 4 >;
		intel,block-status-enable = <786492 3 1>;
		intel,block-enable = <131328 3 1>;
		intel,block-divider-status = <131380 15 3>;
		intel,block-disable = <131348 3 1>;
		intel,block-divider = <131940 0 3>;
		intel,block-divider-activate = <131360 14 1>;
	};
	clk_i2c2:clk_i2c2 {
		compatible = "intel,xgold-block-clock";
		#clock-cells = <0>;
		clock-output-names = "clk_i2c2";
		clocks = <&MUX_FIX1>;
		clock-names = "mux";
		intel,flags-divider_div_fix;
		intel,block-divider-default = < 4 >;
		intel,block-status-enable = <786492 4 1>;
		intel,block-enable = <131328 4 1>;
		intel,block-divider-status = <131380 18 3>;
		intel,block-disable = <131348 4 1>;
		intel,block-divider = <131944 0 3>;
		intel,block-divider-activate = <131360 15 1>;
	};
	clk_i2c3:clk_i2c3 {
		compatible = "intel,xgold-block-clock";
		#clock-cells = <0>;
		clock-output-names = "clk_i2c3";
		clocks = <&MUX_FIX1>;
		clock-names = "mux";
		intel,flags-divider_div_fix;
		intel,block-divider-default = < 4 >;
		intel,block-enable = <131336 4 1>;
		intel,block-divider-status = <131412 12 3>;
		intel,block-disable = <131356 4 1>;
		intel,block-divider = <131948 0 3>;
		intel,block-divider-activate = <131372 2 1>;
	};
	clk_i2c4:clk_i2c4 {
		compatible = "intel,xgold-block-clock";
		#clock-cells = <0>;
		clock-output-names = "clk_i2c4";
		clocks = <&MUX_FIX1>;
		clock-names = "mux";
		intel,flags-divider_div_fix;
		intel,block-divider-default = < 4 >;
		intel,block-enable = <131336 5 1>;
		intel,block-divider-status = <131412 15 3>;
		intel,block-disable = <131356 5 1>;
		intel,block-divider = <131952 0 3>;
		intel,block-divider-activate = <131372 3 1>;
	};
	clk_i2c5:clk_i2c5 {
		compatible = "intel,xgold-block-clock";
		#clock-cells = <0>;
		clock-output-names = "clk_i2c5";
		clocks = <&MUX_FIX1>;
		clock-names = "mux";
		intel,flags-divider_div_fix;
		intel,block-divider-default = < 4 >;
		intel,block-enable = <131336 6 1>;
		intel,block-divider-status = <131412 18 3>;
		intel,block-disable = <131356 6 1>;
		intel,block-divider = <131956 0 3>;
		intel,block-divider-activate = <131372 4 1>;
	};
	clk_ms_i2s1:clk_ms_i2s1 {
/*		compatible = "intel,xgold-block-clock";*/
		#clock-cells = <0>;
		clock-output-names = "clk_ms_i2s1";
		clocks = <&MUX_FIX1>;
		clock-names = "mux";
		intel,flags-divider_div_fix;
		intel,block-divider-default = < 1 >;
		intel,block-status-enable = <786492 16 1>;
		intel,block-enable = <131328 16 1>;
		intel,block-divider-status = <131384 24 3>;
		intel,block-disable = <131348 16 1>;
		intel,block-divider = <131964 0 3>;
		intel,block-divider-activate = <131364 0 1>;
	};
	clk_ms_i2s2:clk_ms_i2s2 {
/*		compatible = "intel,xgold-block-clock";*/
		#clock-cells = <0>;
		clock-output-names = "clk_ms_i2s2";
		clocks = <&MUX_FIX1>;
		clock-names = "mux";
		intel,flags-divider_div_fix;
		intel,block-divider-default = < 1 >;
		intel,block-status-enable = <786492 17 1>;
		intel,block-enable = <131328 17 1>;
		intel,block-divider-status = <131384 27 3>;
		intel,block-disable = <131348 17 1>;
		intel,block-divider = <131968 0 3>;
		intel,block-divider-activate = <131364 1 1>;
	};
	clk_ms_i2s3:clk_ms_i2s3 {
/*		compatible = "intel,xgold-block-clock";*/
		#clock-cells = <0>;
		clock-output-names = "clk_ms_i2s3";
		clocks = <&MUX_FIX1>;
		clock-names = "mux";
		intel,flags-divider_div_fix;
		intel,block-divider-default = < 1 >;
		intel,block-enable = <131336 7 1>;
		intel,block-divider-status = <131412 21 3>;
		intel,block-disable = <131356 7 1>;
		intel,block-divider = <131972 0 3>;
		intel,block-divider-activate = <131372 5 1>;
	};
	clk_oct_dvc_axi:clk_oct_dvc_axi {
		compatible = "intel,xgold-block-clock";
		#clock-cells = <0>;
		clock-output-names = "clk_oct_dvc_axi";
		clocks = <&MUX_FIX1>;
		clock-names = "mux";
		intel,flags-divider_div_fix;
		intel,block-divider-default = < 1 >;
		intel,block-status-enable = <786484 8 1>;
		intel,block-enable = <131320 8 1>;
		intel,block-divider-status = <131404 27 3>;
		intel,block-disable = <131340 8 1>;
		intel,block-divider = <132112 0 3>;
		intel,block-divider-activate = <131368 14 1>;
	};
	clk_usif1:clk_usif1 {
/*		compatible = "intel,xgold-block-clock";*/
		#clock-cells = <0>;
		clock-output-names = "clk_usif1";
		clocks = <&MUX_FIX1>;
		clock-names = "mux";
		intel,flags-divider_div_fix;
		intel,block-divider-default = < 1 >;
		intel,block-status-enable = <786488 26 1>;
		intel,block-enable = <131324 26 1>;
		intel,block-divider-status = <131388 0 3>;
		intel,block-disable = <131344 26 1>;
		intel,block-divider = <131884 0 3>;
		intel,block-divider-activate = <131360 28 1>;
	};
	clk_usif2:clk_usif2 {
/*		compatible = "intel,xgold-block-clock";*/
		#clock-cells = <0>;
		clock-output-names = "clk_usif2";
		clocks = <&MUX_FIX1>;
		clock-names = "mux";
		intel,flags-divider_div_fix;
		intel,block-divider-default = < 2 >;
		intel,block-status-enable = <786488 27 1>;
		intel,block-enable = <131324 27 1>;
		intel,block-divider-status = <131388 3 3>;
		intel,block-disable = <131344 27 1>;
		intel,block-divider = <131888 0 3>;
		intel,block-divider-activate = <131360 29 1>;
	};
	clk_usif3:clk_usif3 {
		compatible = "intel,xgold-block-clock";
		#clock-cells = <0>;
		clock-output-names = "clk_usif3";
		clocks = <&MUX_FIX1>;
		clock-names = "mux";
		intel,flags-divider_div_fix;
		intel,block-divider-default = < 1 >;
		intel,block-status-enable = <786488 28 1>;
		intel,block-enable = <131324 28 1>;
		intel,block-divider-status = <131388 6 3>;
		intel,block-disable = <131344 28 1>;
		intel,block-divider = <131892 0 3>;
		intel,block-divider-activate = <131360 30 1>;
	};
	clk_usif_gnss:clk_usif_gnss {
		compatible = "intel,xgold-block-clock";
		#clock-cells = <0>;
		clock-output-names = "clk_usif_gnss";
		clocks = <&MUX_FIX1>;
		clock-names = "mux";
		intel,flags-divider_div_fix;
		intel,block-divider-default = < 1 >;
		intel,block-status-enable = <786488 29 1>;
		intel,block-enable = <131324 29 1>;
		intel,block-divider-status = <131388 9 3>;
		intel,block-disable = <131344 29 1>;
		intel,block-divider = <131896 0 3>;
		intel,block-divider-activate = <131360 31 1>;
	};
	clk_usif7:clk_usif7 {
/*		compatible = "intel,xgold-block-clock";*/
		#clock-cells = <0>;
		clock-output-names = "clk_usif7";
		clocks = <&MUX_FIX1>;
		clock-names = "mux";
		intel,flags-divider_div_fix;
		intel,block-divider-default = < 1 >;
		intel,block-enable = <131336 14 1>;
		intel,block-divider-status = <131412 9 3>;
		intel,block-disable = <131356 14 1>;
		intel,block-divider = <131908 0 3>;
		intel,block-divider-activate = <131372 14 1>;
	};
	clk_ahb_lte:clk_ahb_lte {
/*		compatible = "intel,xgold-block-clock";*/
		#clock-cells = <0>;
		clock-output-names = "clk_ahb_lte";
		clocks = <&MUX_MACPHY_TILE>;
		clock-names = "mux";
		intel,flags-divider_div_fix;
		intel,block-divider-default = < 1 >;
		intel,block-status-enable = <786488 23 1>;
		intel,block-enable = <131324 23 1>;
		intel,block-divider-status = <131376 21 3>;
		intel,block-disable = <131344 23 1>;
		intel,block-divider = <131872 0 3>;
		intel,block-divider-activate = <131360 7 1>;
	};
	clk_macphy_tile0:clk_macphy_tile0 {
/*		compatible = "intel,xgold-block-clock";*/
		#clock-cells = <0>;
		clock-output-names = "clk_macphy_tile0";
		clocks = <&MUX_MACPHY_TILE>;
		clock-names = "mux";
		intel,flags-divider_div_fix;
		intel,block-divider-default = < 1 >;
		intel,block-status-enable = <786496 0 1>;
		intel,block-enable = <131332 0 1>;
		intel,block-divider-status = <131400 0 3>;
		intel,block-disable = <131352 0 1>;
		intel,block-divider = <132000 0 3>;
		intel,block-divider-activate = <131360 17 1>;
	};
	clk_macphy_tile1:clk_macphy_tile1 {
/*		compatible = "intel,xgold-block-clock";*/
		#clock-cells = <0>;
		clock-output-names = "clk_macphy_tile1";
		clocks = <&MUX_MACPHY_TILE>;
		clock-names = "mux";
		intel,flags-divider_div_fix;
		intel,block-divider-default = < 1 >;
		intel,block-status-enable = <786496 1 1>;
		intel,block-enable = <131332 1 1>;
		intel,block-divider-status = <131400 3 3>;
		intel,block-disable = <131352 1 1>;
		intel,block-divider = <132004 0 3>;
		intel,block-divider-activate = <131360 18 1>;
	};
	clk_macphy_tile2:clk_macphy_tile2 {
/*		compatible = "intel,xgold-block-clock";*/
		#clock-cells = <0>;
		clock-output-names = "clk_macphy_tile2";
		clocks = <&MUX_MACPHY_TILE>;
		clock-names = "mux";
		intel,flags-divider_div_fix;
		intel,block-divider-default = < 1 >;
		intel,block-status-enable = <786496 2 1>;
		intel,block-enable = <131332 2 1>;
		intel,block-divider-status = <131400 6 3>;
		intel,block-disable = <131352 2 1>;
		intel,block-divider = <132008 0 3>;
		intel,block-divider-activate = <131360 19 1>;
	};
	clk_macphy_tile3:clk_macphy_tile3 {
/*		compatible = "intel,xgold-block-clock";*/
		#clock-cells = <0>;
		clock-output-names = "clk_macphy_tile3";
		clocks = <&MUX_MACPHY_TILE>;
		clock-names = "mux";
		intel,flags-divider_div_fix;
		intel,block-divider-default = < 1 >;
		intel,block-status-enable = <786496 3 1>;
		intel,block-enable = <131332 3 1>;
		intel,block-divider-status = <131400 9 3>;
		intel,block-disable = <131352 3 1>;
		intel,block-divider = <132012 0 3>;
		intel,block-divider-activate = <131360 20 1>;
	};
	clk_macphy_tile4:clk_macphy_tile4 {
/*		compatible = "intel,xgold-block-clock";*/
		#clock-cells = <0>;
		clock-output-names = "clk_macphy_tile4";
		clocks = <&MUX_MACPHY_TILE>;
		clock-names = "mux";
		intel,flags-divider_div_fix;
		intel,block-divider-default = < 1 >;
		intel,block-status-enable = <786496 4 1>;
		intel,block-enable = <131332 4 1>;
		intel,block-divider-status = <131400 12 3>;
		intel,block-disable = <131352 4 1>;
		intel,block-divider = <132016 0 3>;
		intel,block-divider-activate = <131360 21 1>;
	};
	clk_macphy_tile5:clk_macphy_tile5 {
/*		compatible = "intel,xgold-block-clock";*/
		#clock-cells = <0>;
		clock-output-names = "clk_macphy_tile5";
		clocks = <&MUX_MACPHY_TILE>;
		clock-names = "mux";
		intel,flags-divider_div_fix;
		intel,block-divider-default = < 1 >;
		intel,block-status-enable = <786496 5 1>;
		intel,block-enable = <131332 5 1>;
		intel,block-divider-status = <131400 15 3>;
		intel,block-disable = <131352 5 1>;
		intel,block-divider = <132020 0 3>;
		intel,block-divider-activate = <131360 22 1>;
	};
	clk_macphy_tile6:clk_macphy_tile6 {
/*		compatible = "intel,xgold-block-clock";*/
		#clock-cells = <0>;
		clock-output-names = "clk_macphy_tile6";
		clocks = <&MUX_MACPHY_TILE>;
		clock-names = "mux";
		intel,flags-divider_div_fix;
		intel,block-divider-default = < 1 >;
		intel,block-status-enable = <786496 23 1>;
		intel,block-enable = <131332 23 1>;
		intel,block-divider-status = <131400 18 3>;
		intel,block-disable = <131352 23 1>;
		intel,block-divider = <132148 0 3>;
		intel,block-divider-activate = <131360 16 1>;
	};
	clk_macphy_trc_sub_arbiter:clk_macphy_trc_sub_arbiter {
/*		compatible = "intel,xgold-block-clock";*/
		#clock-cells = <0>;
		clock-output-names = "clk_macphy_trc_sub_arbiter";
		clocks = <&MUX_MACPHY_TILE>;
		clock-names = "mux";
		intel,flags-divider_div_fix;
		intel,block-divider-default = < 1 >;
		intel,block-status-enable = <786496 12 1>;
		intel,block-enable = <131332 12 1>;
		intel,block-divider-status = <131404 18 3>;
		intel,block-disable = <131352 12 1>;
		intel,block-divider = <132024 0 3>;
		intel,block-divider-activate = <131368 6 1>;
	};
	clk_MODEM_NoC:clk_MODEM_NoC {
/*		compatible = "intel,xgold-block-clock";*/
		#clock-cells = <0>;
		clock-output-names = "clk_MODEM_NoC";
		clocks = <&MUX_MACPHY_TILE>;
		clock-names = "mux";
		intel,flags-divider_div_fix;
		intel,block-divider-default = < 1 >;
		intel,block-status-enable = <786492 22 1>;
		intel,block-enable = <131328 22 1>;
		intel,block-divider-status = <131380 12 3>;
		intel,block-disable = <131348 22 1>;
		intel,block-divider = <131840 0 3>;
		intel,block-divider-activate = <131360 13 1>;
	};
	clk_MODEM_NoC_ltel1ctrl:clk_MODEM_NoC_ltel1ctrl {
/*		compatible = "intel,xgold-block-clock";*/
		#clock-cells = <0>;
		clock-output-names = "clk_MODEM_NoC_ltel1ctrl";
		clocks = <&MUX_MACPHY_TILE>;
		clock-names = "mux";
		intel,flags-divider_div_fix;
		intel,block-divider-default = < 1 >;
		intel,block-status-enable = <786496 13 1>;
		intel,block-enable = <131332 13 1>;
		intel,block-divider-status = <131404 24 3>;
		intel,block-disable = <131352 13 1>;
		intel,block-divider = <132108 0 3>;
		intel,block-divider-activate = <131360 12 1>;
	};
	clk_mc2:clk_mc2 {
/*		compatible = "intel,xgold-block-clock";*/
		#clock-cells = <0>;
		clock-output-names = "clk_mc2";
		clocks = <&MUX_MC2>;
		clock-names = "mux";
		intel,flags-divider_div_fix;
		intel,block-divider-default = < 2 >;
		intel,block-status-enable = <786484 29 1>;
		intel,block-enable = <131320 29 1>;
		intel,block-divider-status = <131392 9 3>;
		intel,block-disable = <131340 29 1>;
		intel,block-divider = <131988 0 3>;
		intel,block-divider-activate = <131364 23 1>;
	};
	clk_oct_dvc_out:clk_oct_dvc_out {
		compatible = "intel,xgold-block-clock";
		#clock-cells = <0>;
		clock-output-names = "clk_oct_dvc_out";
		clocks = <&MUX_OCT_OUT>;
		clock-names = "mux";
		intel,block-status-enable = <786484 7 1>;
		intel,block-enable = <131320 7 1>;
		intel,block-disable = <131340 7 1>;
	};
	clk_oct_out:clk_oct_out {
		compatible = "intel,xgold-block-clock";
		#clock-cells = <0>;
		clock-output-names = "clk_oct_out";
		clocks = <&MUX_OCT_OUT>;
		clock-names = "mux";
		intel,block-status-enable = <786484 6 1>;
		intel,block-enable = <131320 6 1>;
		intel,block-disable = <131340 6 1>;
	};
	clk_sdio_kernel:clk_sdio_kernel {
		compatible = "intel,xgold-block-clock";
		#clock-cells = <0>;
		clock-output-names = "clk_sdio_kernel";
		clocks = <&MUX_SDIO>;
		clock-names = "mux";
		intel,block-status-enable = <786488 2 1>;
		intel,block-enable = <131324 2 1>;
		intel,block-disable = <131344 2 1>;
	};
	clk_emmc_kernel:clk_emmc_kernel {
		compatible = "intel,xgold-block-clock";
		#clock-cells = <0>;
		clock-output-names = "clk_emmc_kernel";
		clocks = <&MUX_EMMC>;
		clock-names = "mux";
		intel,block-status-enable = <786508 2 1>;
		intel,block-enable = <131336 1 1>;
		intel,block-disable = <131356 2 1>;
	};
	clk_sdmmc_kernel:clk_sdmmc_kernel {
		compatible = "intel,xgold-block-clock";
		#clock-cells = <0>;
		clock-output-names = "clk_sdmmc_kernel";
		clocks = <&MUX_SDMMC>;
		clock-names = "mux";
		intel,block-status-enable = <786488 1 1>;
		intel,block-enable = <131324 1 1>;
		intel,block-disable = <131344 1 1>;
	};
	clk_systrace:clk_systrace {
/*		compatible = "intel,xgold-block-clock";*/
		#clock-cells = <0>;
		clock-output-names = "clk_systrace";
		clocks = <&MUX_SYSTRACE>;
		clock-names = "mux";
		intel,flags-divider_div_fix;
		intel,block-divider-default = < 1 >;
		intel,block-status-enable = <786488 4 1>;
		intel,block-enable = <131324 4 1>;
		intel,block-divider-status = <131388 18 3>;
		intel,block-disable = <131344 4 1>;
		intel,block-divider = <132044 0 3>;
		intel,block-divider-activate = <131364 4 1>;
	};
	clk_tpiu_out:clk_tpiu_out {
/*		compatible = "intel,xgold-block-clock";*/
		#clock-cells = <0>;
		clock-output-names = "clk_tpiu_out";
		clocks = <&MUX_TPIU_OUT>;
		clock-names = "mux";
		intel,flags-divider_div_fix;
		intel,block-divider-default = < 1 >;
		intel,block-status-enable = <786492 10 1>;
		intel,block-enable = <131328 10 1>;
		intel,block-divider-status = <131392 12 3>;
		intel,block-disable = <131348 10 1>;
		intel,block-divider = <132036 0 3>;
		intel,block-divider-activate = <131364 11 1>;
	};
	clk_mtm1:clk_mtm1 {
/*		compatible = "intel,xgold-block-clock";*/
		#clock-cells = <0>;
		clock-output-names = "clk_mtm1";
		clocks = <&MUX_TRACEOUT1>;
		clock-names = "mux";
		intel,flags-divider_div_fix;
		intel,block-divider-default = < 1 >;
		intel,block-status-enable = <786492 18 1>;
		intel,block-enable = <131328 18 1>;
		intel,block-divider-status = <131388 12 3>;
		intel,block-disable = <131348 18 1>;
		intel,block-divider = <131976 0 3>;
		intel,block-divider-activate = <131364 2 1>;
	};
	clk_mtm2:clk_mtm2 {
/*		compatible = "intel,xgold-block-clock";*/
		#clock-cells = <0>;
		clock-output-names = "clk_mtm2";
		clocks = <&MUX_TRACEOUT2>;
		clock-names = "mux";
		intel,flags-divider_div_fix;
		intel,block-divider-default = < 1 >;
		intel,block-status-enable = <786492 19 1>;
		intel,block-enable = <131328 19 1>;
		intel,block-divider-status = <131388 15 3>;
		intel,block-disable = <131348 19 1>;
		intel,block-divider = <131976 0 3>;
		intel,block-divider-activate = <131364 3 1>;
	};
	clk_usb_ss:clk_usb_ss {
		compatible = "intel,xgold-block-clock";
		#clock-cells = <0>;
		clock-output-names = "clk_usb_ss";
		clocks = <&MUX_USBSS>;
		clock-names = "mux";
		intel,flags-divider_div_fix;
		intel,block-divider-default = < 1 >;
		intel,block-status-enable = <786488 12 1>;
		intel,block-enable = <131324 12 1>;
		intel,block-divider-status = <131396 3 3>;
		intel,block-disable = <131344 12 1>;
		intel,block-divider = <131916 0 3>;
		intel,block-divider-activate = <131364 13 1>;
	};
	clk_usim:clk_usim {
/*		compatible = "intel,xgold-block-clock";*/
		#clock-cells = <0>;
		clock-output-names = "clk_usim";
		clocks = <&MUX_USIM>;
		clock-names = "mux";
		intel,flags-divider_add_one;
		intel,block-divider-default = < 1 >;
		intel,block-status-enable = <786488 5 1>;
		intel,block-enable = <131324 5 1>;
		intel,block-divider-status = <131476 0 8>;
		intel,block-disable = <131344 5 1>;
		intel,block-divider = <131476 0 8>;
		intel,block-divider-activate = <131276 30 1>;
	};
	clk_usim2:clk_usim2 {
/*		compatible = "intel,xgold-block-clock";*/
		#clock-cells = <0>;
		clock-output-names = "clk_usim2";
		clocks = <&MUX_USIM>;
		clock-names = "mux";
		intel,flags-divider_add_one;
		intel,block-divider-default = < 1 >;
		intel,block-status-enable = <786488 30 1>;
		intel,block-enable = <131324 30 1>;
		intel,block-divider-status = <131476 16 8>;
		intel,block-disable = <131344 30 1>;
		intel,block-divider = <131476 16 8>;
		intel,block-divider-activate = <131276 30 1>;
	};
	clk_ahb_per4:clk_ahb_per4 {
/*		compatible = "intel,xgold-block-clock";*/
		#clock-cells = <0>;
		clock-output-names = "clk_ahb_per4";
		clocks = <&MUX_USPC>;
		clock-names = "mux";
		intel,flags-divider_div_fix;
		intel,block-divider-default = < 4 >;
		intel,block-divider-status = <131376 12 3>;
		intel,block-divider = <131860 0 3>;
		intel,block-divider-activate = <131360 4 1>;
	};
	clk_ahb_per5:clk_ahb_per5 {
/*		compatible = "intel,xgold-block-clock";*/
		#clock-cells = <0>;
		clock-output-names = "clk_ahb_per5";
		clocks = <&MUX_USPC>;
		clock-names = "mux";
		intel,flags-divider_div_fix;
		intel,block-divider-default = < 2 >;
		intel,block-status-enable = <786488 21 1>;
		intel,block-enable = <131324 21 1>;
		intel,block-divider-status = <131376 15 3>;
		intel,block-disable = <131344 21 1>;
		intel,block-divider = <131864 0 3>;
		intel,block-divider-activate = <131360 5 1>;
	};
	clk_dma2ch:clk_dma2ch {
/*		compatible = "intel,xgold-block-clock";*/
		#clock-cells = <0>;
		clock-output-names = "clk_dma2ch";
		clocks = <&MUX_USPC>;
		clock-names = "mux";
		intel,flags-divider_div_fix;
		intel,block-divider-default = < 2 >;
		intel,block-status-enable = <786488 10 1>;
		intel,block-enable = <131324 10 1>;
		intel,block-divider-status = <131376 24 3>;
		intel,block-disable = <131344 10 1>;
		intel,block-divider = <131876 0 3>;
		intel,block-divider-activate = <131360 8 1>;
	};
	clk_dma2ch_2:clk_dma2ch_2 {
/*		compatible = "intel,xgold-block-clock";*/
		#clock-cells = <0>;
		clock-output-names = "clk_dma2ch_2";
		clocks = <&MUX_L1L2NOC>;
		clock-names = "mux";
		intel,flags-divider_div_fix;
		intel,block-divider-default = < 2 >;
		intel,block-status-enable = <786492 14 1>;
		intel,block-enable = <131328 14 1>;
		intel,block-divider-status = <131384 18 3>;
		intel,block-disable = <131348 14 1>;
		intel,block-divider = <132068 0 3>;
		intel,block-divider-activate = <131360 24 1>;
	};
	clk_swtrace0:clk_swtrace0 {
/*		compatible = "intel,xgold-block-clock";*/
		#clock-cells = <0>;
		clock-output-names = "clk_swtrace0";
		clocks = <&MUX_L1L2NOC>;
		clock-names = "mux";
		intel,flags-divider_div_fix;
		intel,block-divider-default = < 1 >;
		intel,block-status-enable = <786492 24 1>;
		intel,block-enable = <131328 24 1>;
		intel,block-divider-status = <131392 27 3>;
		intel,block-disable = <131348 24 1>;
		intel,block-divider = <132104 0 3>;
		intel,block-divider-activate = <131364 30 1>;
	};
	clk_uspc_NoC:clk_uspc_NoC {
/*		compatible = "intel,xgold-block-clock";*/
		#clock-cells = <0>;
		clock-output-names = "clk_uspc_NoC";
		clocks = <&MUX_USPC>;
		clock-names = "mux";
		intel,flags-divider_div_fix;
		intel,flags-ignore-unused;
		intel,block-divider-default = < 1 >;
		intel,block-enable = <131328 27 1>;
		intel,block-divider-status = <131380 9 3>;
		intel,block-disable = <131348 27 1>;
		intel,block-divider = <131836 0 3>;
		intel,block-divider-activate = <131360 23 1>;
	};
	clk_ahb_per1:clk_ahb_per1 {
		compatible = "intel,xgold-block-clock";
		#clock-cells = <0>;
		clock-output-names = "clk_ahb_per1";
		clocks = <&MUX_VSCALE>;
		clock-names = "mux";
		intel,flags-divider_div_fix;
		intel,block-divider-default = < 2 >;
		intel,block-status-enable = <786488 17 1>;
		intel,block-enable = <131324 17 1>;
		intel,block-divider-status = <131376 3 3>;
		intel,block-disable = <131344 17 1>;
		intel,block-divider = <131848 0 3>;
		intel,block-divider-activate = <131360 1 1>;
	};
	clk_ahb_per1_sdio:clk_ahb_per1_sdio {
		compatible = "intel,xgold-block-clock";
		#clock-cells = <0>;
		clock-output-names = "clk_ahb_per1_sdio";
		clocks = <&MUX_VSCALE>;
		clock-names = "mux";
		intel,block-status-enable = <786484 10 1>;
		intel,block-enable = <131320 10 1>;
		intel,block-disable = <131340 10 1>;
	};
	clk_ahb_per1_sdmmc:clk_ahb_per1_sdmmc {
		compatible = "intel,xgold-block-clock";
		#clock-cells = <0>;
		clock-output-names = "clk_ahb_per1_sdmmc";
		clocks = <&MUX_VSCALE>;
		clock-names = "mux";
		intel,block-status-enable = <786484 9 1>;
		intel,block-enable = <131320 9 1>;
		intel,block-disable = <131340 9 1>;
	};
	clk_ahb_per2:clk_ahb_per2 {
		compatible = "intel,xgold-block-clock";
		#clock-cells = <0>;
		clock-output-names = "clk_ahb_per2";
		clocks = <&MUX_VSCALE>;
		clock-names = "mux";
		intel,flags-divider_div_fix;
		intel,block-divider-default = < 1 >;
		intel,block-status-enable = <786488 18 1>;
		intel,block-enable = <131324 18 1>;
		intel,block-divider-status = <131376 6 3>;
		intel,block-disable = <131344 18 1>;
		intel,block-divider = <131852 0 3>;
		intel,block-divider-activate = <131360 2 1>;
	};
	clk_ahb_perm:clk_ahb_perm {
		compatible = "intel,xgold-block-clock";
		#clock-cells = <0>;
		clock-output-names = "clk_ahb_perm";
		clocks = <&MUX_VSCALE>;
		clock-names = "mux";
		intel,block-enable = <131336 16 1>;
		intel,block-disable = <131356 16 1>;
	};
	clk_ahb_per3:clk_ahb_per3 {
/*		compatible = "intel,xgold-block-clock";*/
		#clock-cells = <0>;
		clock-output-names = "clk_ahb_per3";
		clocks = <&MUX_VSCALE>;
		clock-names = "mux";
		intel,flags-divider_div_fix;
		intel,block-divider-default = < 1 >;
		intel,block-status-enable = <786488 19 1>;
		intel,block-enable = <131324 19 1>;
		intel,block-divider-status = <131376 9 3>;
		intel,block-disable = <131344 19 1>;
		intel,block-divider = <131856 0 3>;
		intel,block-divider-activate = <131360 3 1>;
	};
	clk_ahb_per3_usbfs:clk_ahb_per3_usbfs {
/*		compatible = "intel,xgold-block-clock";*/
		#clock-cells = <0>;
		clock-output-names = "clk_ahb_per3_usbfs";
		clocks = <&MUX_VSCALE>;
		clock-names = "mux";
		intel,block-status-enable = <786484 11 1>;
		intel,block-enable = <131320 11 1>;
		intel,block-disable = <131340 11 1>;
	};
	clk_ceu:clk_ceu {
/*		compatible = "intel,xgold-block-clock";*/
		#clock-cells = <0>;
		clock-output-names = "clk_ceu";
		clocks = <&MUX_USPC>;
		clock-names = "mux";
		intel,flags-divider_div_fix;
		intel,block-divider-default = < 2 >;
		intel,block-status-enable = <786488 31 1>;
		intel,block-enable = <131324 31 1>;
		intel,block-divider-status = <131392 0 3>;
		intel,block-disable = <131344 31 1>;
		intel,block-divider = <131960 0 3>;
		intel,block-divider-activate = <131364 21 1>;
	};
	clk_guciph:clk_guciph {
/*		compatible = "intel,xgold-block-clock";*/
		#clock-cells = <0>;
		clock-output-names = "clk_guciph";
		clocks = <&MUX_VSCALE>;
		clock-names = "mux";
		intel,flags-divider_div_fix;
		intel,block-divider-default = < 1 >;
		intel,block-status-enable = <786492 2 1>;
		intel,block-enable = <131328 2 1>;
		intel,block-divider-status = <131380 21 3>;
		intel,block-disable = <131348 2 1>;
		intel,block-divider = <131880 0 3>;
		intel,block-divider-activate = <131364 31 1>;
	};
	clk_tds_ahb:clk_tds_ahb {
/*		compatible = "intel,xgold-block-clock";*/
		#clock-cells = <0>;
		clock-output-names = "clk_tds_ahb";
		clocks = <&MUX_MACPHY_TILE>;
		clock-names = "mux";
		intel,flags-divider_div_fix;
		intel,block-divider-default = < 1 >;
		intel,block-status-enable = <786488 20 1>;
		intel,block-enable = <131324 20 1>;
		intel,block-divider-status = <131400 27 3>;
		intel,block-disable = <131344 20 1>;
		intel,block-divider = <132128 0 3>;
		intel,block-divider-activate = <131360 26 1>;
	};
	clk_out_0:clk_out_0 {
/*		compatible = "intel,xgold-block-clock";*/
		#clock-cells = <0>;
		clock-output-names = "clk_out_0";
		clocks = <&MUX_OUT_0>;
		clock-names = "mux";
		intel,flags-divider_add_one;
		intel,block-divider-default = < 1 >;
		intel,block-divider-status = <131472 0 8>;
		intel,block-divider = <131472 0 8>;
		intel,block-divider-activate = <131276 30 1>;
	};
	clk_out_1:clk_out_1 {
/*		compatible = "intel,xgold-block-clock";*/
		#clock-cells = <0>;
		clock-output-names = "clk_out_1";
		clocks = <&MUX_OUT_1>;
		clock-names = "mux";
		intel,flags-divider_add_one;
		intel,block-divider-default = < 1 >;
		intel,block-divider-status = <131472 8 8>;
		intel,block-divider = <131472 8 8>;
		intel,block-divider-activate = <131276 30 1>;
	};
	clk_out_2:clk_out_2 {
/*		compatible = "intel,xgold-block-clock";*/
		#clock-cells = <0>;
		clock-output-names = "clk_out_2";
		clocks = <&MUX_OUT_2>;
		clock-names = "mux";
		intel,flags-divider_add_one;
		intel,block-divider-default = < 1 >;
		intel,block-divider-status = <131472 16 8>;
		intel,block-divider = <131472 16 8>;
		intel,block-divider-activate = <131276 30 1>;
	};
	pmu_clk_32k:pmu_clk_32k {
/*		compatible = "intel,xgold-block-clock";*/
		#clock-cells = <0>;
		clock-output-names = "pmu_clk_32k";
		clocks = <&RTC_0_1>;
		clock-names = "mux";
		intel,block-status-enable = <131224 18 1>;
		intel,block-enable = <131224 18 1>;
	};
};
