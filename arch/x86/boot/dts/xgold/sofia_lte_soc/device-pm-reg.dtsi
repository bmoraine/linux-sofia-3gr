vsdmmc:pm@0 {
	compatible = "intel,regulator-device-pm";
	regulator-name = "lmmc1";
	intel,table-len = < 4 >;
	intel,table = < 1200000 1800000 2850000 2900000 >;
	regulator-min-microvolt = < 1200000 >;
	regulator-max-microvolt = < 2900000 >;
	intel,enable = < 0x514 2 2 >;
	intel,voltage = < 0x514 0 2 >;
	intel,has-switch = < 0 >;
	intel,class_name = "mmcsd_volt_class";
	intel,user_name = "sdmmc1_volt";
	intel,states = "disable", "mid_perf", "high_perf";
	intel,voltages = <0 1800000 2900000>;

};
lemmc:pm@1 {
	compatible = "intel,regulator-device-pm";
	regulator-name = "lemmc";
	regulator-min-microvolt = < 1200000 >;
	regulator-max-microvolt = < 2900000 >;
	intel,class_name = "mmcsd_volt_class";
	intel,user_name = "vemmc_volt";
	intel,states = "disable", "mid_perf", "high_perf";
	intel,voltages = <0 1800000 2900000>;

};
pm_lcd:pm@2 {
	compatible = "intel,regulator-device-pm";
	regulator-name = "lcd";
	regulator-min-microvolt = < 1200000 >;
	regulator-max-microvolt = < 2900000 >;
	intel,class_name = "generic_class";
	intel,user_name = "ext_display";
	intel,states = "disable", "enable";
	intel,voltages = <0 2900000>;
};
wlan_ldo:fixedregulator@0 {
	compatible = "regulator-fixed";
	regulator-name = "wlan_ldo";
	regulator-min-microvolt = <3000000>;
	regulator-max-microvolt = <3000000>;

	startup-delay-us = <100>;
	enable-active-high;
	gpio = <&xgold_pmx_gpio 81 0>;
};
