pcm_voice:pcm_voice {
	compatible = "intel,xgold-snd-voice";
	intel,dsp = < &dspaud_fb >;
	pinctrl-names = "default", "sleep", "inactive";
	pinctrl-0 = <&i2s1_default_pins>;
	pinctrl-1 = <&i2s1_sleep_pins>;
	pinctrl-2 = <&i2s1_inactive_pins>;
	pm,class-name = "generic_class";
	pm,user-name = "i2s1";
	pm,state-D0 = "enable";
	pm,state-D3 = "disable";
};

speech_probe:speech_probe {
	compatible = "intel,xgold-snd-speech";
	intel,dsp = < &dspaud_fb >;
};

pcm_music:pcm_music {
	compatible = "intel,xgold-snd-pcm";
	intel,dsp = < &dspaud_sb >;
	intel,pcm,dma_en;
	pinctrl-names = "default", "sleep", "inactive";
	pinctrl-0 = < &i2s2_default_pins >;
	pinctrl-1 = < &i2s2_sleep_pins >;
	pinctrl-2 = < &i2s2_inactive_pins >;
	pm,class-name = "generic_class";
	pm,user-name = "i2s2";
	pm,state-D0 = "enable";
	pm,state-D3 = "disable";
};

dspaud_fb:dspaud_fb {
	compatible = "intel,xgold-snd-dsp";
	intel,dsp,id = "XG742_FBA";
	reg = <0xE3304000 0x2000>, <0xE3306000 0x2000>;
	reg-names = "shm-regs", "shm-mem";
	interrupts = < FBADSP_INT2 IRQ_TYPE_DEFAULT >;
	interrupt-names = "dsp_speech_probe";
	intel,uccf = <0x20C 0x210 0x214>;
	intel,mcu2dsp = <0x208>;
	intel,dsp-imsc = < 0xC 1 2 0 >;
	intel,dsp-icr = < 0x18 1 2 0 >;
	intel,dsp-mis = < 0x14 1 2 0 >;
	intel,dsp-cf = <3 4 0x1F>; /* play1, record, tone */
	intel,dsp-sm-buf-speech-buffer_1 = <166>;
	intel,dsp-sm-buf-speech-buffer_2 = <486>;
	intel,dsp-sm-buf-speech-buffer_3 = < 806 >;
	intel,dsp-sm-buf-speech-buffer_4 = < 1126 >;
	intel,dsp-sm-buf-speech-buffer_5 = < 1446 >;
	intel,dsp-sm-buf-speech-buffer_6 = < 1766 >;
	reset-names = "dsp";
	resets = <&dbb_rst3 8>;
	intel,dsp-clc = < 4 >;
	intel,dsp-rstmods = < 0x204 >;
	pm,class-name = "dsp_class";
	pm,user-name = "dsp_aud_frame";
	pm,state-D0 = "enable";
	pm,state-D3 = "disable";
	pm,state-D0i3 = "suspend";

	intel,dsp-fw = /bits/ 16 <
		/* X-GOLD726_FB_AUDIO AF12 PATCH V0.1.4.0 generated on Tue Feb  3 18:35:04 2015 (local time) */
		/* Configuration management:  */
		0x0000 0x0002 0x0002 0x4180 0x91bc 0x0000 0x0006 0x0002
		0x4180 0x253a 0x0000 0x000e 0x0002 0x4180 0x253a 0x0000
		0x0016 0x0002 0x4180 0x23d3 0x0000 0x0020 0x01fd 0x5e08
		0x0001 0x5e09 0x0000 0x5e0a 0x0000 0x4f90 0x5e0d 0x062c
		0x5e18 0x0001 0xd4bc 0xc002 0x0000 0x5e18 0x0400 0xd4bc
		0xc003 0x5e18 0x0001 0xd4bc 0xdba5 0x5e1a 0x027a 0xd4bc
		0x063d 0x5e1a 0x008a 0xd4bc 0x0645 0x5e1a 0x009e 0xd4bc
		0x0648 0x5e1a 0x0091 0xd4bc 0x0646 0x5e1a 0x0466 0xd4bc
		0x0652 0x5e1a 0x03d0 0xd4bc 0x0655 0x5e1a 0x04bd 0xd4bc
		0x0657 0x5e1a 0x049c 0xd4bc 0x0658 0x5e1a 0x0829 0xd4bc
		0x0667 0x41c0 0x07f9 0x5e1a 0xffff 0xd4bc 0xdb02 0xd4bc
		0xdb06 0xd4bc 0xdb0a 0xd4bc 0xdb0e 0x5e1a 0xf007 0xd4bc
		0xdb01 0x5e1a 0x0000 0xd4bc 0xdb05 0x5e1a 0x0000 0xd4bc
		0xdb09 0x81ea 0x0040 0x81e8 0x000e 0x2101 0xd4bc 0xdb92
		0x0000 0x0000 0x0000 0x0000 0x0000 0x0000 0x0000 0x43c0
		0x2101 0xd4bc 0xdba1 0x0000 0x0000 0x0000 0x4380 0x4180
		0x0079 0xcd08 0x4181 0x0141 0xcd03 0x4181 0x01d0 0x4580
		0xcd07 0x4181 0x00a2 0xcd04 0x4181 0x00e4 0xcd00 0x4181
		0x00e7 0xcd02 0x4181 0x013e 0x4580 0xcd05 0x4181 0x0148
		0x4580 0x5e78 0x5e18 0x0001 0x5e19 0x0003 0xed9f 0x0000
		0x67f1 0xd4bc 0xdba5 0xd4bc 0xc826 0x6760 0x3892 0x3894
		0x38a5 0x3899 0x3896 0x3897 0x3898 0xd4bc 0x014c 0xd4bc
		0x024c 0xd4bc 0x014d 0xd4bc 0x014e 0xd4bc 0x024d 0x389d
		0x5e19 0x0125 0x5e01 0x2787 0x0d1b 0x1b49 0x5e01 0x28b5
		0x0d1b 0x1b49 0x5e01 0x28ae 0x0c05 0x1b49 0xd4bc 0x28b4
		0x5e01 0x28ad 0x1b41 0x388c 0x388a 0x3882 0x5e00 0xd286
		0x1b48 0x0088 0x1b48 0x1b48 0x1b48 0x1b48 0x5e1a 0xffff
		0x388b 0x4180 0x27af 0x5e78 0x4180 0x29bf 0x5e78 0x1f28
		0x5032 0x41c0 0x011a 0x5020 0x41c0 0x00f1 0x4180 0x2dfa
		0xe98a 0x0001 0x41c2 0x012e 0xe98a 0x0002 0x41c2 0x2e6a
		0xe98a 0x0020 0x41c2 0x2e7a 0x1f08 0x388b 0x1f08 0x6720
		0x86c0 0x0107 0x0000 0x599a 0x0000 0x0000 0x4180 0x0111
		0x4180 0x0112 0x4180 0x2e31 0x4180 0x0111 0x4180 0x2e39
		0x4580 0x6760 0x3893 0x5e18 0x0001 0x388c 0xe18a 0x0001
		0x4580 0x0088 0x1f08 0x6720 0x86c0 0x0123 0x0000 0x599a
		0x0000 0x0000 0x4180 0x012d 0x4180 0x012e 0x4180 0x2e6a
		0x4180 0x012d 0x4180 0x2e7a 0x4580 0x6760 0x3892 0x3894
		0x38a5 0x5e19 0x0800 0xd5bc 0xdb10 0x6760 0x388c 0x5e1a
		0xffff 0x388b 0xe38a 0x0001 0x4580 0x5e78 0x4180 0x2a18
		0x5e78 0x0090 0x8ce0 0x0048 0x5011 0x7f60 0x4580 0x5e78
		0x1c20 0x87e1 0xc000 0x5e18 0x0015 0x1b49 0x5e18 0x002f
		0x1b49 0x5e18 0x1600 0x1b49 0x5e18 0x0031 0x1b49 0x5e18
		0x1300 0x1b49 0x5e18 0x0025 0x1b49 0x5e18 0x2500 0x1b49
		0x5e18 0x006f 0x1b49 0x5e18 0x1100 0x1b49 0x5e18 0x0068
		0x1b49 0x5e18 0x1000 0x1b49 0x5e18 0x0071 0x1b49 0x5e18
		0x1500 0x1b49 0x5e18 0x0046 0x1b49 0x5e18 0x1400 0x1b49
		0x5e18 0x0026 0x1b49 0x5e18 0x1100 0x1b49 0x5e18 0x006b
		0x1b49 0x5e18 0x1000 0x1b49 0x5e18 0x0027 0x1b49 0x5e18
		0x1000 0x1b49 0x5e18 0x0030 0x1b49 0x5e18 0x1200 0x1b49
		0x5e18 0x0037 0x1b49 0x5e18 0x1200 0x1b49 0x5e18 0x005e
		0x1b49 0x5e18 0x1100 0x1b49 0x5e18 0x005f 0x1b49 0x5e18
		0x1000 0x1b49 0x5e18 0x0023 0x1b49 0x5e18 0x1100 0x1b49
		0x5e18 0x004e 0x1b49 0x5e18 0x2500 0x1b49 0x1b49 0x1b49
		0x5e18 0x0050 0x1b49 0x5e18 0x1200 0x1b41 0x5e18 0x007d
		0x1b49 0x5e18 0x1000 0x1b49 0x5e18 0x0077 0x1b49 0x5e18
		0x1000 0x1b49 0x5e18 0x0079 0x1b49 0x5e18 0x1000 0x1b49
		0x5e18 0x0034 0x1b49 0x5e18 0x1000 0x1b49 0x4580 0x5e7a
		0xd6d0 0x5e5a 0x1f68 0x5edb 0x5e03 0x28b5 0x1f48 0x5e9a
		0x67e0 0x58fa 0x080e 0x5b0b 0x86a3 0x587a 0x58da 0x1c23
		0x5ee1 0x5b01 0x6765 0x583a 0x1b43 0xd2d0 0x82a1 0xcc03
		0x4181 0x0277 0x5e05 0x2787 0x5b0b 0x86a5 0x58ba 0xcd00
		0x51a2 0x58da 0x5e18 0xffff 0x1b4b 0x6760 0x0c0c 0x1b4b
		0xd98c 0x5091 0x585b 0x0000 0x1b42 0xd5b8 0x28b4 0x5031
		0x77e0 0xd5bc 0x28b4 0xd4b8 0x28b4 0x4182 0x0277 0xe39d
		0x0006 0x4180 0x0277 0x008d 0x8ce5 0x0000 0x5056 0xd6d0
		0x5035 0x5e18 0x0001 0x5eda 0xd2d0 0x8083 0x1b4b 0x9120
		0x5022 0xe19d 0x0002 0x9220 0x0000 0x021d 0x01fd 0x5022
		0xe19d 0x0004 0x5840 0x008a 0x3706 0x5e18 0x0200 0x8ce2
		0x0000 0x5081 0x6760 0x8ce2 0xfc40 0x5041 0x1c22 0x41c0
		0x681f 0x6700 0x1b4a 0x0095 0x570c 0x5823 0x3709 0x41c0
		0x2f55 0xd2f0 0xcd01 0x4181 0x0277 0xd4b8 0x28b4 0x5e19
		0x0006 0xed8b 0x0005 0x5071 0xed8b 0x0007 0x5041 0xed8b
		0x0008 0x5011 0x5020 0x5e19 0x0004 0x8cb9 0x5032 0x6760
		0xdc80 0x5270 0x1f08 0x1b49 0x1f08 0x1b49 0x5e19 0xffff
		0x5e04 0x28ae 0x3706 0xed8b 0x0005 0x5022 0x5e05 0x0004
		0x77d0 0x1f0c 0x5021 0x0095 0x57bc 0x0094 0x47d8 0x1b44
		0x5b04 0x1b49 0x5e02 0xf323 0x58fb 0x5e03 0x00d0 0x8043
		0x5b2b 0x87a2 0x585b 0x1b69 0xd4b8 0x28b4 0x67d0 0xd4bc
		0x28b4 0x5e78 0x5efa 0x4580 0xcd0e 0x4181 0x0281 0xcd16
		0x4181 0x02e4 0x4580 0x5e7a 0x2110 0xd4bc 0xdb91 0x5e18
		0x0001 0xd4bc 0xdb10 0xeda6 0x000c 0x5071 0xf08a 0x41c1
		0x03b4 0xd4b8 0x1f3f 0xd4bc 0xd28a 0xd4b8 0x00a5 0xcc02
		0x53b2 0xed8b 0x0005 0x5071 0xed8b 0x0007 0x5041 0xed8b
		0x0008 0x5011 0x5200 0x5e01 0xc6e6 0x5e00 0x1ffc 0x1f20
		0x5e00 0x213f 0x5d1b 0x02ab 0x1f09 0x1b48 0xed91 0x0001
		0x5112 0xd4b8 0x1ffb 0x5031 0x5e18 0x0006 0x5020 0x5e18
		0x0005 0x5e01 0xc968 0x5e00 0x213f 0x1b49 0x5d1b 0x02bf
		0x1f08 0x1b49 0x50a0 0xe98a 0x0012 0x41c2 0x36e2 0x41c0
		0x365d 0x8de1 0x0001 0x41c1 0x3689 0x41c0 0x3532 0x2301
		0x5e01 0x068a 0x41c0 0x2327 0xed91 0x0001 0x5072 0x2101
		0xd4bc 0xdb91 0x5e18 0x0008 0xd4bc 0xdb10 0x2140 0xd4bc
		0xdb91 0x5e18 0x0001 0xd4bc 0xdb10 0x4580 0x5e7a 0x2108
		0xd4bc 0xdb91 0x5e18 0x0001 0xd4bc 0xdb10 0x3101 0x2103
		0xed9f 0x0000 0x5071 0x5e00 0x024c 0x9520 0x5031 0xed9a
		0x0000 0x67f1 0xd4bc 0xdba5 0xd4bc 0xc826 0xed8a 0x0000
		0x5031 0xed94 0x0002 0x5022 0x41c0 0x337d 0xed8b 0x0005
		0x51f2 0x5e01 0xc5a6 0x5e00 0x1ffc 0x1f28 0x5d1b 0x030f
		0x1f08 0x1b49 0xed91 0x0001 0x5112 0xd4b8 0x1ffb 0x5031
		0x5e18 0x0006 0x5020 0x5e18 0x0005 0x5e01 0xc827 0x5e00
		0x1ffd 0x1b49 0x5d1b 0x0323 0x1f08 0x1b49 0x4180 0x0340
		0x41c0 0x328a 0x5e00 0xd288 0x718c 0x1b40 0x41c0 0x32b3
		0x8de1 0x0001 0x41c1 0x0364 0xed8b 0x0003 0x5041 0xed8b
		0x0007 0x5011 0x5030 0x7982 0xd5bc 0xd406 0xe98a 0x000a
		0x41c2 0x36a8 0xe98a 0x0018 0x5081 0x3108 0xd5bc 0xdb10
		0x2303 0x5e01 0x068a 0x41c0 0x2327 0xeda6 0x000c 0x5072
		0x41c0 0x3aa4 0x2303 0x5e01 0x068a 0x41c0 0x2327 0x718a
		0x5052 0x2303 0x5e01 0x068a 0x41c0 0x2327 0x2120 0xd4bc
		0xdb91 0x5e18 0x0001 0xd4bc 0xdb10 0x4580 0x718b 0x4585
		0x5e19 0x0003 0xed8b 0x0007 0x67f1 0x5e19 0x0004 0xed8b
		0x0008 0x67f1 0xed8a 0x0001 0x50c2 0x5e00 0xd406 0xcc03
		0x5044 0x5e19 0x0001 0x1b60 0x5040 0x7982 0x1b68 0x7760
		0x1b60 0x581a 0x87e0 0x73a9 0x0000 0x1f60 0x581a 0x87e0
		0x73b8 0x0000 0x1f40 0xd4bc 0xdba3 0x7293 0x5e00 0x1ffd
		0x5e01 0x1f3f 0x0400 0xd580 0x0400 0x5e19 0x0000 0xd5bc
		0xdba3 0x2102 0x3892 0x5e00 0x1f3f 0x5e01 0xd406 0x5c4c
		0x03a0 0x1f08 0x1b49 0xed91 0x0001 0x50f2 0x5e00 0x1f3f
		0x5e01 0xc827 0x718b 0x1b49 0xed8a 0x0001 0x5022 0x7182
		0x1b49 0x5c4c 0x03b2 0x1f08 0x1b49 0x4580 0x5e00 0xd457
		0x5e01 0x1f3f 0x5c4c 0x03bb 0x1f08 0x1b49 0xed91 0x0001
		0x50c2 0x5e00 0xd457 0x5e01 0xc968 0x718b 0x1b49 0x7183
		0x1b49 0x5c4c 0x03ca 0x1f08 0x1b49 0x5e18 0x0100 0xd4bc
		0xdb10 0x4580 0xcd10 0x4181 0x03da 0xcd0c 0x4181 0x03f7
		0xcd05 0x4181 0x0414 0x4580 0x5e78 0xf34d 0x4182 0x3fb7
		0xf14c 0x4181 0x3fb7 0x2101 0x386e 0x5e01 0x5e2a 0x2204
		0x5e01 0x5e7a 0x2205 0x5e01 0x5e4a 0x2206 0x5e01 0x5e5a
		0x2207 0x5e01 0x5e6a 0x2208 0x5e01 0x5dbc 0x221b 0x4180
		0x3fb3 0x5e78 0xf14d 0x4182 0x4166 0xf04c 0x4181 0x4166
		0x6760 0x386e 0x5e01 0x5f8c 0x2204 0x5e01 0x5fdc 0x2205
		0x5e01 0x5fac 0x2206 0x5e01 0x5fbc 0x2207 0x5e01 0x5fcc
		0x2208 0x5e01 0x5ddc 0x221b 0x4180 0x4162 0x5e78 0x714a
		0x50d2 0x2180 0x3857 0x2110 0x0000 0x041a 0x01fd 0x3850
		0x2104 0x3851 0x2110 0x3858 0x210a 0x3856 0x21a0 0x3855
		0x50e0 0x5e1a 0x0100 0x3857 0x2120 0x3850 0x2105 0x3851
		0x2120 0x3858 0x210a 0x3856 0x5e1a 0x0140 0x3855 0x7150
		0x6700 0x3852 0x2108 0x3859 0x6760 0x385b 0x385a 0x5e18
		0x0400 0x3853 0x5e18 0x2000 0x3854 0x6005 0x7957 0x77e0
		0x6760 0x0d1b 0x1b48 0xf16d 0x5062 0x601b 0x7950 0x77e0
		0x6760 0x0d1b 0x1b48 0x7052 0x5e18 0x7fff 0x6008 0x6404
		0x6807 0x6c06 0x5e19 0x0400 0x0094 0x5d04 0x045e 0x1b48
		0x1ba9 0x1b69 0x1b4a 0x1b4b 0x6760 0x7a6e 0x5021 0x5e18
		0x001e 0x386f 0x4580 0xcd08 0x4181 0x046a 0x4580 0x5e78
		0x83e8 0x0001 0x4d82 0xfa4c 0x5122 0xd4b8 0x3796 0x581a
		0x5e01 0x0f6f 0x714b 0x67e0 0x5d1a 0x047a 0x1f88 0x1b89
		0x5e00 0x0f6f 0x5e01 0x6f47 0x794b 0x41c0 0x3ca7 0x724f
		0x3809 0x5e01 0x5e2a 0x2204 0x5e01 0x5e7a 0x2205 0x5e01
		0x5e4a 0x2206 0x5e01 0x5e5a 0x2207 0x5e01 0x5e6a 0x2208
		0x5e01 0x5dbc 0x221b 0x41c0 0x514b 0x4d80 0x81e8 0x0001
		0x4580 0xcd00 0x4181 0x04a0 0x4580 0x5e78 0x83e8 0x0001
		0x4d82 0x2009 0x5e01 0x5f8c 0x2204 0x5e01 0x5fdc 0x2205
		0x5e01 0x5fac 0x2206 0x5e01 0x5fbc 0x2207 0x5e01 0x5fcc
		0x2208 0x5e01 0x5ddc 0x221b 0x41c0 0x514b 0x4d80 0x81e8
		0x0001 0x4580 0xcd0b 0x4181 0x04d0 0xcd08 0x4181 0x056a
		0xcd07 0x4181 0x0587 0xcd06 0x4181 0x060f 0xcd0c 0x4181
		0x061f 0xcd03 0x4181 0x0647 0x4580 0x5e78 0x716e 0x5161
		0xfa4c 0x5142 0x5e00 0x0f6f 0x5e01 0x6e47 0x5e02 0xe560
		0x7157 0x67e0 0x5d1a 0x04e0 0x1f09 0x1b4a 0x5b62 0x7155
		0x67e0 0x5d1a 0x04e7 0x1f08 0x1b4a 0x3c0c 0x6009 0x7156
		0x67e0 0x380a 0x4b88 0x41c0 0x51e3 0x41c0 0x53c5 0x4b88
		0xf16d 0x5262 0x7250 0x67d0 0x59fa 0x7af4 0xb3f4 0x5ef9
		0x71f5 0x67e0 0x5d1a 0x051a 0x5e03 0x0f1f 0x67c0 0x5e02
		0x011a 0x740b 0x701b 0x7950 0x77e0 0x5d1b 0x0513 0x1fab
		0x1e0c 0x97b0 0x58f1 0x805d 0x5bb0 0x87ab 0x1ba2 0xd046
		0x86ab 0x7760 0xd6f0 0x93b3 0x5ef9 0x1b88 0x009d 0x2a0b
		0x7250 0x67d0 0x59fa 0x7158 0x79f5 0x8eb9 0x67e0 0x5d1a
		0x0530 0x5e03 0x0f1f 0x67c0 0x740b 0x7950 0xcf02 0xd04f
		0x0d1b 0xd24f 0x86ab 0x1b88 0x009d 0x2a0b 0xf16d 0x5092
		0x5e03 0x0f1f 0x681b 0x7250 0x67e0 0x5d1a 0x053b 0x1f0b
		0x1b4a 0x716e 0x5051 0xfa4c 0x5032 0x710c 0xa650 0x380c
		0x6760 0x720a 0x4182 0x04eb 0x5e18 0xe300 0xa655 0x58ba
		0x7005 0x7157 0x67e0 0x5d1a 0x0551 0x1f0d 0x1b4c 0x716e
		0x5151 0xfa4c 0x5132 0xf94c 0x5112 0xd4b8 0x6f8c 0x67d0
		0xd4bc 0x6f8c 0x5e18 0xe560 0xa655 0x58ba 0x5e04 0x6e47
		0x7157 0x67e0 0x5d1a 0x0568 0x1f0d 0x1b4c 0x4580 0x5e78
		0x725a 0x67d0 0x385a 0xbe61 0x5156 0x6760 0x385a 0x5e00
		0x0f4f 0x6407 0x6808 0x6c06 0x7152 0x67e0 0x5d1a 0x0584
		0x1f02 0x1f21 0x8db8 0x67f5 0x1b6a 0x1f28 0x8db8 0x67f5
		0x1b69 0x1b4b 0x4180 0x5300 0x5e78 0x5e00 0x0f4f 0x6806
		0x716e 0x5061 0xf94c 0x5042 0xfa4c 0x5022 0x5e02 0x6e37
		0x5e03 0xe2e0 0x3300 0x7952 0x77e0 0x5d1b 0x05ef 0x716d
		0x901a 0x5292 0x715d 0x795e 0x8de4 0x0000 0x77f1 0x1f08
		0x8e8a 0x58fa 0x805b 0x5b0b 0x6720 0x41c0 0x4cce 0x67a0
		0x49c0 0x7e6b 0x9abc 0x5b0b 0x98ba 0x50e6 0x9458 0xdac0
		0x3a03 0x0c0f 0x0f03 0x5b3b 0xdee0 0x7700 0x5e18 0x7fff
		0x8dc0 0x7fff 0x77f3 0x5020 0x5e19 0x7fff 0x7c54 0x805b
		0x5b0b 0x9b42 0x5200 0x7953 0x1f00 0x8e82 0x8cb9 0x50d6
		0x795e 0x715d 0x8de4 0x0000 0x77f1 0x1f00 0x8e82 0xae63
		0x6765 0x58fa 0x805b 0x5b0b 0x5010 0x6760 0x008a 0x0088
		0x41c0 0x4cce 0x67a0 0x49c0 0x5e19 0x7fff 0x8fbc 0x58fb
		0xe054 0x5b0b 0x9b42 0x7e6c 0x8cb9 0x67f3 0x5b3c 0x715c
		0x6700 0x8cb9 0x77f3 0x1b6b 0x3301 0x7153 0x6006 0x796e
		0x5061 0xf94c 0x5042 0xfa4c 0x5022 0x5e00 0x6e37 0x5e01
		0x0f50 0x0088 0x1fa8 0xb364 0x49f0 0x5b7d 0x8d89 0x5025
		0xa667 0x5010 0xae68 0x7965 0x8cb9 0x67f3 0x7966 0x8cb9
		0x67f5 0x3853 0x4180 0x538d 0x5e78 0x1f00 0xa653 0xa663
		0xa66a 0x5b3a 0x7169 0x8db8 0x0000 0x0617 0x01fd 0x77f5
		0x5b1b 0x8c81 0x4584 0xd5b8 0x0f51 0x4180 0x539f 0x5e78
		0x5e19 0x0000 0x3cf5 0xf16d 0x5092 0x5e19 0x0007 0x7155
		0x8cc0 0x0140 0x5021 0x5e19 0x0003 0x3cf5 0xf16d 0x5092
		0x5e19 0x1000 0x7155 0x8cc0 0x0140 0x5021 0x5e19 0x2000
		0x3cf4 0x5e02 0xb990 0x5e03 0xb780 0x7155 0x8cc0 0x0140
		0x5042 0x5e02 0xb890 0x5e03 0xb760 0x4180 0x5164 0x5e78
		0x7760 0x7152 0x67e0 0x5d1a 0x07d1 0x5e5b 0x7ced 0x600d
		0x0000 0x8028 0x5b0b 0x200d 0x6013 0x0000 0x1fa0 0x9ffd
		0x8fb8 0xf0f1 0x5031 0xf1f1 0x4182 0x06f4 0x9fc3 0x49f0
		0x7cf2 0x6010 0x0000 0x1f80 0x96bd 0x805c 0x5b0b 0x93bc
		0x1ba0 0xf0f1 0x5052 0x6014 0x0000 0x1f88 0x2014 0x4981
		0xf1f1 0x4182 0x06ef 0x6013 0x0000 0x9a80 0x5b0b 0x6011
		0x0000 0x1f68 0x9380 0x5e12 0x000b 0x41c0 0x6e95 0x5e07
		0x7c12 0x815a 0x77b0 0x9ff0 0x9b70 0x815a 0x5b0b 0x87b8
		0x5e1a 0xb852 0x5e07 0xe41e 0x92a7 0x87b8 0x5e1a 0x2b7e
		0x9ff0 0x050b 0x41c0 0x6e44 0x77f0 0x2301 0x93a0 0x6700
		0x7700 0x41c0 0x6f6c 0x9b50 0x6012 0x0000 0x1fa0 0x8fb8
		0x4980 0xd4b8 0x6f5a 0x58fa 0x815b 0x67b0 0x9b70 0x805d
		0x5b2b 0x87b8 0x4980 0x87b8 0x1ba8 0x2012 0x8dfd 0x7eb8
		0x5056 0x8dfc 0x7eb8 0x5026 0x5e1c 0x7eb8 0x6013 0x0000
		0x9a80 0x58fc 0x5b0b 0x6011 0x0000 0x1f68 0x9380 0x8fb8
		0x4980 0x815b 0x67b0 0x9b70 0x805d 0x5b2b 0x87b8 0x4980
		0x87b8 0x6010 0x0000 0x1f00 0x5154 0xd4b8 0x6f5b 0x58fa
		0x6011 0x0000 0x1f48 0x9290 0x8eb9 0x4982 0x815a 0x77b0
		0x9ff0 0x805c 0x5b0b 0x87b8 0x4980 0x87b8 0x1b68 0x1ba8
		0x67f0 0x5040 0x6011 0x0000 0x1f48 0x9288 0x2011 0x41c0
		0x4cb4 0x6700 0x9b50 0x5e00 0x4000 0x92a0 0x4981 0x6016
		0x0000 0x1a28 0x2016 0x5030 0x6010 0x0000 0x1ba0 0x6010
		0x0000 0x1f08 0x2010 0x4184 0x07b5 0xf4f1 0x4182 0x075c
		0x6017 0x5e7b 0x5e5b 0x5e01 0x6f8e 0x95a1 0x583b 0x1f88
		0x1fa1 0x2017 0x8cb9 0x53e3 0x2101 0xd4bc 0x6ffe 0x6016
		0x0090 0x1f80 0x6720 0x6790 0x9b70 0x5b9a 0x41c0 0x4cce
		0x6013 0x0000 0x9a88 0x5b2b 0x2013 0x4983 0x6817 0x0092
		0x1ce2 0x815a 0x77b0 0x9ff0 0x805c 0x5b0b 0x87b8 0x5ed9
		0x5e1c 0x7fff 0x9682 0x58fc 0x4981 0x815a 0x77b0 0x9ff0
		0x805c 0x5b0b 0x87b8 0xd2d0 0x87b8 0x600e 0x0000 0x1f48
		0x9290 0x8eb9 0x5ed9 0x7cee 0x815a 0x77b0 0x9ff0 0x805c
		0x5b0b 0x87b8 0xd2d0 0x86b9 0x5ed8 0x6016 0x0090 0x1e20
		0x4180 0x077c 0x6013 0x0088 0x2013 0x6760 0xd4bc 0x6ffe
		0x600e 0x0088 0x0088 0x200e 0x600f 0x0088 0x200f 0x6015
		0x0088 0x2015 0x4180 0x077c 0x600e 0x0000 0x1f48 0x9290
		0x6013 0x0000 0x9a88 0x5b2b 0x2013 0x8eb9 0x5ed9 0x7cee
		0x815a 0x77b0 0x9ff0 0x805c 0x5b0b 0x87b8 0x4980 0x87b8
		0x67f0 0x5ed8 0x5e19 0x0001 0xd5bc 0x6ffe 0x6016 0x0090
		0x1e20 0x6017 0x0088 0x2017 0xd5b8 0x6ffe 0x4181 0x07c5
		0x41c0 0x4cb4 0x9b4f 0x5e07 0x4000 0x92a7 0xf0f1 0x5021
		0xf1f1 0x5162 0x6015 0x0000 0x1fa8 0x2015 0x8db8 0x67f5
		0x77f0 0x4981 0x8fb8 0x4981 0xb7f3 0x5174 0x600e 0x0000
		0x1a48 0x1a08 0x200e 0x600f 0x0000 0x1b88 0x200f 0x5250
		0x6015 0x0088 0x2015 0x600e 0x0000 0x1a48 0x1a08 0x200e
		0x600f 0x0000 0x1b88 0x200f 0x5180 0x600e 0x0088 0x0088
		0x200e 0x600f 0x0088 0x200f 0x5100 0x600e 0x0088 0x0088
		0x200e 0x600f 0x0088 0x200f 0x6013 0x0088 0x2013 0x6015
		0x0088 0x2015 0x6017 0x0088 0x2017 0xf4f1 0x5092 0x600f
		0x6415 0x0090 0x0091 0x1fa0 0x1f81 0x8db8 0x5016 0x1b80
		0x5e7b 0x77d0 0x4d83 0x5e00 0x5e4a 0x5e01 0x6e07 0x5e02
		0x6e37 0x7952 0x77e0 0x71ec 0x5072 0x7cf0 0x5d1b 0x07e2
		0x8028 0x5b0b 0x1b8a 0x5130 0xcc01 0x5072 0x7cef 0x5d1b
		0x07eb 0x8029 0x5b0b 0x1b8a 0x50a0 0x5d1b 0x07f6 0x7cf0
		0x8028 0x5b0b 0x7cef 0x8029 0x5b2b 0x8660 0x1b8a 0x4d82
		0x4580 0x6760 0x388e 0x388a 0x388c 0x3891 0x5e19 0xffff
		0x3c8b 0x3ca6 0x5e00 0xd286 0x718a 0x1b48 0x718b 0x1b48
		0x718c 0x1b48 0x6760 0x1b48 0x1b48 0x41c0 0x26c6 0x41c0
		0x3029 0xeda8 0x0001 0x50c1 0x0000 0x0814 0x0053 0x5e18
		0x0001 0x38a8 0x6760 0x5e00 0xc004 0x5e19 0x0bfb 0x0d1b
		0x1b48 0x41c0 0x8ee0 0x2100 0x3890 0x5e1a 0xffff 0xd4bc
		0xca8c 0xd4bc 0xca8d 0x4580 0xcd02 0x4181 0x082d 0x4580
		0x5e7a 0x5e49 0x0402 0x6760 0x5e01 0x0284 0x0c09 0x1b49
		0x5e00 0xc005 0x5e1a 0x0071 0x5e1b 0xd047 0x1b48 0x1b68
		0x7760 0x1b68 0x1b68 0x1b68 0x1b68 0x1b68 0x1b68 0x1b68
		0x2101 0x1b48 0x5e1a 0x014b 0x1b48 0x2102 0x1b48 0x1b68
		0x1b68 0x2102 0x1b48 0x5e1a 0x024c 0x1b48 0x2101 0x1b48
		0x5e1a 0x0096 0x1b48 0x2106 0x1b48 0x1b68 0x1b68 0x1b68
		0x1b68 0x1b68 0x1b68 0x1b60 0x5e00 0xc005 0x41c0 0x8fa2
		0x5e69 0x4580 0x0000 0x1fe0 0x0020 0x4180 0x2764 0x4180
		0x2764 0x4180 0x2764 0x4180 0x2764 0x4180 0x2764 0x4180
		0x2764 0x4180 0x2764 0x4180 0x2764 0x4180 0x2764 0x4180
		0x2764 0x4180 0x2764 0x4180 0x2764 0x4180 0x2764 0x4180
		0x2764 0x4180 0x2764 0x4180 0x2764 0x0002 0x0020
	 >;
};
