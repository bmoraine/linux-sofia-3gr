dspaud_sb:dspaud_sb {
	compatible = "intel,xgold-snd-dsp";
	intel,dsp,id = "XG742_SBA";
	reg = <0xE3300000 0x2000>, <0xE3302000 0x2000>;
	reg-names = "shm-regs", "shm-mem";
	interrupts = < SBADSP_INT1 IRQ_TYPE_DEFAULT >, < SBADSP_INT2 IRQ_TYPE_DEFAULT >, < SBADSP_INT1 IRQ_TYPE_DEFAULT >;
	interrupt-names = "dsp_playback", "dsp_record", "dsp_hw_probe";
	intel,uccf = <0x20C 0x210 0x214>;
	intel,mcu2dsp = <0x208>;
	intel,dsp-imsc = < 0xC 1 2 0 >;
	intel,dsp-icr = < 0x18 1 2 0 >;
	intel,dsp-mis = < 0x14 1 2 0 >;
	intel,dsp-cf = <3 4 0x1F>; /* play1, record, tone */
	reset-names = "dsp";
	dmas = < &dma8ch 11
		 &dma8ch 12
		 &dma8ch 13 >;
	dma-names = "play1", "play2", "record";
	resets = <&dbb_rst3 8>;
	intel,dsp-clc = < 4 >;
	intel,dsp-pcm-offset = < 2530 2531 >;
	intel,dsp-buf-size-ul-offset = < 1554 >;
	intel,dsp-sm-aud-buf-dl-offset = < 594 >;
	intel,dsp-sm-aud-buf-dl2-offset = < 1074 >;
	intel,dsp-sm-aud-buf-ul-offset = < 114 >;
	intel,dsp-sm-buf_sm_hw_probe_a_offset = < 1555 >;
	intel,dsp-sm-buf_sm_hw_probe_b_offset = < 2035 >;
	intel,dsp-rstmods = < 0x204 >;
	pm,class-name = "dsp_class";
	pm,user-name = "dsp_aud_sample";
	pm,state-D0 = "enable";
	pm,state-D3 = "disable";
	pm,state-D0i3 = "suspend";
	/* Fix me use DAPM for firmware path setup */
	intel,dsp-cmd-pcm_gain = /bits/ 16 <0x21 0x40 0x0 0x0 0x0 0x0 0x0 0x0 0x0 0x0 0x0 0x0 0x0 0x0 0x0 0x0 0x0 0x0 0x0 0x0 0x0 0x0 0x0 0x0 0x0 0x0 0x0 0x0 0x0 0x0 0x0 0x0 0x0 0x0>;
	intel,dsp-cmd-gain_const = /bits/ 16 < 0x24 0x2 0x32 >;
	intel,dsp-cmd-swm_afeout =/bits/ 16 <0x1F 0x24 0x1 0x0 0x0 0x0 0x0 0x0 0x1 0x0 0x0 0x0 0x0 0x0 0x0 0x0 0x0 0x0 0x0 0x0>;
	intel,dsp-cmd-swm_pcmout = /bits/ 16 <0x20 0x24 0x1 0x0 0x0 0x0 0x1 0x0 0x0 0x0 0x0 0x0 0x0 0x0 0x0 0x0 0x0 0x0 0x0 0x0>;
	intel,dsp-cmd-pcm_iir_left = /bits/ 16 <0x27 0x2E 0xA 0x0 0x0 0x0 0x0 0x0 0x0 0x0 0x0 0x0 0x0 0x0 0x0 0x0 0x0 0x0 0x0 0x0 0x0 0x0 0x0 0x0 0x0>;
	intel,dsp-cmd-pcm_iir_right = /bits/ 16 <0x27 0x2E 0xB 0x0 0x0 0x0 0x0 0x0 0x0 0x0 0x0 0x0 0x0 0x0 0x0 0x0 0x0 0x0 0x0 0x0 0x0 0x0 0x0 0x0 0x0>;
	intel,dsp-cmd-afe_tx_iir = /bits/ 16 <0x27 0x2E 0x2 0x0 0x0 0x0 0x0 0x0 0x0 0x0 0x0 0x0 0x0 0x0 0x0 0x0 0x0 0x0 0x0 0x0 0x0 0x0 0x0 0x0 0x0>;
	intel,dsp-cmd-i2s2_tx = /bits/ 16 <0x16 0x1E 0x1 0x1 0x3 0x0030 0x1060 0x0659 0x0 0x0 0x12 0x13 0x1 0x8 0x8 0x8 0x8>;
	intel,dsp-cm-i2s2_rx = /bits/ 16 <0x16 0x1E 0x2 0x1 0x3 0x30 0x1060 0x0659 0x0 0x0 0x12 0x13 0x1 0x8 0x8 0x8 0x8>;

	intel,dsp-fw = /bits/ 16 <
		/* SFLTE_SB_AUDIO CS10 PATCH V0.2.1.0 generated on Wed Jan 28 15:10:03 2015 (local time) */
		/* Configuration management:  */
		0x0000 0x0002 0x0002 0x4180 0x73aa 0x0000 0x0006 0x0002
		0x4180 0x253a 0x0000 0x000e 0x0002 0x4180 0x253a 0x0000
		0x0016 0x0002 0x4180 0x23d3 0x0000 0x0020 0x01fd 0x5e08
		0x0001 0x5e09 0x0030 0x5e0a 0x0000 0x4f90 0x5e0d 0x3000
		0x5e18 0x0002 0xd4bc 0xc402 0x0000 0x5e18 0x0100 0xd4bc
		0xc403 0x5e18 0x0001 0xd4bc 0xdba5 0xd4bc 0xcde1 0x5e18
		0x00cd 0xd4bc 0x2b1d 0x5e18 0x0391 0xd4bc 0x2b28 0x5e18
		0x05ae 0xd4bc 0x2b33 0x5e18 0x050b 0xd4bc 0x2b34 0x5e18
		0x0651 0xd4bc 0x2b35 0x5e18 0x0705 0xd4bc 0x2b1a 0x41c0
		0x0080 0x5e1a 0xffff 0xd4bc 0xdb02 0xd4bc 0xdb06 0xd4bc
		0xdb0a 0xd4bc 0xdb0e 0x5e1a 0xf007 0xd4bc 0xdb01 0x5e1a
		0x0000 0xd4bc 0xdb05 0x5e1a 0x0000 0xd4bc 0xdb09 0x81ea
		0x0040 0x81e8 0x000e 0x2101 0xd4bc 0xdb92 0x0000 0x0000
		0x0000 0x0000 0x0000 0x0000 0x0000 0x43c0 0x2101 0xd4bc
		0xdba1 0x0000 0x0000 0x0000 0x4380 0x4180 0x006f 0x6760
		0xd4bc 0x2648 0x387e 0x3880 0x38a2 0x38a4 0x38ce 0x5e00
		0xc404 0x5e19 0x0dfb 0x0d1b 0x1b48 0x3812 0xd4bc 0xd201
		0x41c0 0x00b6 0x41c0 0x26db 0x41c0 0x76a2 0x6760 0xd4bc
		0xceb4 0xd4bc 0xceb5 0xd4bc 0xceb0 0xd4bc 0xceb1 0xd4bc
		0xceb2 0xd4bc 0xceb3 0x5e18 0x0680 0xd4bc 0x2b4f 0x6760
		0xd4bc 0x2ec9 0xd4bc 0x2ece 0xd4bc 0x2ed2 0xd4bc 0x2ec8
		0xd4bc 0x2ecd 0xd4bc 0x2ed1 0x4580 0x5e00 0x6011 0x5e01
		0x2b3e 0x5c07 0x00bd 0x1f48 0x1b49 0x5e00 0x6019 0x5e01
		0x2b4b 0x5c07 0x00c5 0x1f48 0x1b49 0x5e00 0x2b3e 0x5e01
		0x2b4b 0x41c0 0x2302 0x4580 0xcd00 0x4181 0x00d1 0x4580
		0x5e78 0x83e8 0x0001 0x4d82 0x204e 0x205d 0x2258 0x724c
		0xa658 0x384c 0xe74b 0x0001 0x7247 0x384f 0x7248 0x3850
		0x7249 0x3851 0x724a 0x3852 0xd4b8 0x2c07 0x5102 0x604e
		0x644e 0x7958 0x77e0 0x5d1b 0x00f1 0x1f88 0x9288 0x6700
		0x1b89 0x7158 0xd4bc 0x2ec4 0x2101 0x3859 0x5060 0x7158
		0x6720 0xd4bc 0x2ec4 0x2102 0x3859 0xd4b8 0x2c08 0x50a2
		0x604e 0x6445 0xd5b8 0x2ec4 0x77e0 0x5d1b 0x0109 0x1f88
		0x1b89 0x2245 0xd4b8 0x2ec4 0x3857 0x7158 0x7159 0xd4bc
		0x2c10 0x6760 0x385a 0xd4b8 0x2c08 0x4181 0x01a3 0x714f
		0xa65a 0x3853 0x581a 0x7151 0xa65a 0x3854 0x583a 0x714e
		0xa65a 0x585a 0x7157 0x41c0 0x027f 0x6053 0x5e03 0x2c16
		0x5e01 0xe83c 0x41c0 0x0287 0x6054 0x5e03 0x2c20 0x5e01
		0xe854 0x41c0 0x0287 0x6053 0x6454 0x7157 0x585a 0x41c0
		0x026c 0xd4b8 0x2c13 0xcc01 0x5072 0x6053 0x5e03 0x2c5c
		0x5e01 0xeae5 0x41c0 0x0287 0xd4b8 0x2c12 0xcc01 0x5262
		0x6054 0x5e03 0x2c52 0x5e01 0xeacd 0x41c0 0x0287 0x7153
		0x3855 0x7150 0xa65a 0x3854 0x6053 0x6454 0x6855 0x7157
		0x41c0 0x027f 0x6053 0x5e03 0x2c2a 0x5e01 0xe86c 0x41c0
		0x0287 0x6054 0x5e03 0x2c34 0x5e01 0xe884 0x41c0 0x0287
		0x6053 0x6454 0x7157 0x585a 0x41c0 0x026c 0xd4b8 0x2c13
		0xcc01 0x5212 0x7151 0xa65a 0x3853 0x3855 0x7152 0xa65a
		0x3854 0x6053 0x6454 0x6855 0x7157 0x41c0 0x027f 0x6053
		0x5e03 0x2c3e 0x5e01 0xe89c 0x41c0 0x0287 0x6054 0x5e03
		0x2c48 0x5e01 0xebcd 0x41c0 0x0287 0x6053 0x6454 0x7157
		0x585a 0x41c0 0x026c 0xd5b8 0x2ec4 0x581b 0x7247 0x86a0
		0x3847 0x7248 0x86a0 0x3848 0x7249 0x86a0 0x3849 0x724a
		0x86a0 0x384a 0x724b 0xcc08 0x4182 0x025d 0x7246 0x3845
		0x7c4c 0xd4b8 0x2c0a 0x581a 0x8040 0x77b0 0x5b7d 0xd5bc
		0x2ec3 0xd4b8 0x2c09 0x3857 0xd5b8 0x2c07 0x5021 0x6720
		0x3857 0x6760 0x384c 0x5e1a 0x2ce3 0x384f 0x5e1a 0x2d43
		0x3850 0x5e1a 0x2da3 0x3851 0x5e1a 0x2e03 0x3852 0x5e1a
		0x2ce3 0x3847 0x5e1a 0x2d43 0x3848 0x5e1a 0x2da3 0x3849
		0x5e1a 0x2e03 0x384a 0x7246 0x384e 0x6760 0x385a 0xd4b8
		0x2ec3 0x385b 0xd4b8 0x2c08 0x4181 0x0233 0xcc02 0x51c6
		0x604f 0x5b00 0xa65a 0x581a 0x5e06 0x2c7f 0x5e40 0x41c0
		0x02e2 0x5e60 0x5e06 0x2c7f 0xd4b8 0x2c08 0xce02 0x5d1a
		0x01fb 0x87e0 0x0060 0x87e6 0x0019 0x5e40 0x5e46 0x41c0
		0x02e2 0x5e66 0x5e60 0x50e0 0x714f 0xa65a 0x581a 0x5e06
		0x2c7f 0x41c0 0x02e2 0x7151 0xa65a 0x581a 0x5e06 0x2c98
		0x41c0 0x02e2 0xd4b8 0x2c12 0xcc01 0x50a2 0x714f 0xa65a
		0x581a 0x7150 0xa65a 0x583a 0x5840 0x7157 0x41c0 0x0278
		0xd4b8 0x2c13 0xcc01 0x50a2 0x0000 0x021d 0x01fd 0x7151
		0xa65a 0x581a 0x7152 0xa65a 0x583a 0x5840 0x7157 0x41c0
		0x0278 0x714f 0xa65a 0x581a 0x7151 0xa65a 0x583a 0x714e
		0xa65a 0x585a 0x7157 0x41c0 0x0278 0x714e 0xa65a 0x581a
		0x5e06 0x2c66 0x41c0 0x02e2 0x715a 0xa657 0x385a 0x715b
		0x67e0 0x385b 0x4182 0x01db 0x714e 0xa657 0x67e0 0x581a
		0xd4b8 0x2c07 0x50b2 0x5b40 0xa657 0x583a 0x7157 0x67e0
		0x5d1a 0x0252 0x1f90 0x1b91 0x1b91 0x5070 0x5820 0x7157
		0x67e0 0x5d1a 0x025a 0x1f90 0x1b91 0x6760 0x384b 0x725d
		0x384e 0x6044 0x644e 0x5c0b 0x0264 0x1f88 0x1b89 0x2044
		0x714b 0xcc07 0x5022 0x7246 0x3844 0x4580 0x5b42 0x67e0
		0x5d1a 0x0276 0x1f80 0x1fa1 0x5a1d 0x87b8 0x1ba8 0x96b0
		0x1b89 0x4580 0x67e0 0x5d1a 0x027d 0x1f88 0x9289 0x1b8a
		0x4580 0x67e0 0x5d1a 0x0285 0x1f8a 0x6700 0x1b88 0x1b89
		0x4580 0x7058 0x7159 0x59da 0x5e40 0x5e41 0x5e43 0x41c0
		0x029e 0x5e63 0x5e61 0x5e60 0xd4b8 0x2c10 0xcc02 0x5072
		0x7058 0x0088 0x5b01 0xc60c 0x583a 0x41c0 0x029e 0x4580
		0xd4b8 0x2c15 0x67e0 0x585a 0x5e1f 0x4000 0x1e00 0x5e44
		0x5e40 0x5e41 0x5e43 0x5e45 0x5881 0x5b44 0xc604 0x58ba
		0x5803 0x5b43 0xc605 0x587a 0x5d02 0x02d8 0x5824 0xd028
		0x5b0b 0xd228 0x5b2b 0xda28 0xd248 0x1ce1 0x18ec 0x1a09
		0x58f0 0x8a30 0x822d 0x6700 0x8eb9 0xdb54 0x0090 0x77c0
		0xdb04 0x87ab 0xda04 0x9ff0 0x8eb9 0x1b4d 0x18f5 0x1ce1
		0x18ec 0x1b81 0x86bf 0x9a41 0x5b44 0xc602 0x589a 0x5b45
		0xc606 0x58ba 0x5803 0x5e65 0x5e63 0x5e61 0x5e60 0x5e64
		0x1a18 0x0094 0x543c 0x4580 0x6760 0x385c 0x5b66 0xc700
		0x3c5e 0x5b66 0xc705 0x3c5f 0x5b66 0xc701 0x3c60 0x5b66
		0xc706 0x3c61 0x5b66 0xc703 0x3c62 0x5b66 0xc708 0x3c63
		0x5b66 0xc702 0x3c64 0x5b66 0xc707 0x3c65 0x5b66 0xc704
		0x3c66 0x2056 0xd4b8 0x2c10 0x67e0 0x5d1a 0x0362 0x7156
		0xa65c 0x581a 0x41c0 0x0364 0x5b7c 0xdd89 0xdc8a 0x41c0
		0x75bc 0x5b7c 0xdd89 0xdc8a 0x5b66 0xc709 0x581b 0x5b66
		0xc70d 0x583b 0x0000 0x1fa9 0x9591 0x8cb9 0x5036 0x685e
		0x6c5f 0x5030 0x6860 0x6c61 0x5000 0x41c0 0x0383 0x77f0
		0xdc8a 0x5b5c 0xdc89 0x6866 0x0510 0x1f02 0xdac0 0x8db8
		0x5076 0x5e12 0x000f 0x41c0 0x7589 0x5b5c 0xdc8b 0x5040
		0x5e19 0x7fff 0xdd8b 0x5000 0x5b46 0xc60b 0x581a 0x0510
		0x1f00 0xdac0 0x5b66 0xc70f 0x583b 0x0000 0x1fa9 0x9591
		0x8cb9 0x5036 0x6862 0x6c63 0x5020 0x6864 0x6c65 0x41c0
		0x0383 0x5b5c 0xdc8b 0x58fa 0x7156 0xa65c 0x581a 0xd5b8
		0x2c09 0x7159 0x59da 0x77e0 0x5d1b 0x035e 0x8020 0x5b0b
		0x1b98 0xe75c 0x0001 0x87e6 0x0008 0x4580 0xd4b8 0x2c0a
		0x585a 0x7760 0xd4b8 0x2c11 0x587a 0x6790 0x5bfa 0xd4b8
		0x2c09 0x589a 0x9a80 0x5b0b 0xdac0 0x87b8 0x5b00 0xd4fb
		0x2c10 0x581a 0x0094 0x576c 0x58e2 0x6760 0x805d 0x865b
		0x845b 0x5be3 0xdac0 0x49c0 0x4580 0x6760 0x1ce2 0x8028
		0x8630 0x8420 0x7760 0x1ce3 0x8029 0x8e31 0x8c21 0x86b9
		0x1b89 0x1b41 0x4580 0xcd08 0x4181 0x039b 0xcd01 0x4181
		0x041c 0xcd07 0x4181 0x049d 0x4580 0x5e78 0x1f08 0xcc03
		0x6763 0x9b41 0x86c0 0x03a6 0x0000 0x599a 0x0000 0x0000
		0x4180 0x03ae 0x4180 0x03c1 0x4180 0x03fb 0x4180 0x040d
		0xe121 0x0002 0xe321 0x0001 0x6760 0xd4bc 0xceb0 0xd4bc
		0xceb1 0xd4bc 0x2ec9 0xd4bc 0x2ec8 0x5e18 0x0008 0xd4bc
		0x2ec7 0x4180 0x041b 0xd4b8 0x2ec9 0x4182 0x041b 0xf021
		0x4181 0x041b 0x6760 0xd4bc 0xceb0 0xd4bc 0xceb1 0xd4bc
		0x2ec6 0xd4bc 0x2ec8 0x5e18 0x0008 0xd4bc 0x2ec7 0xe321
		0x0002 0x0432 0x1f48 0x3801 0x1f48 0x3802 0x1f48 0x380c
		0x41c0 0x5f6f 0x6760 0x5e00 0xf1e6 0x0c0f 0x1b48 0x5e00
		0xf1f6 0x0c0f 0x1b48 0x5e06 0x1f11 0x5e01 0x1f1c 0x6802
		0x2f08 0x5e04 0xf2ed 0x41c0 0x6bf2 0xed0c 0x0001 0x50f2
		0x0430 0x0000 0xe121 0x0001 0x5200 0xd4b8 0x2ec9 0x4182
		0x041b 0xd4b8 0x2ec5 0x67e0 0xd4bc 0x2ec5 0x5165 0x0432
		0x41c0 0x5f9f 0x0430 0x2302 0x41c0 0x2327 0x50e0 0x87e0
		0x0003 0x0000 0x1f00 0xd4bc 0x2ec8 0x5002 0x0430 0x0000
		0xe121 0x0001 0x6760 0xd4bc 0x0000 0x041a 0x01fd 0x2ec9
		0x4580 0x5e78 0x1f08 0xcc03 0x6763 0x9b41 0x86c0 0x0427
		0x0000 0x599a 0x0000 0x0000 0x4180 0x042f 0x4180 0x0442
		0x4180 0x047c 0x4180 0x048e 0xe121 0x0020 0xe321 0x0010
		0x6760 0xd4bc 0xceb2 0xd4bc 0xceb3 0xd4bc 0x2ece 0xd4bc
		0x2ecd 0x5e18 0x0008 0xd4bc 0x2ecc 0x4180 0x049c 0xd4b8
		0x2ece 0x4182 0x049c 0xf421 0x4181 0x049c 0x6760 0xd4bc
		0xceb2 0xd4bc 0xceb3 0xd4bc 0x2ecb 0xd4bc 0x2ecd 0x5e18
		0x0008 0xd4bc 0x2ecc 0xe321 0x0020 0x0432 0x1f48 0x380e
		0x1f48 0x380f 0x1f48 0x3819 0x41c0 0x615c 0x6760 0x5e00
		0xf206 0x0c0f 0x1b48 0x5e00 0xf216 0x0c0f 0x1b48 0x5e06
		0x1f62 0x5e01 0x1f6d 0x680f 0x2f08 0x5e04 0xf2ed 0x41c0
		0x6bf2 0xed19 0x0001 0x50f2 0x0430 0x0000 0xe121 0x0010
		0x5200 0xd4b8 0x2ece 0x4182 0x049c 0xd4b8 0x2eca 0x67e0
		0xd4bc 0x2eca 0x5165 0x0432 0x41c0 0x618c 0x0430 0x2303
		0x41c0 0x2327 0x50e0 0x87e0 0x0003 0x0000 0x1f00 0xd4bc
		0x2ecd 0x5002 0x0430 0x0000 0xe121 0x0010 0x6760 0xd4bc
		0x2ece 0x4580 0x5e78 0x1f08 0xcc03 0x5361 0xcc04 0x5111
		0xe321 0x0004 0x6760 0xd4bc 0xceb4 0xd4bc 0xceb5 0xd4bc
		0x2ed1 0xd4bc 0x2ed2 0x5e18 0x0008 0xd4bc 0x2ed0 0x4180
		0x0509 0x87e0 0x0004 0x0000 0x1f00 0xd4bc 0x2ed1 0x5021
		0x4180 0x0509 0xe121 0x0004 0xd4b8 0x2ed2 0x4181 0x0509
		0x0432 0xef1e 0x01e2 0x641e 0x2100 0x1b49 0x5e1a 0x00f0
		0x1b51 0x0430 0x2304 0x41c0 0x2327 0x0432 0x41c0 0x63b3
		0x6760 0xd4bc 0x2ed2 0x5320 0xd4b8 0x2ed2 0x4182 0x0509
		0x1f48 0xd4bc 0x321a 0x1f48 0xd4bc 0x321b 0x1f48 0xd4bc
		0x3223 0x1f48 0xd4bc 0x3224 0xf221 0x5141 0x6760 0xd4bc
		0xceb4 0xd4bc 0xceb5 0xd4bc 0x2ed2 0xd4bc 0x2ed1 0x5e18
		0x0008 0xd4bc 0x2ed0 0x7221 0x82c0 0x000c 0x41c1 0x6337
		0xe121 0x0004 0x5e06 0x2521 0x5e01 0x237d 0x2b08 0xd4b8
		0x321b 0x587a 0x5e04 0xf2ed 0x41c0 0x6bf2 0x0430 0x4580
		0xcd06 0x5041 0xcd04 0x4181 0x057f 0x4580 0x5e7a 0xd4b8
		0x2ecd 0x4182 0x05a4 0x5e41 0x5e45 0x5e18 0x0001 0xd4bc
		0x2ecb 0x5e06 0x008f 0xd882 0x4e05 0x5e19 0x0002 0x8cb9
		0x67f3 0xd4bc 0xcde3 0xed14 0x0000 0x51d2 0xd880 0x581a
		0x0000 0x1c40 0x8ce2 0x0001 0x5162 0x5e18 0x0002 0x1b4a
		0x1f4a 0x3811 0x2413 0x2101 0x3812 0x0088 0xd883 0x4602
		0x96bc 0x9ea0 0x5023 0xd883 0x581a 0x5b40 0xdc80 0xd885
		0x67e3 0xdc85 0x50a0 0x5e1a 0x00f0 0x3811 0x5e18 0x0510
		0x3813 0x6760 0x3812 0xd4bc 0x2ecb 0xed19 0x0001 0x50c2
		0x41c0 0x618c 0x0430 0x5e41 0x5e45 0x2303 0x41c0 0x2327
		0x5e65 0x5e61 0x0432 0x51d0 0xed18 0xffff 0x5082 0xd4b8
		0x0091 0xd4ff 0x0094 0xcc01 0x5093 0x2101 0x3818 0xd4b8
		0x0094 0xac18 0x50e3 0x5e18 0xffff 0x3818 0x2120 0xd4bc
		0xdb91 0xd4b8 0xcde3 0xd4bc 0x2eca 0x5e18 0x0002 0xd4bc
		0xdb10 0x5e65 0x5e61 0x4580 0xd4b8 0x2ecb 0x4181 0x05a3
		0xd4b8 0x2ecc 0x67e0 0xd4bc 0x2ecc 0x4182 0x05a3 0x5e18
		0x0008 0xd4bc 0x2ecc 0x5e1a 0x0200 0xd4bc 0xdb92 0x81e8
		0x0001 0x5e18 0xceb3 0x581a 0x0000 0x1f90 0x8080 0x67d0
		0x1b48 0x1b80 0x5e1a 0x0200 0xd4bc 0xdb91 0x83e8 0x0001
		0x4580 0x5e78 0x0430 0x0000 0xe321 0x0010 0x5e18 0x0001
		0xd4bc 0x2ece 0x4580 0xcd06 0x5041 0xcd04 0x4181 0x0622
		0x4580 0x5e7a 0xd4b8 0x2ec8 0x4182 0x0647 0x5e41 0x5e45
		0x5e18 0x0001 0xd4bc 0x2ec6 0x5e06 0x0089 0xd882 0x4e05
		0x5e19 0x0002 0x8cb9 0x67f3 0xd4bc 0xcde2 0xed07 0x0000
		0x51d2 0xd880 0x581a 0x0000 0x1c40 0x8ce2 0x0001 0x5162
		0x5e18 0x0002 0x1b4a 0x1f4a 0x3804 0x2406 0x2101 0x3805
		0x0088 0xd883 0x4602 0x96bc 0x9ea0 0x5023 0xd883 0x581a
		0x5b40 0xdc80 0xd885 0x67e3 0xdc85 0x50a0 0x5e1a 0x00f0
		0x3804 0x5e18 0x0510 0x3806 0x6760 0x3805 0xd4bc 0x2ec6
		0xed0c 0x0001 0x50c2 0x41c0 0x5f9f 0x0430 0x5e41 0x5e45
		0x2302 0x41c0 0x2327 0x5e65 0x5e61 0x0432 0x51d0 0xed0b
		0xffff 0x5082 0xd4b8 0x008b 0xd4ff 0x008e 0xcc01 0x5093
		0x2101 0x380b 0xd4b8 0x008e 0xac0b 0x50e3 0x5e18 0xffff
		0x380b 0x2108 0xd4bc 0xdb91 0x0000 0x0617 0x0143 0xd4b8
		0xcde2 0xd4bc 0x2ec5 0x5e18 0x0002 0xd4bc 0xdb10 0x5e65
		0x5e61 0x4580 0xd4b8 0x2ec6 0x4181 0x0646 0xd4b8 0x2ec7
		0x67e0 0xd4bc 0x2ec7 0x4182 0x0646 0x5e18 0x0008 0xd4bc
		0x2ec7 0x5e1a 0x0100 0xd4bc 0xdb92 0x81e8 0x0001 0x5e18
		0xceb1 0x581a 0x0000 0x1f90 0x8080 0x67d0 0x1b48 0x1b80
		0x5e1a 0x0100 0xd4bc 0xdb91 0x83e8 0x0001 0x4580 0x5e7a
		0x0430 0x0000 0xe321 0x0001 0x5e18 0x0001 0xd4bc 0x2ec9
		0x4580 0xcd04 0x4181 0x065e 0xcd03 0x4181 0x067c 0xcd02
		0x4181 0x0687 0xcd01 0x4181 0x069b 0x4580 0x5e78 0x0432
		0x81e8 0x0001 0x4d80 0x6760 0x381a 0x381b 0x381c 0x381d
		0x381e 0x3820 0x3821 0x3822 0x3823 0x2101 0x381f 0x0432
		0x3705 0x5e06 0x252c 0x5e01 0xf2ca 0x5e02 0x254f 0x41c0
		0x654f 0x0430 0x4180 0x631d 0x6760 0xd4bc 0x2ecf 0x4580
		0x41c0 0x6374 0x5e18 0x0001 0xd4bc 0x2ecf 0x4580 0x5e78
		0x5e06 0x0095 0xd881 0x581a 0xd883 0x4602 0x1c28 0x8ca0
		0x5083 0xd883 0x581a 0x5e18 0x0001 0xd5b8 0x2ecf 0x6762
		0x381f 0x4180 0x63c5 0x5e78 0xf221 0x5202 0xd4b8 0x2ed0
		0x67e0 0xd4bc 0x2ed0 0x4182 0x06be 0x5e18 0x0008 0xd4bc
		0x2ed0 0x5e1a 0x0400 0xd4bc 0xdb92 0x81e8 0x0001 0x5e18
		0xceb5 0x581a 0x0000 0x1f90 0x8080 0x67d0 0x1b48 0x1b80
		0x5e1a 0x0400 0xd4bc 0xdb91 0x83e8 0x0001 0xd4b8 0x0c4e
		0x5bfa 0xd4b8 0x0c4f 0x58fa 0x5e00 0x0b0f 0x5c05 0x06d1
		0x8020 0x5b0b 0xdac0 0x67a0 0x1b88 0x8020 0x5b0b 0xdac0
		0x67a0 0x1b88 0x0432 0x0000 0xed1e 0x0000 0x41c1 0x63b3
		0x601e 0x5e01 0x0b0f 0x5c05 0x06e0 0x1f49 0x1b48 0x1f49
		0x1b48 0x201e 0xe71c 0x000c 0xed1c 0x01e0 0x5135 0xd4b8
		0x2ed1 0x4182 0x06fc 0xef1e 0x01e2 0x641e 0x2100 0x1b49
		0x5e1a 0x00f0 0x1b51 0x0430 0x2304 0x41c0 0x2327 0x0432
		0x41c0 0x63b3 0x0430 0x4580 0x0430 0x0000 0xe321 0x0004
		0x5e18 0x0001 0xd4bc 0x2ed2 0x4580 0xcd04 0x5011 0x4580
		0x5e78 0x5e49 0x9020 0x4182 0x0758 0x0092 0x4d80 0x3f05
		0x1f08 0x9b7f 0x82c0 0x000f 0x805a 0x5b0b 0x86c0 0x2622
		0x58da 0x1f10 0x58fa 0xd881 0x8cc0 0x01e0 0x51c4 0xdaf0
		0x4602 0x4703 0x587a 0x58bb 0x4d83 0x5c3b 0x072c 0x1f05
		0x8023 0x5b2b 0x9fc4 0x1b4b 0x1bad 0xd981 0x87c0 0x003c
		0xdd81 0x8dc0 0x01e0 0x5075 0xd884 0xd4bc 0xdb91 0x5e18
		0x0002 0xd4bc 0xdb10 0xd880 0x4603 0x587a 0x5881 0x9520
		0x5071 0x5d02 0x0746 0x1f83 0x1fa4 0x1b8c 0x1bab 0x5070
		0x5d02 0x074e 0x1f83 0x9284 0x1fa4 0x1b8c 0x1bab 0xd980
		0x87a2 0x77d0 0x8dc0 0x01e0 0x5025 0x7760 0xdd81 0xdd80
		0x5e69 0x4580 0x0000 0x17e0 0x0020 0x4180 0x2770 0x4180
		0x2770 0x4180 0x2770 0x4180 0x2770 0x4180 0x2770 0x4180
		0x2770 0x4180 0x2770 0x4180 0x2770 0x4180 0x2770 0x4180
		0x2770 0x4180 0x2770 0x4180 0x2770 0x4180 0x2770 0x4180
		0x2770 0x4180 0x2770 0x4180 0x2770 0x0001 0x1fb3 0x0006
		0x0002 0x1789 0x196b 0x0002 0x1b4d 0x1d2f 0x0001 0x260a
		0x003e 0x0000 0x0000 0x0000 0x0000 0x0000 0x0000 0x0000
		0x0000 0x0000 0x0000 0x0000 0x0000 0x0000 0x0000 0x0000
		0x0000 0x0000 0x0000 0x0000 0x0000 0x0000 0x0000 0x0000
		0x0000 0x0000 0x0000 0xca13 0x1b4d 0x0002 0x0000 0x0000
		0xcbf3 0x1d2f 0x0004 0x0000 0x0000 0x0000 0x0000 0x0000
		0x0000 0x0000 0x0000 0x0000 0x0000 0x0000 0x0000 0x0000
		0x0000 0x0000 0x0000 0x0000 0x0000 0x0000 0x0000 0x0000
		0x0000 0x0000 0x0000 0x0000 0x0000 0x0000 0x0000 0x0001
		0x2649 0x0018 0x0000 0x0000 0x0000 0x0000 0x0000 0x0000
		0x0000 0x0000 0x0000 0x0000 0x0000 0x0000 0x0000 0x0000
		0x0000 0x0000 0x0000 0x0000 0x0000 0x0000 0x0000 0x0000
		0x0000 0x0000 0x0001 0x2ec3 0x0002 0x0000 0x0000 0x0001
		0x30f4 0x0004 0x0000 0x0000 0x0000 0x0000 0x0002 0x0020
	>;
};
