#ifdef CONFIG_X86_INTEL_SOFIA
#define VMM_HIRQ_VECT 32
main_hirq:main-hirq-interrupt-controller {
	compatible = "intel,sofia-main-hirq";
	#interrupt-cells = <2>;
	interrupt-controller;
	interrupt-parent = <&pic>;
	interrupts =
		< VMM_HIRQ_VECT IRQ_TYPE_DEFAULT >;
};
hirq:hirq-interrupt-controller {
	compatible = "intel,sofia-hirq";
	#interrupt-cells = <2>;
	interrupt-controller;
	interrupt-parent = <&main_hirq>;
	interrupts =
		< 0 IRQ_TYPE_DEFAULT >, /* 512 - HIRQ_VMM_BROADCAST */
		< 0 IRQ_TYPE_DEFAULT >, /* 513 - HIRQ_PMIC_TEST */
		< 0 IRQ_TYPE_DEFAULT >, /* 514 - HIRQ_HIRQ_TEST */
		< 0 IRQ_TYPE_DEFAULT >, /* 515 - HIRQ_PMIC_PRH_SIGNALING */
		< 0 IRQ_TYPE_DEFAULT >, /* 516 - HIRQ_PMIC_VTIMER */
		< 0 IRQ_TYPE_DEFAULT >, /* 517 - HIRQ_PMIC_PWR_BUTTON */
		< 0 IRQ_TYPE_DEFAULT >, /* 518 - HIRQ_PMIC_UI_BUTTON */
		< 0 IRQ_TYPE_DEFAULT >, /* 519 - HIRQ_PMIC_VENDOR_IRQ */
		< 0 IRQ_TYPE_DEFAULT >, /* 520 - HIRQ_PMIC_WAKE_ALARM */
		< 0 IRQ_TYPE_DEFAULT >, /* 521 - HIRQ_PMIC_SYS_ALARM */
		< 0 IRQ_TYPE_DEFAULT >, /* 522 - HIRQ_PMIC_SYS0ALRT0 */
		< 0 IRQ_TYPE_DEFAULT >, /* 523 - HIRQ_PMIC_SYS1ALRT0 */
		< 0 IRQ_TYPE_DEFAULT >, /* 524 - HIRQ_PMIC_SYS2ALRT0 */
		< 0 IRQ_TYPE_DEFAULT >, /* 525 - HIRQ_PMIC_PMICALRT0 */
		< 0 IRQ_TYPE_DEFAULT >, /* 526 - HIRQ_PMIC_SYS0ALRT1 */
		< 0 IRQ_TYPE_DEFAULT >, /* 527 - HIRQ_PMIC_SYS1ALRT1 */
		< 0 IRQ_TYPE_DEFAULT >, /* 528 - HIRQ_PMIC_SYS2ALRT1 */
		< 0 IRQ_TYPE_DEFAULT >, /* 529 - HIRQ_PMIC_GPALRT */
		< 0 IRQ_TYPE_DEFAULT >, /* 530 - HIRQ_PMIC_SYS0CRIT */
		< 0 IRQ_TYPE_DEFAULT >, /* 531 - HIRQ_PMIC_SYS1CRIT */
		< 0 IRQ_TYPE_DEFAULT >, /* 532 - HIRQ_PMIC_SYS2CRIT */
		< 0 IRQ_TYPE_DEFAULT >, /* 533 - HIRQ_PMIC_PMICCRIT */
		< 0 IRQ_TYPE_DEFAULT >, /* 534 - HIRQ_PMIC_BATCRIT */
		< 0 IRQ_TYPE_DEFAULT >, /* 535 - HIRQ_PMIC_BATCRIT_HC */
		< 0 IRQ_TYPE_DEFAULT >, /* 536 - HIRQ_PMIC_BZIRQ */
		< 0 IRQ_TYPE_DEFAULT >, /* 537 - HIRQ_PMIC_SYS0ALRT3 */
		< 0 IRQ_TYPE_DEFAULT >, /* 538 - HIRQ_PMIC_SYS1ALRT3 */
		< 0 IRQ_TYPE_DEFAULT >, /* 539 - HIRQ_PMIC_SYS2ALRT3 */
		< 0 IRQ_TYPE_DEFAULT >, /* 540 - HIRQ_PMIC_PMICALRT3 */
		< 0 IRQ_TYPE_DEFAULT >, /* 541 - HIRQ_PMIC_BAT0ALRT0 */
		< 0 IRQ_TYPE_DEFAULT >, /* 542 - HIRQ_PMIC_BAT1ALRT0 */
		< 0 IRQ_TYPE_DEFAULT >, /* 543 - HIRQ_PMIC_BAT1ALRT3 */
		< 0 IRQ_TYPE_DEFAULT >, /* 544 - HIRQ_PMIC_BAT1ALRT3 */
		< 0 IRQ_TYPE_DEFAULT >, /* 545 - HIRQ_PMIC_BCU_VWARN1 */
		< 0 IRQ_TYPE_DEFAULT >, /* 546 - HIRQ_PMIC_BCU_VWARN2 */
		< 0 IRQ_TYPE_DEFAULT >, /* 547 - HIRQ_PMIC_BCU_VCRIT */
		< 0 IRQ_TYPE_DEFAULT >, /* 548 - HIRQ_PMIC_ADC_USBID */
		< 0 IRQ_TYPE_DEFAULT >, /* 549 - HIRQ_PMIC_ADC_PEAK */
		< 0 IRQ_TYPE_DEFAULT >, /* 550 - HIRQ_PMIC_ADC_BATTEMP */
		< 0 IRQ_TYPE_DEFAULT >, /* 551 - HIRQ_PMIC_ADC_SYSTEMP */
		< 0 IRQ_TYPE_DEFAULT >, /* 552 - HIRQ_PMIC_ADC_BATTID */
		< 0 IRQ_TYPE_DEFAULT >, /* 553 - HIRQ_PMIC_ADC_VBATT */
		< 0 IRQ_TYPE_DEFAULT >, /* 554 - HIRQ_PMIC_ADC_GPMEAS */
		< 0 IRQ_TYPE_DEFAULT >, /* 555 - HIRQ_PMIC_ADC_CCTICK */
		< 0 IRQ_TYPE_DEFAULT >, /* 556 - HIRQ_PMIC_CHGINTB */
		< 0 IRQ_TYPE_DEFAULT >, /* 557 - HIRQ_PMIC_I2CWRCMP */
		< 0 IRQ_TYPE_DEFAULT >, /* 558 - HIRQ_PMIC_I2CRDCMP */
		< 0 IRQ_TYPE_DEFAULT >, /* 559 - HIRQ_PMIC_I2CERROR */
		< 0 IRQ_TYPE_DEFAULT >, /* 560 - HIRQ_PMIC_CTYP */
		< 0 IRQ_TYPE_DEFAULT >, /* 561 - HIRQ_PMIC_VBUSDET */
		< 0 IRQ_TYPE_DEFAULT >, /* 562 - HIRQ_PMIC_DCDET */
		< 0 IRQ_TYPE_DEFAULT >, /* 563 - HIRQ_PMIC_BATTDET */
		< 0 IRQ_TYPE_DEFAULT >, /* 564 - HIRQ_PMIC_USBID_FLT */
		< 0 IRQ_TYPE_DEFAULT >, /* 565 - HIRQ_PMIC_USBID_GND */
		< 0 IRQ_TYPE_DEFAULT >, /* 566 - HIRQ_PMIC_GPIO0P0 */
		< 0 IRQ_TYPE_DEFAULT >, /* 567 - HIRQ_PMIC_GPIO0P1 */
		< 0 IRQ_TYPE_DEFAULT >, /* 568 - HIRQ_PMIC_GPIO0P2 */
		< 0 IRQ_TYPE_DEFAULT >, /* 569 - HIRQ_PMIC_GPIO0P3 */
		< 0 IRQ_TYPE_DEFAULT >, /* 570 - HIRQ_PMIC_GPIO0P4 */
		< 0 IRQ_TYPE_DEFAULT >, /* 571 - HIRQ_PMIC_GPIO0P5 */
		< 0 IRQ_TYPE_DEFAULT >, /* 572 - HIRQ_PMIC_GPIO0P6 */
		< 0 IRQ_TYPE_DEFAULT >, /* 573 - HIRQ_PMIC_BATTIO  */
		< 0 IRQ_TYPE_DEFAULT >, /* 574 - HIRQ_PMIC_GPIO1P0 */
		< 0 IRQ_TYPE_DEFAULT >, /* 575 - HIRQ_PMIC_GPIO1P1 */
		< 0 IRQ_TYPE_DEFAULT >, /* 576 - HIRQ_PMIC_GPIO1P2 */
		< 0 IRQ_TYPE_DEFAULT >, /* 577 - HIRQ_PMIC_GPIO1P3 */
		< 0 IRQ_TYPE_DEFAULT >, /* 578 - HIRQ_PMIC_GPIO2P0 */
		< 0 IRQ_TYPE_DEFAULT >, /* 579 - HIRQ_PMIC_GPIO2P1 */
		< 0 IRQ_TYPE_DEFAULT >, /* 580 - HIRQ_PMIC_CRIT_VROCP */
		< 0 IRQ_TYPE_DEFAULT >, /* 581 - HIRQ_PMIC_CRIT_OSCSTP */
		< 0 IRQ_TYPE_DEFAULT >, /* 582 - HIRQ_PMIC_ACC_DET1 */
		< 0 IRQ_TYPE_DEFAULT >, /* 583 - HIRQ_PMIC_ACC_DET2 */
		< 0 IRQ_TYPE_DEFAULT >, /* 584 - HIRQ_PMIC_ACC_DET_AUX */
		< 0 IRQ_TYPE_DEFAULT >, /* 585 - HIRQ_PMIC_VIBR_OVC */
		< 0 IRQ_TYPE_DEFAULT >; /* 586 - HIRQ_PMIC_LOUDSPK */
	intel,hirq_offset = <HIRQ_OFFSET>;
};
#endif
