## drivers/media/i2c/soc_camera/xgold/Kconfig
```kconfig
config VIDEO_OV8825
	bool "OV8825"
	depends on VIDEO_V4L2 && VIDEO_XGOLD && I2C
	default n
	---help---
	Say Y here to enable OV8825.

config VIDEO_OV5670
	bool "OV5670"
	depends on VIDEO_V4L2 && VIDEO_XGOLD && I2C
	default n
	---help---
	Say Y here to enable OV5670.

config VIDEO_OV9740
	bool "OV9740"
	depends on VIDEO_V4L2 && VIDEO_XGOLD && I2C
	default n
	---help---
	Say Y here to enable OV9740.

config VIDEO_OV9760
	bool "OV9760"
	depends on VIDEO_V4L2 && VIDEO_XGOLD && I2C
	default n
	---help---
	Say Y here to enable OV9760.

config VIDEO_OV13850
	bool "OV13850"
	depends on VIDEO_V4L2 && VIDEO_XGOLD && I2C
	default n
	---help---
	Say Y here to enable OV13850.

config VIDEO_OV5648
	bool "OV5648"
	depends on VIDEO_V4L2 && VIDEO_XGOLD && I2C
	default n
	help
	  Say Y here to enable OV5648.
	  OV5648 is a 5MP Camera Sensor.
	  The supported max resolution is 2592X1944.
	  It is a RAW Camera Sensor.

config VIDEO_GC2155
	tristate "GC2155"
	depends on I2C && VIDEO_V4L2
	default n
	help
	  Say Y here to enable GC2155.
	  GC2155 is a 2MP Camera Sensor.
	  The supported max resolution is 1600x1200.
	  It is a SOC Camera Sensor.

config VIDEO_GC2355
	tristate "GC2355"
	depends on VIDEO_V4L2 && VIDEO_XGOLD && I2C
	default n
	help
	  Say Y here to enable GC2355.
	  GC2355 is a 2MP Camera Sensor.
	  The supported max resolution is 1600x1200.
	  It is a RAW Camera Sensor.

config VIDEO_XGOLD_GC2355
	tristate "GC2355"
	depends on I2C && VIDEO_V4L2
	default n
	help
	  Say Y here to enable GC2355.
	  GC2355 is a 2MP Camera Sensor.
	  The supported max resolution is 1600x1200.
	  It is a RAW Camera Sensor.

config VIDEO_GC0310
	tristate "GC0310"
	depends on I2C && VIDEO_V4L2
	default n
	help
	  Say Y here to enable GC0310.
	  GC0310 is a VGA Camera Sensor.
	  The supported max resolution is 640x480.
	  It is a SOC Camera Sensor.

config VIDEO_GC0310_RAW
	tristate "GC0310_RAW"
	depends on I2C && VIDEO_V4L2
	default n
	help
	  Say Y here to enable GC0310.
	  GC0310 is a VGA Camera Sensor.
	  The supported max resolution is 640x480.
	  It is a RAW Camera Sensor.

config VIDEO_OV8858
	bool "OV8858"
	depends on VIDEO_V4L2 && VIDEO_XGOLD && I2C
	default n
	---help---
	Say Y here to enable OV8858.

config VIDEO_OV2685
    bool "OV2685"
    depends on VIDEO_V4L2 && VIDEO_XGOLD && I2C
	default n
	---help---
	Say Y here to enable OV2685.

config VIDEO_OV2680
    bool "OV2680"
    depends on VIDEO_V4L2 && VIDEO_XGOLD && I2C
        default n
        ---help---
        Say Y here to enable OV2680.
        OV2680 is a 2M Camera Sensor.
         The supported max resolution is 1600x1200.
         It is a RAW Camera Sensor.

config VIDEO_HM2051
	tristate "HM2051 support"
	depends on I2C && VIDEO_V4L2 && VIDEO_XGOLD
	---help---
	This is a Video4Linux2 sensor-level driver for HM2051.

	iCatch is an external ISP connected to the sensor

	It currently only works with the atomisp driver.
```

## drivers/media/platform/xgold/Kconfig
```kconfig
config VIDEO_XGOLD
	tristate "Xgold camera sensors"
	depends on VIDEO_V4L2 && I2C
	select VIDEOBUF_GEN
	select VIDEOBUF_DMA_CONTIG
	select VIDEOBUF_VMALLOC
	default n

	---help---
	Say Y here to enable selecting the
	xgold supported camera sensors

config CIF_ISP20_REG_TRACE
	tristate "ISP register trace"
	depends on VIDEO_XGOLD
	default n

	---help---
	Say Y here to enable ISP function and register traces.
	This is a debugging feature.
```

## drivers/media/radio/intel_lnp/Kconfig
```kconfig
#Kconfig
#
# Intel LnP FM driver
#
menu "Intel LnP FM driver"
config RADIO_LNP
        tristate "Intel FM Radio driver"
        depends on VIDEO_V4L2
        ---help---
           Choose Y here if you have this FM radio chip.

           In order to control your radio card, you will need to use programs
           that are compatible with the Video For Linux 2 API.  Information on
           this API and pointers to "v4l2" programs may be found at
           <file:Documentation/video4linux/API.html>.

           To compile this driver as a module, choose M here: the
           module will be called fmdrv_intel.
endmenu
```

## drivers/misc/noc/Kconfig
```kconfig
config HAVE_NOC
	bool "Arteris NoC driver support on xgold platforms"
	depends on X86_INTEL_XGOLD
	default n
	help
	   Select this if you want support
	   for Arteris FlexNOC on-chip interconnect
```

## drivers/misc/rockchip/vpu/Kconfig
```kconfig
config ROCKCHIP_VPU
	tristate "rockchip vpu driver"
	default n
	help
	  Driver for sofia video encoder and decoder
```

## drivers/misc/verisilicon/7280/Kconfig
```kconfig
config VERISILICON_7280
	tristate "VeriSilicon 7280 driver"
	default n
	help
	  Driver for Verisilicon 7280 video encoder

config VERISILICON_7280_DEBUG_FS
	tristate "Verisilicon 7280 debug file system"
	depends on VERISILICON_7280 && DEBUG_FS
	default n
	help
	  Debug FS for Verisilicon 7280 video encoder
```

## drivers/misc/verisilicon/G1/Kconfig
```kconfig
config VERISILICON_G1
	tristate "VeriSilicon G1 driver"
	default n
	help
	  Driver for Verisilicon G1 video decoder using an IOCTL Interface

config VERISILICON_G1_DEBUG_FS
	tristate "Verisilicon G1 debug file system"
	depends on VERISILICON_G1 && DEBUG_FS
	default n
	help
	  Debug FS for Verisilicon G1 video decoder
```

## drivers/mobilevisor/Kconfig
```kconfig
#
#  Copyright (C) 2014 Intel Mobile Communications
#
#  This program is free software: you can redistribute it and/or modify
#  it under the terms of the GNU General Public License Version 2
#  as published by the Free Software Foundation.
#
#  This program is distributed in the hope that it will be useful,
#  but WITHOUT ANY WARRANTY; without even the implied warranty of
#  MERCHANTABILITY or FITNESS FOR A PARTICULAR PURPOSE.
#
#  You should have received a copy of the GNU General Public License Version 2
#  along with this program. If not, see <http://www.gnu.org/licenses/>.
#

#
# Mobilevisor vdriver configuration
#

if MOBILEVISOR_VDRIVER

menu "Mobilevisor virtual driver support"

config MOBILEVISOR_VDRIVER_PIPE
        tristate "bi-directional pipe for inter OS communication"
        default y
        help
          Virtual bi-directional pipe for inter OS communication.


config MOBILEVISOR_VDRIVER_NVM
        tristate "VNVM driver"
        default y
        help
          VNVM driver

config MOBILEVISOR_VDRIVER_POWER
	bool "Virtual Power management frontend interface"
	default y
	help
	  Power management support for the native device drivers
	  in a virtualized environment.

config MOBILEVISOR_VDRIVER_OEMCRYPTO
	tristate "Virtual OEMCrypto frontend interface"
	default y
	help
	  Virtualized OEMCrypto library support for Widevine DRM
	  from Secure VM.
	  To compile this driver as a module, choose M here: the
	  module will be called voemcrypto-fe.

config MOBILEVISOR_VDRIVER_DUMP
	tristate "VDUMP Driver"
	default y
	help
	  To support coredump
	  via VMM when Linux panic
	  To compile this driver as a module, choose M here: the
	  module will be called vdump.

config MOBILEVISOR_VDRIVER_USB
	tristate "Virtual USB SIO Extender Front End"
	default y
	help
	 usb sio extender front end allows sending AT
	 commands to modem vm over usb acm.
	 vbpipe is used to forward from acm to modem vm.

	 To compile this driver as a module, choose M here: the
	 module will be called vusb_se_fe

config MOBILEVISOR_VDRIVER_ETHERNET
        tristate "Virtual Ethernet driver"
        depends on NETDEVICES
        default y
        help
          This driver emulates Ethernet communication with a back-end driver
          running in another partition.

          To compile this driver as a module, choose M here: the
          module will be called veth.

config MOBILEVISOR_VDRIVER_MODEM_CTL
        tristate "Virtual modem control driver"
        default y
        help
          This driver provides interface to load, start and stop modem.

config SYSTEM_PROFILING
        tristate "Virtual System Profiling backend interface"
        default n
        help
          Enable instrumentation for ExactProfiling in Linux
          to generate traces for post-processing.

config TEE_RPC
        tristate "TEE RPC driver for Sofia sec_vm"
	select VSEC_RPC
	default n
        help
          TEE RPC driver for dispatching RPC calls to the secure vm

          The driver's name is tee_rpc.

          If unsure, select N.
endmenu

endif
```

## drivers/nvm/Kconfig
```kconfig
#
# NVM infrastructure and drivers
#

config NVM
    tristate "NVM driver"
    default y
      help
        IMC NVM support driver.
        This driver emulates non-volatile memory and provide interfaces to other drivers.

        To compile this driver as a module, choose M here: the
        module will be called nvmdev.

config NVM_DEBUG
    bool "NVM Debug"
    depends on DEBUG_KERNEL && NVM
    default n
    ---help---
        Say Y here to add debug messages to nvm driver.

config NVMTEST
    tristate "NVM test driver"
    depends on NVM
    default n
    ---help---
     Creates a test driver interface to test nvm driver.
```

## drivers/oct/Kconfig
```kconfig
#
# OCT configuration
#

menu "OCT config"

config OCT
	bool "OCT REV1 driver"
	default n
	help
	  The OCT driver provides the interface to get the traces from
	  the OCT HW.

config OCT2
	bool "OCT REV2 driver"
	default n
	help
	  The OCT REV2 - used for getting modem and linux traces out over
	  the USB to the STT tool.

endmenu
```

## drivers/reset/Kconfig
```kconfig
config ARCH_HAS_RESET_CONTROLLER
	bool

config XGOLD_RESET
	bool
	select ARCH_HAS_RESET_CONTROLLER

menuconfig RESET_CONTROLLER
	bool "Reset Controller Support"
	default y if ARCH_HAS_RESET_CONTROLLER
	help
	  Generic Reset Controller support.

	  This framework is designed to abstract reset handling of devices
	  via GPIOs or SoC-internal reset controller modules.

	  If unsure, say no.
```

## drivers/sldriver/Kconfig
```kconfig
config SLDRIVER
	tristate "Silentlake driver"
	default y if (x86)
	help
	  Silentlake Trusted Execution Environment Driver
```

## drivers/switch/Kconfig
```kconfig
menuconfig SWITCH
	tristate "Switch class support"
	help
	  Say Y here to enable switch class support. This allows
	  monitoring switches by userspace via sysfs and uevent.

if SWITCH

config SWITCH_GPIO
	tristate "GPIO Swith support"
	depends on GPIOLIB
	help
	  Say Y here to enable GPIO based switch support.

config SWITCH_XGOLD
	bool "Configure XGOLD switch driver for XGOLD (headset)"
	depends on SND_SOC_XGOLD_MACHINE
	help
	  Say Y here to enable XGOLD Switch driver (for headset)

endif # SWITCH
```

## drivers/usb/dwc_otg/Kconfig
```kconfig
config USB_DWC_OTG
	tristate "Synopsys Highspeed Dual Role Controller"
	depends on USB || USB_GADGET
	---help---
	  Say Y here if your system has a dual role high speed USB
	  controller based on Synopsys silicon IP.

if USB_DWC_OTG

config USB_DWC_UDC
	bool "DWC device controller"
	depends on USB_GADGET=y || USB_GADGET=USB_DWC_OTG
	---help---
	  Say Y here to enable device controller functionality of the
	  Synopsys driver

config USB_DWC_HOST
	bool "DWC host controller"
	depends on USB=y || USB=USB_DWC_OTG
	---help---
	  Say Y here to enable host controller functionality of the
	  Synopsys driver.

config USB_DWC_DEBUG
	bool "DWC driver debug"
	---help---
	  Say Y here to enable debugging output of the Synopsys driver.

endif
```

## drivers/video/nanosilicon/Kconfig
```kconfig
menuconfig TRSM_NANOSILICON
	bool "Nanosilicon display transmitter support"
	depends on FB_ROCKCHIP
	help
	  Nanosilicon display transmitter support.
	  It is used by rockchip framebuffer driver.
	  Say Y here if you use
	  Nanosilicon display transmitter.

config LVDS_NANOSILICON
	bool "Nanosilicon lvds transmitter support"
	depends on TRSM_NANOSILICON
	help
	  Nanosilicon lvds transmitter support
	  It is used by rockchip framebuffer driver.
	  Say y to use
	  Nanosilicon LVDS transmitter.
```

## drivers/video/rockchip/Kconfig
```kconfig
menuconfig FB_ROCKCHIP
	tristate "Rockchip Framebuffer Display support"
	select FB
	select FB_CFB_FILLRECT
	select FB_CFB_COPYAREA
	select FB_CFB_IMAGEBLIT
	select FB_MODE_HELPERS
	select VIDEOMODE_HELPERS
	default n
	help
	  Enable Rockchip Framebuffer Display driver
	  for sofia 3gr platform.
	  Please choose Y to enable rockchip
	  framebuffer driver.

source "drivers/video/rockchip/vop/Kconfig"
source "drivers/video/rockchip/rga/Kconfig"
```

## drivers/video/rockchip/rga/Kconfig
```kconfig
config RGA_ROCKCHIP
	tristate "RGA_ROCKCHIP"
	depends on FB_ROCKCHIP
	help
	  sofia rga module.
```

## drivers/video/rockchip/vop/Kconfig
```kconfig
config ROCKCHIP_VOP
        tristate "rockchip vop support"
        depends on FB_ROCKCHIP
        help
          Driver for rockchip vop controller.
	  It is used on sofia 3gr platform.
	  Please select Y to enable the
	  rockchip vop driver
```

## drivers/video/xgold/Kconfig
```kconfig
source "drivers/video/xgold/dcc/Kconfig"
source "drivers/video/xgold/dsi/Kconfig"
```

## drivers/video/xgold/dcc/Kconfig
```kconfig
config XGOLD_DCC
    tristate "XGold DCC(Display Content Controller) support"
    depends on X86_INTEL_XGOLD
    select FB
	default y
    help
      Say Y here if you use XGold Display Content Controller.

config XGOLD_DCC_SYSFS
    bool "XGold DCC sysfs support"
    depends on XGOLD_DCC
	  default y
    help
      Say y to activate.(/sys/devices/system/dcc)

config XGOLD_DCC_DEBUG
    bool "Enable DCC debug at boot"
    depends on XGOLD_DCC
	default n
    help
      Perform an animation at startup.

config TRANSMITTER_LVDS
    bool "Enable to support LVDS interface display"
    depends on I2C
	default n
    help
      Say y to activate.
```

## drivers/video/xgold/dsi/Kconfig
```kconfig
config XGOLD_MIPI_DSI
	bool "XGold MIPI DSI transmitter support"
	depends on X86_INTEL_XGOLD
	default y
	help
	  XGold MIPI DSI transmitter support
	  It is used by rockchip framebuffer driver.
	  Say y to use
	  XGold MIPI DSI transmitter.
```
